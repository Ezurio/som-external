## toolchain/toolchain-external-laird-bdimx6/Config.in
```kconfig
config BR2_TOOLCHAIN_EXTERNAL_LAIRD_BDIMX6
	bool "Laird BDIMX Toolchain"
	depends on BR2_arm
	depends on BR2_ARM_CPU_ARMV7A || BR2_ARM_CPU_ARMV8A
	depends on BR2_ARM_EABIHF
	depends on BR2_HOSTARCH = "x86_64"
	select BR2_TOOLCHAIN_EXTERNAL_GLIBC
	select BR2_TOOLCHAIN_HEADERS_AT_LEAST_4_14
	select BR2_TOOLCHAIN_GCC_AT_LEAST_12
	select BR2_TOOLCHAIN_HAS_SSP
	select BR2_INSTALL_LIBSTDCPP
	help
	  GCC 12.2.0, GDB 12.0.0, glibc-2.36+, headers-4.14, binutils 2.39
```

## toolchain/toolchain-external-laird-component/Config.in
```kconfig
config BR2_TOOLCHAIN_EXTERNAL_LAIRD_COMPONENT
	bool "Laird Component Toolchain"
	depends on BR2_HOSTARCH = "x86_64"
	select BR2_TOOLCHAIN_EXTERNAL_GLIBC
	select BR2_TOOLCHAIN_HAS_SSP
	select BR2_TOOLCHAIN_HAS_NATIVE_RPC
	select BR2_INSTALL_LIBSTDCPP
	select BR2_TOOLCHAIN_HEADERS_AT_LEAST_3_0 if BR2_arm || BR2_i386 || BR2_x86_64
	select BR2_TOOLCHAIN_HEADERS_AT_LEAST_3_10 if BR2_aarch64 || BR2_powerpc64
	select BR2_TOOLCHAIN_HEADERS_AT_LEAST_3_16 if BR2_powerpc
	select BR2_TOOLCHAIN_GCC_AT_LEAST_4_9 if BR2_arm || BR2_i386 || BR2_x86_64 || BR2_powerpc
	select BR2_TOOLCHAIN_GCC_AT_LEAST_5 if BR2_aarch64
	select BR2_TOOLCHAIN_GCC_AT_LEAST_6 if BR2_powerpc64
	help
	  Laird Connectivity Component toolchains. It uses:
	  arm, x86, x86-64: GCC 4.9.4, GDB 9.1.0, glibc-2.13, binutils 2.34.0 Linux 3.0.0
	  aarch64: GCC 5.5.0 , GDB 9.1.0, glibc-2.19, binutils 2.29.1 Linux 3.10.0
	  powerpc64: GCC 6.5.0, GDB 9.1.0, glibc-2.26, binutils 2.34.0  Linux 3.10.0
	  powerpc: GCC 4.9.4, GDB 9.2.0, glibc-2.19, binutils 2.37 Linux 3.16.0
```

## toolchain/toolchain-external-laird-wb40-32/Config.in
```kconfig
config BR2_TOOLCHAIN_EXTERNAL_LAIRD_WB40_32
	bool "Laird WB40 Kernel 3.2 Toolchain"
	depends on BR2_arm
	depends on BR2_ARM_CPU_ARMV7A || BR2_ARM_CPU_ARMV8A || BR2_ARM_CPU_ARMV6 || BR2_ARM_CPU_ARMV5 || BR2_ARM_CPU_ARMV4
	depends on BR2_HOSTARCH = "x86_64"
	depends on BR2_ARM_EABI
	select BR2_TOOLCHAIN_HEADERS_AT_LEAST_3_2
	select BR2_TOOLCHAIN_GCC_AT_LEAST_12
	select BR2_TOOLCHAIN_EXTERNAL_GLIBC
	select BR2_TOOLCHAIN_HAS_SSP
	select BR2_INSTALL_LIBSTDCPP
	help
	  Laird toolchain for the ARM architecture.
	  GCC 12.2.0, GDB 12.0.0, glibc-2.36+, headers-3.2.0, binutils 2.39
```

## package/lrd/lrd-radio/som60-firmware-binaries/Config.in
```kconfig
config BR2_PACKAGE_SOM60_FIRMWARE_BINARIES
	bool "SOM60 Firmware Installer"
	select BR2_PACKAGE_LAIRD_FIRMWARE if BR2_LRD_DEVEL_BUILD
	select BR2_PACKAGE_LAIRD_FIRMWARE_LRDMWL_60_SDIO_UART if BR2_LRD_DEVEL_BUILD
	select BR2_PACKAGE_LRD_WIRELESS_REGDB if BR2_LRD_DEVEL_BUILD
	help
      Extracts the Laird som60 wireless firmware binaries from an firmware release and install them on the target.
```

## package/lrd/lrd-radio/summit-supplicant-binaries/Config.in
```kconfig
config BR2_PACKAGE_SUMMIT_SUPPLICANT_BINARIES
	bool "Summit Supplicant Binaries Installer"
	select BR2_PACKAGE_LIBNL
	select BR2_PACKAGE_DBUS if !BR2_PACKAGE_LRD_LEGACY
	select BR2_PACKAGE_OPENSSL
	select BR2_PACKAGE_LIBEDIT if BR2_PACKAGE_LRD_LEGACY
	select BR2_PACKAGE_SDCSUPP
	select BR2_PACKAGE_SDCSUPP_WPA_CLI if !BR2_PACKAGE_LRD_LEGACY
	select BR2_PACKAGE_SDCSUPP_LEGACY if BR2_PACKAGE_LRD_LEGACY
	select BR2_PACKAGE_SDCSDK if BR2_LRD_DEVEL_BUILD && BR2_PACKAGE_LRD_LEGACY
	select BR2_PACKAGE_SDCCLI if BR2_LRD_DEVEL_BUILD && BR2_PACKAGE_LRD_LEGACY
	help
	  Extracts sdcsupp, wpa_cli binaries from summit supplicant release and install them on the target.

config BR2_PACKAGE_SUMMIT_SUPPLICANT_BINARIES_SUFFIX
	string
	depends on BR2_PACKAGE_SUMMIT_SUPPLICANT_BINARIES
	default "_libs_legacy" if BR2_PACKAGE_LRD_LEGACY
	default "_libs"
```

## package/lrd/lrd-radio/wb45n-firmware-binaries/Config.in
```kconfig
config BR2_PACKAGE_WB45N_FIRMWARE_BINARIES
	bool "WB45N Firmware Installer"
	select BR2_PACKAGE_LAIRD_FIRMWARE if BR2_LRD_DEVEL_BUILD
	select BR2_PACKAGE_LAIRD_FIRMWARE_AR6003 if BR2_LRD_DEVEL_BUILD
	select BR2_PACKAGE_LRD_WIRELESS_REGDB if BR2_LRD_DEVEL_BUILD
	help
	  Extracts the Laird wb45n wireless firmware binaries from the
	  binary firmware release and install them on the target.
```

## package/lrd/lrd-radio/wb50n-firmware-binaries/Config.in
```kconfig
config BR2_PACKAGE_WB50N_FIRMWARE_BINARIES
	bool "WB50N Firmware Installer"
	select BR2_PACKAGE_LAIRD_FIRMWARE if BR2_LRD_DEVEL_BUILD
	select BR2_PACKAGE_LAIRD_FIRMWARE_AR6004 if BR2_LRD_DEVEL_BUILD
	select BR2_PACKAGE_LRD_WIRELESS_REGDB if BR2_LRD_DEVEL_BUILD
	help
	  Extracts the Laird wb50n wireless firmware binaries from the
	  binary firmware release and install them on the target.
```

## package/lrd/lrd-usbgadget/Config.in
```kconfig
menuconfig BR2_PACKAGE_LRD_USBGADGET
	bool "lrd-usb-gadget"
	help
	  Laird USB Ethernet Gadget

if BR2_PACKAGE_LRD_USBGADGET

config BR2_PACKAGE_LRD_USBGADGET_ETHERNET_PORTS
	int "USB Gadget Ethernet ports"
	default 1

if BR2_PACKAGE_LRD_USBGADGET_ETHERNET_PORTS > 0
choice BR2_PACKAGE_LRD_USBGADGET_TYPE
	prompt "USB Gadget Ethernet Type"
	default BR2_PACKAGE_LRD_USBGADGET_TYPE_ECM if BR2_PACKAGE_LRD_LEGACY
	default BR2_PACKAGE_LRD_USBGADGET_TYPE_NCM
	help
	  Laird USB Ethernet Gadget Type

config BR2_PACKAGE_LRD_USBGADGET_TYPE_RNDIS
	bool "RNDIS"
	help
	  Laird RNDIS USB Ethernet Gadget

config BR2_PACKAGE_LRD_USBGADGET_TYPE_NCM
	bool "NCM"
	help
	  Laird NCM USB Ethernet Gadget

config BR2_PACKAGE_LRD_USBGADGET_TYPE_ECM
	bool "ECM"
	help
	  Laird ECM USB Ethernet Gadget

endchoice

config BR2_PACKAGE_LRD_USBGADGET_VENDOR_ID
	string "USB Vendor ID"
	default "0x1fa3"
	help
	  USB Gadget Vendor ID

config BR2_PACKAGE_LRD_USBGADGET_PRODUCT_ID
	string "USB Product ID"
	default "0x0002"
	help
	  USB Gadget Product ID

config BR2_PACKAGE_LRD_USBGADGET_LOCAL_MAC
	string "USB Ethernet Gadget local MAC address"
	default "DE:AD:BE:EF:00:01"
	help
	  USB Ethernet Gadget local MAC address

config BR2_PACKAGE_LRD_USBGADGET_REMOTE_MAC
	string "USB Ethernet Gadget remote MAC address"
	default "DE:AD:BE:EF:00:00"
	help
	  USB Ethernet Gadget remote MAC address
endif

config BR2_PACKAGE_LRD_USBGADGET_TYPE_STRING
	string
	default "rndis" if BR2_PACKAGE_LRD_USBGADGET_TYPE_RNDIS
	default "ncm"   if BR2_PACKAGE_LRD_USBGADGET_TYPE_NCM
	default "ecm"   if BR2_PACKAGE_LRD_USBGADGET_TYPE_ECM

config BR2_PACKAGE_LRD_USBGADGET_SERIAL_PORTS
	int "USB Gadget Serial ports"
	default 0

endif
```

## package/lrd/lrd-wireless-regdb/Config.in
```kconfig
config BR2_PACKAGE_LRD_WIRELESS_REGDB
	bool "lrd-wireless-regdb"
	help
	  Laird Wireless regulatory databases.

	  Laird Wireless regulatory databases for CRDA and kernel. The database
	  lists the allowed radio frequencies for each local jurisdiction.

	  http://linuxwireless.org/en/developers/Regulatory
```

## package/lrd/sdcsupp/Config.in
```kconfig
config BR2_PACKAGE_SDCSUPP
	bool "SDC Supplicant"
	select BR2_PACKAGE_LIBNL
	select BR2_PACKAGE_OPENSSL
	select BR2_PACKAGE_SDCSUPP_LEGACY if BR2_PACKAGE_LRD_LEGACY
	select BR2_PACKAGE_DBUS if !BR2_PACKAGE_SDCSUPP_LEGACY
	select BR2_PACKAGE_SUMMIT_SUPPLICANT_BINARIES if !BR2_LRD_DEVEL_BUILD && !BR2_LRD_NO_RADIO
	help
	  SDC Supplicant

if BR2_PACKAGE_SDCSUPP

config BR2_PACKAGE_SDCSUPP_WPA_CLI
	bool "Install wpa_cli binary"
	help
	  Install wpa_cli command line utility

config BR2_PACKAGE_SDCSUPP_WPA_PASSPHRASE
	bool "Install wpa_passphrase binary"
	help
	  Install wpa_passphrase command line utility.

config BR2_PACKAGE_SDCSUPP_LEGACY
	bool "SDC Supplicant Legacy"
	select BR2_PACKAGE_SDCSDK if BR2_LRD_DEVEL_BUILD || BR2_LRD_NO_RADIO
	select BR2_PACKAGE_SDCCLI if BR2_LRD_DEVEL_BUILD || BR2_LRD_NO_RADIO

config BR2_PACKAGE_SDCSUPP_LIBS_ONLY
	bool "Internal build of closed source libraries only"

endif
```

## package/lrd/summit-edgeiq/Config.in
```kconfig
config BR2_PACKAGE_SUMMIT_EDGEIQ
	bool "summit-edgeiq"
	depends on BR2_PACKAGE_SYSTEMD
	select BR2_PACKAGE_LRD_ENCRYPTED_STORAGE_TOOLKIT_EXEC_PERM if BR2_PACKAGE_LRD_ENCRYPTED_STORAGE_TOOLKIT
	help
	  Summit IG EdgeIQ Support

if BR2_PACKAGE_SUMMIT_EDGEIQ
config BR2_PACKAGE_SUMMIT_EDGEIQ_INSTALLDIR
	string "EdgeIQ install directory"
	default /perm
endif
```

## package/lrd/summit-rcm-awm-plugin/Config.in
```kconfig
config BR2_PACKAGE_SUMMIT_RCM_AWM_PLUGIN
	bool "AWM plugin for Summit RCM"
	depends on BR2_PACKAGE_ADAPTIVE_WW || BR2_PACKAGE_ADAPTIVE_WW_BINARIES
	depends on BR2_PACKAGE_SUMMIT_RCM
	select BR2_PACKAGE_PYTHON_LIBCONF
	default y
	help
		Add AWM (Adaptive Worldwide Mode) configuration support to Summit RCM.
```

## package/lrd/summit-rcm-bluetooth-plugin/Config.in
```kconfig
config BR2_PACKAGE_SUMMIT_RCM_BLUETOOTH_PLUGIN
	bool "Bluetooth plugin for Summit RCM"
	depends on BR2_PACKAGE_BLUEZ5_UTILS
	depends on BR2_PACKAGE_SUMMIT_RCM_REST_API
	default y
	help
		Add basic Bluetooth REST API support to Summit RCM
		(scanning/pairing/connecting), and BLE REST API
		(GATT central role).

if BR2_PACKAGE_SUMMIT_RCM_BLUETOOTH_PLUGIN

config BR2_PACKAGE_SUMMIT_RCM_BLUETOOTH_PLUGIN_VSP
	bool "BLE VSP support for Summit RCM"
	help
		Add BLE VSP support (rx/tx transfers over chosen GATT
		characteristics to TCP server) to Summit RCM.

config BR2_PACKAGE_SUMMIT_RCM_BLUETOOTH_PLUGIN_HID
	bool "HID BT barcode scanner support for Summit RCM"
	select BR2_PACKAGE_PYTHON_PYUDEV
	select BR2_PACKAGE_BLUEZ5_UTILS_PLUGINS_HID
	select BR2_PACKAGE_BLUEZ5_UTILS_PLUGINS_HOG
	help
		Add Bluetooth HID barcode scanner support to Summit RCM.

config BR2_PACKAGE_SUMMIT_RCM_BLUETOOTH_PLUGIN_WEBSOCKETS
	bool "Websockets support for BLE on Summit RCM"
	select BR2_PACKAGE_PYTHON_WEBSOCKETS
	help
		Add Websockets streaming support for BLE REST API.

endif
```

## package/lrd/summit-rcm-chrony-plugin/Config.in
```kconfig
config BR2_PACKAGE_SUMMIT_RCM_CHRONY_PLUGIN
	bool "chrony plugin for NTP control"
	depends on BR2_PACKAGE_SUMMIT_RCM
	depends on BR2_PACKAGE_CHRONY
	default y
	help
		Enable chrony wrapper for NTP configuration
```

## package/lrd/summit-rcm-modem-plugin/Config.in
```kconfig
config BR2_PACKAGE_SUMMIT_RCM_MODEM_PLUGIN
	bool "Modem / positioning support plugin or Summit RCM"
	depends on BR2_PACKAGE_SUMMIT_RCM_REST_API_LEGACY_ROUTES
	help
		Add modem, positioning, positioning switch support to Summit RCM.
```

## package/lrd/summit-rcm-radio-siso-mode-plugin/Config.in
```kconfig
config BR2_PACKAGE_SUMMIT_RCM_RADIO_SISO_MODE_PLUGIN
	bool "Plugin to allow changing radio's SISO mode"
	depends on BR2_PACKAGE_SUMMIT_RCM
	help
		Enable support for temporarily changing the radio's SISO mode
		(for testing purposes only)
```

## package/lrd/summit-rcm-stunnel-plugin/Config.in
```kconfig
config BR2_PACKAGE_SUMMIT_RCM_STUNNEL_PLUGIN
	bool "Control support plugin for stunnel"
	depends on BR2_PACKAGE_SUMMIT_RCM_REST_API_V2_ROUTES || \
		BR2_PACKAGE_SUMMIT_RCM_REST_API_LEGACY_ROUTES
	select BR2_PACKAGE_STUNNEL
	help
		Enable support to control stunnel
```

## package/lrd/summit-rcm-unauthenticated-plugin/Config.in
```kconfig
config BR2_PACKAGE_SUMMIT_RCM_UNAUTHENTICATED_PLUGIN
	bool "Unauthenticated access support plugin for Summit RCM"
	depends on BR2_PACKAGE_SUMMIT_RCM_ENABLE_SESSIONS
	help
		Add unauthenticated access support, for example, for factory reset and reboot endpoints.  Due to security concerns, this should never be enabled unless requested by a customer, and preferably never enabled if Summit RCM is exposed on a public/external zone interface.
```

## package/lrd/summit-rcm/Config.in
```kconfig
config BR2_PACKAGE_SUMMIT_RCM
	bool "Summit Remote Control Manager (RCM)"
	select BR2_PACKAGE_PYTHON3
	select BR2_PACKAGE_PYTHON3_SSL
	select BR2_PACKAGE_PYTHON_AIOFILES
	select BR2_PACKAGE_PYTHON_DBUS_FAST
	select BR2_PACKAGE_ZIP
	select BR2_PACKAGE_UNZIP
	select BR2_PACKAGE_LIBOPENSSL_BIN
	select BR2_PACKAGE_LRD_SWUPDATE_CLIENT
	help
		Summit Remote Control Manager (RCM)

if BR2_PACKAGE_SUMMIT_RCM

config BR2_PACKAGE_SUMMIT_RCM_REST_API
	bool
	select BR2_PACKAGE_PYTHON_FALCON
	select BR2_PACKAGE_PYTHON_UVICORN

config BR2_PACKAGE_SUMMIT_RCM_REST_API_V2_ROUTES
	bool "v2 REST API routes"
	select BR2_PACKAGE_SUMMIT_RCM_REST_API
	default y
	help
		Enable the Summit RCM v2 REST API routes

config BR2_PACKAGE_SUMMIT_RCM_REST_API_LEGACY_ROUTES
	bool "Legacy REST API routes"
	select BR2_PACKAGE_SUMMIT_RCM_REST_API
	help
		Enable the Summit RCM legacy REST API routes
		(backward compatibility with WebLCM)

config BR2_PACKAGE_SUMMIT_RCM_HTTPS_PORT
	int "REST API HTTPS Port"
	depends on BR2_PACKAGE_SUMMIT_RCM_REST_API
	default 443
	help
		HTTPS port number for the Summit RCM REST API

config BR2_PACKAGE_SUMMIT_RCM_AT_INTERFACE
	bool "AT Interface"
	select BR2_PACKAGE_PYTHON_SERIAL_ASYNCIO
	select BR2_PACKAGE_PYTHON_TRANSITIONS
	help
		Enable the Summit RCM AT command interface

config BR2_PACKAGE_SUMMIT_RCM_MANAGED_SOFTWARE_DEVICES
	string "List of supported software devices"
	default ""
	help
		Space separated software devices like bonds, bridges etc.
		Bridge devices should be named as "br0", "br1" etc.
		Bond devices should be named as "bn0", "bn1" etc.

config BR2_PACKAGE_SUMMIT_RCM_UNMANAGED_HARDWARE_DEVICES
	string "List of unmanaged hardware devices"
	default ""
	help
		Space separated hardware devices like eth0, wlan0 etc which
		are managed by NetworkManager, but don't want to be managed
		by Summit RCM.

config BR2_PACKAGE_SUMMIT_RCM_ENABLE_SESSIONS
	bool "Enable cookie-based authentication sessions"
	depends on BR2_PACKAGE_SUMMIT_RCM_REST_API
	default y
	help
		Enable cookie-based authentication sessions

config BR2_PACKAGE_SUMMIT_RCM_DEFAULT_USERNAME
	string "default root user name"
	depends on BR2_PACKAGE_SUMMIT_RCM_ENABLE_SESSIONS
	default "root"

config BR2_PACKAGE_SUMMIT_RCM_DEFAULT_PASSWORD
	string "default root user password"
	depends on BR2_PACKAGE_SUMMIT_RCM_ENABLE_SESSIONS
	default "summit"

config BR2_PACKAGE_SUMMIT_RCM_ENABLE_CLIENT_AUTHENTICATION
	bool "Enable SSL client authentication"
	depends on BR2_PACKAGE_SUMMIT_RCM_REST_API
	help
		Enable SSL client authentication

config BR2_PACKAGE_SUMMIT_RCM_ALLOW_MUTLIPLE_USER_SESSIONS
	bool "Allow multiple sessions per user"
	depends on BR2_PACKAGE_SUMMIT_RCM_ENABLE_SESSIONS
	help
		Enable multiple sessions for the same user (re-login)

config BR2_PACKAGE_SUMMIT_RCM_SERIAL_PORT
	string "AT Interface Serial Port"
	depends on BR2_PACKAGE_SUMMIT_RCM_AT_INTERFACE
	default "/dev/ttyS2"
	help
		Enable Configuration of the AT Interface serial port

config BR2_PACKAGE_SUMMIT_RCM_BAUD_RATE
	int "AT Interface Baud Rate"
	depends on BR2_PACKAGE_SUMMIT_RCM_AT_INTERFACE
	default 3000000
	help
		Enable Configuration of the AT Interface baud rate

endif
```

## package/lrd/summitssl_fips_provider/Config.in
```kconfig
config BR2_PACKAGE_SUMMITSSL_FIPS_PROVIDER
	bool "OpenSSL FIPS Provider"
	depends on BR2_PACKAGE_OPENSSL 
	depends on BR2_PACKAGE_LIBOPENSSL_3_0
	depends on !BR2_PACKAGE_FIPSCHECK 
	depends on !BR2_PACKAGE_LIBOPENSSL_ENABLE_FIPS
	help
		FIPS provider 

if BR2_PACKAGE_SUMMITSSL_FIPS_PROVIDER

config BR2_PACKAGE_SUMMITSSL_FIPS_PROVIDER_VERSION_VALUE
	string "OpenSSL FIPS Provider version"
	default "11.0.0.256"

endif # BR2_PACKAGE_SUMMITSSL_FIPS_PROVIDER
```

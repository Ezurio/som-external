## package/summit-usbgadget-legacy/Config.in
```kconfig
menuconfig BR2_PACKAGE_SUMMIT_USBGADGET_LEGACY
	bool "Summit USB Gadget (legacy shell)"
	help
	  Legacy USB Ethernet Gadget helper scripts.

if BR2_PACKAGE_SUMMIT_USBGADGET_LEGACY

config BR2_PACKAGE_SUMMIT_USBGADGET_LEGACY_OTG
	bool "USB Gadget OTG"
	help
	  USB Gadget OTG

config BR2_PACKAGE_SUMMIT_USBGADGET_LEGACY_VENDOR_ID
	string "USB Vendor ID"
	default "0x1fa3"
	help
	  USB Gadget Vendor ID

config BR2_PACKAGE_SUMMIT_USBGADGET_LEGACY_PRODUCT_ID
	string "USB Product ID"
	default "0x0002"
	help
	  USB Gadget Product ID

choice BR2_PACKAGE_SUMMIT_USBGADGET_LEGACY_SERIAL_SOURCE
	prompt "USB Gadget serial number source"
	default BR2_PACKAGE_SUMMIT_USBGADGET_LEGACY_SERIAL_SOURCE_AUTO
	help
	  Select how the USB gadget serial number is derived at runtime.

config BR2_PACKAGE_SUMMIT_USBGADGET_LEGACY_SERIAL_SOURCE_AUTO
	bool "Automatic fallback"
	help
	  Use the existing runtime fallback order.

config BR2_PACKAGE_SUMMIT_USBGADGET_LEGACY_SERIAL_SOURCE_UBOOT_ETHADDR
	bool "U-Boot ethaddr"
	help
	  Derive the USB gadget serial number from U-Boot ethaddr.

config BR2_PACKAGE_SUMMIT_USBGADGET_LEGACY_SERIAL_SOURCE_UBOOT_ETH1ADDR
	bool "U-Boot eth1addr"
	help
	  Derive the USB gadget serial number from U-Boot eth1addr.

config BR2_PACKAGE_SUMMIT_USBGADGET_LEGACY_SERIAL_SOURCE_CUSTOM
	bool "Custom serial value or expression"
	help
	  Use the custom USB gadget serial value or shell expression below.

endchoice

config BR2_PACKAGE_SUMMIT_USBGADGET_LEGACY_SERIAL_SOURCE_STRING
	string
	default "auto" if BR2_PACKAGE_SUMMIT_USBGADGET_LEGACY_SERIAL_SOURCE_AUTO
	default "uboot_ethaddr" if BR2_PACKAGE_SUMMIT_USBGADGET_LEGACY_SERIAL_SOURCE_UBOOT_ETHADDR
	default "uboot_eth1addr" if BR2_PACKAGE_SUMMIT_USBGADGET_LEGACY_SERIAL_SOURCE_UBOOT_ETH1ADDR
	default "custom" if BR2_PACKAGE_SUMMIT_USBGADGET_LEGACY_SERIAL_SOURCE_CUSTOM

config BR2_PACKAGE_SUMMIT_USBGADGET_LEGACY_SERIAL_NUMBER
	string "USB Gadget serial value or expression"
	depends on BR2_PACKAGE_SUMMIT_USBGADGET_LEGACY_SERIAL_SOURCE_CUSTOM
	help
	  Custom USB gadget serial value or shell expression.
	  This value is written into /etc/default/usb-gadget and sourced
	  at runtime, so shell expressions such as command substitution may
	  be used to derive a serial number.
	  Required when the custom serial source is selected.

config BR2_PACKAGE_SUMMIT_USBGADGET_LEGACY_ETHERNET_PORTS
	int "USB Gadget Ethernet ports"
	default 1

if BR2_PACKAGE_SUMMIT_USBGADGET_LEGACY_ETHERNET_PORTS > 0
choice BR2_PACKAGE_SUMMIT_USBGADGET_LEGACY_TYPE
	prompt "USB Gadget Ethernet Type"
	default BR2_PACKAGE_SUMMIT_USBGADGET_LEGACY_TYPE_ECM if BR2_PACKAGE_SUMMIT_LEGACY
	default BR2_PACKAGE_SUMMIT_USBGADGET_LEGACY_TYPE_NCM
	help
	  USB Ethernet Gadget Type

config BR2_PACKAGE_SUMMIT_USBGADGET_LEGACY_TYPE_RNDIS
	bool "RNDIS"
	help
	  RNDIS USB Ethernet Gadget

config BR2_PACKAGE_SUMMIT_USBGADGET_LEGACY_TYPE_NCM
	bool "NCM"
	help
	  NCM USB Ethernet Gadget

config BR2_PACKAGE_SUMMIT_USBGADGET_LEGACY_TYPE_ECM
	bool "ECM"
	help
	  ECM USB Ethernet Gadget

endchoice

config BR2_PACKAGE_SUMMIT_USBGADGET_LEGACY_TYPE_STRING
	string
	default "rndis" if BR2_PACKAGE_SUMMIT_USBGADGET_LEGACY_TYPE_RNDIS
	default "ncm"   if BR2_PACKAGE_SUMMIT_USBGADGET_LEGACY_TYPE_NCM
	default "ecm"   if BR2_PACKAGE_SUMMIT_USBGADGET_LEGACY_TYPE_ECM

config BR2_PACKAGE_SUMMIT_USBGADGET_LEGACY_LOCAL_MAC
	string "USB Ethernet Gadget local MAC address"
	default "DE:AD:BE:EF:00:01"
	help
	  USB Ethernet Gadget local MAC address

config BR2_PACKAGE_SUMMIT_USBGADGET_LEGACY_REMOTE_MAC
	string "USB Ethernet Gadget remote MAC address"
	default "DE:AD:BE:EF:00:00"
	help
	  USB Ethernet Gadget remote MAC address

endif

config BR2_PACKAGE_SUMMIT_USBGADGET_LEGACY_SERIAL_PORTS
	int "USB Gadget Serial ports"
	default 0

endif
```

## package/summit-usbgadget/Config.in
```kconfig
menuconfig BR2_PACKAGE_SUMMIT_USBGADGET
	bool "Summit USB Gadget daemon (Rust)"
	depends on BR2_PACKAGE_HOST_RUSTC_TARGET_ARCH_SUPPORTS
	select BR2_PACKAGE_HOST_RUSTC
	help
	  Runtime-configurable composite USB gadget daemon.

if BR2_PACKAGE_SUMMIT_USBGADGET

config BR2_PACKAGE_SUMMIT_USBGADGET_USB
	bool "Enable USB gadget support"
	depends on BR2_PACKAGE_HAS_UDEV
	default y
	help
	  Build summit-usbgadget with USB gadget support enabled.
	  Supports USB gadget modes: CDC ACM, NCM, ECM, RNDIS, and others

config BR2_PACKAGE_SUMMIT_USBGADGET_DFU
	bool "Enable DFU support (SWUpdate backend)"
	default y
	depends on BR2_PACKAGE_SUMMIT_USBGADGET_USB
	depends on BR2_PACKAGE_SWUPDATE
	help
	  Support updates over USB connections (DFU). When enabled, the
	  service performs update from incoming DFU connections.
	  To perform an update, use the following example command:
	  sudo dfu-util -d <vendor_id>:<product_id> -D <swu file>

config BR2_PACKAGE_SUMMIT_USBGADGET_FASTBOOT_USB
	bool "Enable fastboot-usb support (SWUpdate backend)"
	default y
	depends on BR2_PACKAGE_SUMMIT_USBGADGET_USB
	depends on BR2_PACKAGE_SWUPDATE
	help
	  Support updates over USB connections (fastboot). When enabled, the
	  service performs update from incoming Android fastboot or 
	  NXP uuu FBK (fastboot for kernel) connections.
	  To perform an update, use the following example command:
	  fastboot -i <vendor_id> -p <product_id> update <partition> <swu file>

config BR2_PACKAGE_SUMMIT_USBGADGET_FASTBOOT_TCP
	bool "Enable fastboot-tcp support (SWUpdate backend)"
	default y
	depends on BR2_PACKAGE_SWUPDATE
	help
	  Support updates over TCP using fastboot TCP protocol v1 (default
	  port 5554). When enabled, the service performs update from incoming
	  fastboot TCP connections.
	  To perform an update, use the following example command:
	  fastboot -s tcp:<receiver_ip> update <partition> <swu file>

config BR2_PACKAGE_SUMMIT_USBGADGET_SOCKET
	bool "Enable socket update support (SWUpdate backend)"
	default y
	depends on BR2_PACKAGE_SWUPDATE
	help
	  Support updates over TCP connections (default port 9000). When 
	  enabled, performs update from incoming network connection.
	  To perform an update, use the following example command:
	  nc -N <RECEIVER_IP> <PORT> < <swu file>

config BR2_PACKAGE_SUMMIT_USBGADGET_SOCKET_TLS
	bool "Enable TLS for socket update"
	depends on BR2_PACKAGE_SUMMIT_USBGADGET_SOCKET
	depends on BR2_PACKAGE_OPENSSL
	help
	  Support updates over TLS connections (default port 9000). When 
	  enabled, performs update from incoming network connection.
	  To perform an update, use the following example command:
	  ncat -nv <RECEIVER_IP> <PORT> --ssl <swu file>
	  openssl s_client -connect <RECEIVER_IP>:<PORT> -quiet < <swu file>

config BR2_PACKAGE_SUMMIT_USBGADGET_SWUPDATE
	bool
	default y
	depends on BR2_PACKAGE_SUMMIT_USBGADGET_DFU ||\
		BR2_PACKAGE_SUMMIT_USBGADGET_FASTBOOT_USB ||\
		BR2_PACKAGE_SUMMIT_USBGADGET_FASTBOOT_TCP ||\
		BR2_PACKAGE_SUMMIT_USBGADGET_SOCKET

endif
```

## package/summit-userspace-examples/Config.in
```kconfig
config BR2_PACKAGE_SUMMIT_USERSPACE_EXAMPLES
	bool "Summit Userspace Examples"
	help
	  Summit userspace examples for som products.

if BR2_PACKAGE_SUMMIT_USERSPACE_EXAMPLES

config BR2_PACKAGE_SUMMIT_USERSPACE_NETWORKMANAGER_EXAMPLES
	bool "Build networkmanager examples"
	select BR2_PACKAGE_SUMMIT_NETWORK_MANAGER

config BR2_PACKAGE_SUMMIT_USERSPACE_NETLINK_EXAMPLES
	bool "Build netlink examples"
	select BR2_PACKAGE_LIBNL

endif
```

## package/summit-wifi-bridge/Config.in
```kconfig
config BR2_PACKAGE_SUMMIT_WIFI_BRIDGE
	bool "lrd wifi bridge setup"
	depends on BR2_PACKAGE_SUMMIT_NETWORK_MANAGER 
	select BR2_PACKAGE_EBTABLES
	help
		scripts required to establish a wifi bridge

if BR2_PACKAGE_SUMMIT_WIFI_BRIDGE

config BR2_PACKAGE_SUMMIT_WIFI_BRIDGE_INTERFACE
	string "bridged interface"
	default "eth0"
	help
		This is the interface that will be bridged over wlan0
		examples: eth0, eth1, usb0, ppp0, ...

endif
```

## package/web_lcm_gatwick/Config.in
```kconfig
config BR2_PACKAGE_WEB_LCM_GATWICK
	bool "Web LCM Gatwick"
	select BR2_PACKAGE_LIBOPENSSL_BIN
	help
	  Summit webapp to configure LoRa gateway
	    http://www.ezurio.com

if BR2_PACKAGE_WEB_LCM_GATWICK

config BR2_WEB_LCM_GATWICK_OPTIMIZE_AUTOLOADER
    bool "Optimize PHP autoloader"
    default y
    help
      If the php backend should allow composer to optimise the autoloader
      into a classmap.

config BR2_WEB_LCM_GATWICK_SOURCEMAP
    bool "Include Angular sourcemap"
    default n
    help
      Include source maps generated from Angular in the final image, this
      helps with in browser debugging.

config BR2_WEB_LCM_GATWICK_AOT
    bool "Use Angular AOT compilation"
    default y
    help
      Allow AOT to run when compiling the Angular front end, this reduces
      on the fly page generation but may produce build errors.

endif
```

## package/weblcm-legacy/Config.in
```kconfig
config BR2_PACKAGE_WEBLCM_LEGACY
	bool "weblcm-legacy"
	select BR2_PACKAGE_PHP_SDK
	select BR2_PACKAGE_LIGHTTPD
	select BR2_PACKAGE_LIGHTTPD_OPENSSL
	select BR2_PACKAGE_LIGHTTPD_PCRE
	select BR2_PACKAGE_ZLIB
	help
	  Summit Legacy Web configuration utility based on sdcsdk
```

## package/weston-init/Config.in
```kconfig
config BR2_PACKAGE_WESTON_INIT
	bool "weston-init"
	depends on BR2_PACKAGE_WESTON
	help
	  Startup script and systemd unit files for the Weston Wayland
	  compositor. Installs a SysV init script, systemd service and
	  socket units, a default weston.ini configuration, and the
	  weston-start helper script.

	  https://wayland.freedesktop.org/

if BR2_PACKAGE_WESTON_INIT

config BR2_PACKAGE_WESTON_INIT_AUTOLOGIN
	bool "PAM autologin support"
	select BR2_PACKAGE_LINUX_PAM 
	select BR2_PACKAGE_SEATD
	select BR2_PACKAGE_SEATD_DAEMON
	help
	  Install the weston-autologin PAM configuration to
	  /etc/pam.d/weston-autologin. Required for automatic login
	  via the systemd weston.socket service.

endif
```

## toolchain/toolchain-external-summit-arm/Config.in
```kconfig
config BR2_TOOLCHAIN_EXTERNAL_SUMMIT_ARM
	bool "Summit ARM Toolchain"
	depends on BR2_arm || BR2_aarch64
	depends on BR2_ARM_CPU_ARMV7A || BR2_ARM_CPU_ARMV8A || BR2_ARM_CPU_ARMV6 || BR2_ARM_CPU_ARMV5 || BR2_ARM_CPU_ARMV4 || BR2_aarch64
	depends on BR2_HOSTARCH = "x86_64"
	select BR2_TOOLCHAIN_EXTERNAL_GLIBC
	select BR2_TOOLCHAIN_HAS_SSP
	select BR2_INSTALL_LIBSTDCPP
	help
	  Summit toolchain for the ARM architecture.

if BR2_TOOLCHAIN_EXTERNAL_SUMMIT_ARM

choice
	prompt "Toolchain Version"
	default BR2_TOOLCHAIN_EXTERNAL_SUMMIT_ARM_12
	help
	  Select the version of the toolchain you wish to use.

config BR2_TOOLCHAIN_EXTERNAL_SUMMIT_ARM_12
	bool "Summit 12.x (2024.02) toolchain"
	select BR2_TOOLCHAIN_HEADERS_AT_LEAST_6_6
	select BR2_TOOLCHAIN_GCC_AT_LEAST_13
	select BR2_TOOLCHAIN_HAS_OPENMP
	help
	  GCC 13.3.0, GDB 14.2.0, glibc-2.38+, headers-6.6.0, binutils 2.41

endchoice

config BR2_TOOLCHAIN_EXTERNAL_SUMMIT_ARM_ID
	string
	default summit

config BR2_TOOLCHAIN_EXTERNAL_SUMMIT_ARM_VERSION
	string
	default 12.0.0.59 if BR2_TOOLCHAIN_EXTERNAL_SUMMIT_ARM_12

endif
```

## package/dcal/Config.in
```kconfig
config BR2_PACKAGE_DCAL
	bool "DCAL"
	select BR2_PACKAGE_FLATCC
	select BR2_PACKAGE_LIBSSH
	help
	  DCAL is Laird's Device Client API Library. It is a open-sourced project
	  for customers to compile on their host, which produces a library that they
	  can then use to control one or more WB devices.

if BR2_PACKAGE_DCAL
config BR2_PACKAGE_DCAL_TEST_APPS
	bool "DCAL example apps"
	help
	  Build and install DCAL example apps on target.
endif
```

## package/fswatch/Config.in
```kconfig
config BR2_PACKAGE_FSWATCH
	bool "fswatch"
	select BR2_PACKAGE_INOTIFY_TOOLS
	help
	  File system write monitor
```

## package/ggv2support/Config.in
```kconfig
config BR2_PACKAGE_GGV2SUPPORT
	bool "ggv2support"
	depends on BR2_PACKAGE_SYSTEMD
	help
	  Summit Greengrass V2 Support
```

## package/ig-tty-utils/Config.in
```kconfig
config BR2_PACKAGE_IG_TTY_UTILS
	bool "IG60 TTY Utilities"
	help
	  Utilities to enable serial getty processes on USB and serial
	depends on BR2_PACKAGE_SYSTEMD
```

## package/lrd-br/Config.in
```kconfig
source "$BR2_EXTERNAL_LRD_SOM_PATH/package/lrd-br/bluez4_utils/Config.in"
source "$BR2_EXTERNAL_LRD_SOM_PATH/package/lrd-br/firewalld/Config.in"
source "$BR2_EXTERNAL_LRD_SOM_PATH/package/lrd-br/fscryptctl_1/Config.in"
source "$BR2_EXTERNAL_LRD_SOM_PATH/package/lrd-br/gattlib/Config.in"
source "$BR2_EXTERNAL_LRD_SOM_PATH/package/lrd-br/lrd-linux-backports/Config.in"
source "$BR2_EXTERNAL_LRD_SOM_PATH/package/lrd-br/lrd-brcm-patchram-plus/Config.in"
source "$BR2_EXTERNAL_LRD_SOM_PATH/package/lrd-br/microxml/Config.in"
source "$BR2_EXTERNAL_LRD_SOM_PATH/package/lrd-br/minehunt/Config.in"
source "$BR2_EXTERNAL_LRD_SOM_PATH/package/lrd-br/nbnsd/Config.in"
source "$BR2_EXTERNAL_LRD_SOM_PATH/package/lrd-br/node-ssl-shim/Config.in"
source "$BR2_EXTERNAL_LRD_SOM_PATH/package/lrd-br/python-gatt/Config.in"
source "$BR2_EXTERNAL_LRD_SOM_PATH/package/lrd-br/python-httptools/Config.in"
source "$BR2_EXTERNAL_LRD_SOM_PATH/package/lrd-br/python-transitions/Config.in"
source "$BR2_EXTERNAL_LRD_SOM_PATH/package/lrd-br/python-libconf/Config.in"
source "$BR2_EXTERNAL_LRD_SOM_PATH/package/lrd-br/qt5quick1d/Config.in"
source "$BR2_EXTERNAL_LRD_SOM_PATH/package/lrd-br/wifi-test-suite/Config.in"
source "$BR2_EXTERNAL_LRD_SOM_PATH/package/lrd-br/python-awscrt/Config.in"
source "$BR2_EXTERNAL_LRD_SOM_PATH/package/lrd-br/python-awsiotsdk/Config.in"
```

## package/lrd-br/Config.in.host
```kconfig
source "$BR2_EXTERNAL_LRD_SOM_PATH/package/lrd-br/backports/Config.in.host"
source "$BR2_EXTERNAL_LRD_SOM_PATH/package/lrd-br/backports-test/Config.in.host"
source "$BR2_EXTERNAL_LRD_SOM_PATH/package/lrd-br/composer/Config.in.host"
source "$BR2_EXTERNAL_LRD_SOM_PATH/package/lrd-br/fscryptctl_1/Config.in.host"
```

## package/lrd-br/fscryptctl_1/Config.in.host
```kconfig
config BR2_PACKAGE_HOST_FSCRYPTCTL_1
        bool "host fscryptctl v1"
        help
          host fscryptctl v1
```

## package/lrd-br/lrd-brcm-patchram-plus/Config.in
```kconfig
config BR2_PACKAGE_LRD_BRCM_PATCHRAM_PLUS
	bool "lrd-brcm-patchram-plus"
	depends on BR2_PACKAGE_BLUEZ5_UTILS || BR2_PACKAGE_BLUEZ4_UTILS
	help
	  Broadcom utility to flash Bluetooth firmwares, extended with
	  per-device Low Power Mode configuration.
```

## package/lrd-br/lrd-linux-backports/Config.in
```kconfig
comment "linux-backports needs a Linux kernel to be built"
	depends on !BR2_LINUX_KERNEL

config BR2_PACKAGE_LRD_LINUX_BACKPORTS
	bool "lrd-linux-backports"
	depends on BR2_LINUX_KERNEL
	help
	  The linux-backports package includes many Linux drivers from
	  recent kernels, backported to older ones.

if BR2_PACKAGE_LRD_LINUX_BACKPORTS

choice
	prompt "Linux kernel driver backports configuration"
	default BR2_PACKAGE_LRD_LINUX_BACKPORTS_USE_DEFCONFIG

config BR2_PACKAGE_LRD_LINUX_BACKPORTS_USE_DEFCONFIG
	bool "Using an in-tree defconfig file"

config BR2_PACKAGE_LRD_LINUX_BACKPORTS_USE_CUSTOM_CONFIG
	bool "Using a custom (def)config file"

endchoice

config BR2_PACKAGE_LRD_LINUX_BACKPORTS_DEFCONFIG
	string "Backports defconfig name"
	default "som60_nbt_fips" if (BR2_LRD_SOM60_RADIO || BR2_LRD_SOM60_RADIO_MANUAL) && (BR2_LRD_FIPS_RADIO || BR2_LRD_FIPS_RADIO_11) && !BR2_PACKAGE_BLUEZ5_UTILS
	default "som60_fips" if (BR2_LRD_SOM60_RADIO || BR2_LRD_SOM60_RADIO_MANUAL) && (BR2_LRD_FIPS_RADIO || BR2_LRD_FIPS_RADIO_11)
	default "som60_nbt" if (BR2_LRD_SOM60_RADIO || BR2_LRD_SOM60_RADIO_MANUAL) && !BR2_PACKAGE_BLUEZ5_UTILS
	default "som60" if BR2_LRD_SOM60_RADIO || BR2_LRD_SOM60_RADIO_MANUAL
	default "wb50n_nbt_fips" if BR2_LRD_WB50N_RADIO && (BR2_LRD_FIPS_RADIO || BR2_LRD_FIPS_RADIO_11) && !BR2_PACKAGE_BLUEZ5_UTILS
	default "wb50n_fips" if BR2_LRD_WB50N_RADIO && (BR2_LRD_FIPS_RADIO || BR2_LRD_FIPS_RADIO_11)
	default "wb50n_nbt" if BR2_LRD_WB50N_RADIO && !BR2_PACKAGE_BLUEZ5_UTILS
	default "wb50n" if BR2_LRD_WB50N_RADIO
	default "wb45n_nbt_fips" if BR2_LRD_WB45N_LEGACY_RADIO && (BR2_LRD_FIPS_RADIO || BR2_LRD_FIPS_RADIO_11) && !BR2_PACKAGE_BLUEZ5_UTILS
	default "wb45n_fips" if BR2_LRD_WB45N_LEGACY_RADIO && (BR2_LRD_FIPS_RADIO || BR2_LRD_FIPS_RADIO_11)
	default "wb45n_nbt" if BR2_LRD_WB45N_LEGACY_RADIO && !BR2_PACKAGE_BLUEZ5_UTILS
	default "wb45n" if BR2_LRD_WB45N_LEGACY_RADIO
	depends on BR2_PACKAGE_LRD_LINUX_BACKPORTS_USE_DEFCONFIG
	help
	  Name of the backports defconfig file to use, without the
	  leading defconfig-. The defconfig is located in defconfigs/
	  directory in the backports tree.

config BR2_PACKAGE_LRD_LINUX_BACKPORTS_CUSTOM_CONFIG_FILE
	string "Configuration file path"
	depends on BR2_PACKAGE_LRD_LINUX_BACKPORTS_USE_CUSTOM_CONFIG
	help
	  Path to the backports configuration file

	  Note: this can be a defconfig file or a complete .config
	  file, which can later be saved back with make
	  linux-update-(def)config.

config BR2_PACKAGE_LRD_LINUX_BACKPORTS_CONFIG_FRAGMENT_FILES
	string "Additional configuration fragment files"
	help
	  A space-separated list of configuration fragment files, that
	  will be merged to the main linux-backports configuration file.

endif # BR2_PACKAGE_LRD_LINUX_BACKPORTS
```

## package/lrd-br/nbnsd/Config.in
```kconfig
config BR2_PACKAGE_NBNSD
	bool "nbnsd"
	help
	  A free and minimal NetBIOS Name Service responder daemon
```

## package/lrd-br/nginx-unit/Config.in
```kconfig
config BR2_PACKAGE_NGINX_UNIT
	bool "nginx-unit"
	depends on BR2_TOOLCHAIN_HAS_SYNC_4
	help
	  NGINX Unit – universal web app server – a lightweight and versatile
	  open source server project that works as a reverse proxy, serves
	  static assets, and runs applications in multiple languages.

	  https://unit.nginx.org/

if BR2_PACKAGE_NGINX_UNIT

config BR2_PACKAGE_NGINX_UNIT_PYTHON_APP
	bool "Python application support"
	select BR2_PACKAGE_PYTHON3

endif
```

## package/lrd-br/python-spectree/Config.in
```kconfig
config BR2_PACKAGE_PYTHON_SPECTREE
	bool "python-spectree"
	select BR2_PACKAGE_PYTHON_PYDANTIC # runtime
	help
	  generate OpenAPI document and validate request&response
	  with Python annotations.

	  https://github.com/0b01001001/spectree
```

## package/lrd-br/python-statemachine/Config.in
```kconfig
config BR2_PACKAGE_PYTHON_STATEMACHINE
	bool "python-statemachine"
	help
	  Python Finite State Machines made easy.

	  https://github.com/fgmacedo/python-statemachine
```

## package/lrd-br/python-transitions/Config.in
```kconfig
config BR2_PACKAGE_PYTHON_TRANSITIONS
	bool "python-transitions"
	select BR2_PACKAGE_PYTHON_SIX # runtime
	help
	  A lightweight, object-oriented Python state machine
	  implementation with many extensions.

	  http://github.com/pytransitions/transitions
```

## package/lrd-br/python-uvicorn/Config.in
```kconfig
config BR2_PACKAGE_PYTHON_UVICORN
	bool "python-uvicorn"
	select BR2_PACKAGE_PYTHON_HTTPTOOLS # runtime
	select BR2_PACKAGE_PYTHON_CLICK # runtime
	select BR2_PACKAGE_PYTHON3_ZLIB # runtime
	help
	  Uvicorn is an ASGI web server implementation for Python.

	  https://www.uvicorn.org/
```

## package/lrd/Config.in
```kconfig
source "$BR2_EXTERNAL_LRD_SOM_PATH/package/lrd/lrd-wireless-regdb/Config.in"
source "$BR2_EXTERNAL_LRD_SOM_PATH/package/lrd/fipscheck/Config.in"
source "$BR2_EXTERNAL_LRD_SOM_PATH/package/lrd/mc-mint/Config.in"
source "$BR2_EXTERNAL_LRD_SOM_PATH/package/lrd/eventmon/Config.in"
source "$BR2_EXTERNAL_LRD_SOM_PATH/package/lrd/fswatch/Config.in"
source "$BR2_EXTERNAL_LRD_SOM_PATH/package/lrd/php_sdk/Config.in"
source "$BR2_EXTERNAL_LRD_SOM_PATH/package/lrd/weblcm-python/Config.in"
source "$BR2_EXTERNAL_LRD_SOM_PATH/package/lrd/dcal/Config.in"
source "$BR2_EXTERNAL_LRD_SOM_PATH/package/lrd/dcas/Config.in"
source "$BR2_EXTERNAL_LRD_SOM_PATH/package/lrd/libloragw/Config.in"
source "$BR2_EXTERNAL_LRD_SOM_PATH/package/lrd/lrd-network-manager/Config.in"
source "$BR2_EXTERNAL_LRD_SOM_PATH/package/lrd/lora-packet-forwarder/Config.in"
source "$BR2_EXTERNAL_LRD_SOM_PATH/package/lrd/lrd-legacy/Config.in"
source "$BR2_EXTERNAL_LRD_SOM_PATH/package/lrd/ttn-forwarder/Config.in"
source "$BR2_EXTERNAL_LRD_SOM_PATH/package/lrd/lora-gateway-bridge/Config.in"
source "$BR2_EXTERNAL_LRD_SOM_PATH/package/lrd/demo-gui/Config.in"
source "$BR2_EXTERNAL_LRD_SOM_PATH/package/lrd/easycwmp/Config.in"
source "$BR2_EXTERNAL_LRD_SOM_PATH/package/lrd/lrd-automount/Config.in"
source "$BR2_EXTERNAL_LRD_SOM_PATH/package/lrd/lrd-usbgadget/Config.in"
source "$BR2_EXTERNAL_LRD_SOM_PATH/package/lrd/lrd-encrypted-storage-toolkit/Config.in"
source "$BR2_EXTERNAL_LRD_SOM_PATH/package/lrd/igconfd/Config.in"
source "$BR2_EXTERNAL_LRD_SOM_PATH/package/lrd/igprovd/Config.in"
source "$BR2_EXTERNAL_LRD_SOM_PATH/package/lrd/lrd-bt-utils/Config.in"
source "$BR2_EXTERNAL_LRD_SOM_PATH/package/lrd/lrd-userspace-examples/Config.in"
source "$BR2_EXTERNAL_LRD_SOM_PATH/package/lrd/sdcsdk_nm/Config.in"
source "$BR2_EXTERNAL_LRD_SOM_PATH/package/lrd/lrd-swupdate-client/Config.in"
source "$BR2_EXTERNAL_LRD_SOM_PATH/package/lrd/ig-tty-utils/Config.in"
source "$BR2_EXTERNAL_LRD_SOM_PATH/package/lrd/lrd-fips-utils/Config.in"
source "$BR2_EXTERNAL_LRD_SOM_PATH/package/lrd/lrd-wifi-bridge/Config.in"
source "$BR2_EXTERNAL_LRD_SOM_PATH/package/lrd/echotest/Config.in"
source "$BR2_EXTERNAL_LRD_SOM_PATH/package/lrd/summit-firewall/Config.in"
source "$BR2_EXTERNAL_LRD_SOM_PATH/package/lrd/summit-rcm/Config.in"
source "$BR2_EXTERNAL_LRD_SOM_PATH/package/lrd/summit-rcm-awm-plugin/Config.in"
source "$BR2_EXTERNAL_LRD_SOM_PATH/package/lrd/summit-rcm-bluetooth-plugin/Config.in"
source "$BR2_EXTERNAL_LRD_SOM_PATH/package/lrd/summit-rcm-certificate-provisioning-plugin/Config.in"
source "$BR2_EXTERNAL_LRD_SOM_PATH/package/lrd/summit-rcm-chrony-plugin/Config.in"
source "$BR2_EXTERNAL_LRD_SOM_PATH/package/lrd/summit-rcm-firewall-plugin/Config.in"
source "$BR2_EXTERNAL_LRD_SOM_PATH/package/lrd/summit-rcm-log-forwarding-plugin/Config.in"
source "$BR2_EXTERNAL_LRD_SOM_PATH/package/lrd/summit-rcm-radio-siso-mode-plugin/Config.in"
source "$BR2_EXTERNAL_LRD_SOM_PATH/package/lrd/summit-rcm-stunnel-plugin/Config.in"
source "$BR2_EXTERNAL_LRD_SOM_PATH/package/lrd/summit-rcm-unauthenticated-plugin/Config.in"
source "$BR2_EXTERNAL_LRD_SOM_PATH/package/lrd/sdcsupp/Config.in"
source "$BR2_EXTERNAL_LRD_SOM_PATH/package/lrd/summit-hostapd/Config.in"
source "$BR2_EXTERNAL_LRD_SOM_PATH/package/lrd/lrd-disable-console-login/Config.in"
source "$BR2_EXTERNAL_LRD_SOM_PATH/package/lrd/summit-edgeiq/Config.in"
source "$BR2_EXTERNAL_LRD_SOM_PATH/package/lrd/ggv2support/Config.in"
source "$BR2_EXTERNAL_LRD_SOM_PATH/package/lrd/summitssl_fips_provider/Config.in"

if BR2_LRD_NO_RADIO
source "$BR2_EXTERNAL_LRD_SOM_PATH/package/lrd/lrd-radio/adaptive_bt/Config.in"
endif
```

## package/lrd/echotest/Config.in
```kconfig
config BR2_PACKAGE_ECHOTEST
	bool "Serial Echo Test utility"
	select BR2_PACKAGE_PYTHON3
	select BR2_PACKAGE_PYTHON_SERIAL
	help
	  Laird Connectivity Serial Echo Test utility
```

## package/lrd/fipscheck/Config.in
```kconfig
config BR2_PACKAGE_FIPSCHECK
	bool "fipscheck"
	select BR2_PACKAGE_OPENSSL
	help
	  FIPS Integrity Checker

config BR2_PACKAGE_HOST_FIPSCHECK
	bool "host fipscheck"
	help
	  FIPS Integrity Checker
```

## package/lrd/ggv2support/Config.in
```kconfig
config BR2_PACKAGE_GGV2SUPPORT
	bool "ggv2support"
	depends on BR2_PACKAGE_SYSTEMD
	select BR2_PACKAGE_LRD_ENCRYPTED_STORAGE_TOOLKIT
	help
	  Summit Greengrass V2 Support
```

## package/lrd/igprovd/Config.in
```kconfig
config BR2_PACKAGE_IGPROVD
	bool "igprovd"
	select BR2_PACKAGE_PYTHON3
	select BR2_PACKAGE_GOBJECT_INTROSPECTION
	select BR2_PACKAGE_PYTHON_GOBJECT
	select BR2_PACKAGE_PYTHON_SYSTEMD
	select BR2_PACKAGE_DBUS_PYTHON
	select BR2_PACKAGE_PYTHON_REQUESTS
	help
	  Laird IG Provisioning Service
```

## package/lrd/laird_openssl_fips-binaries/Config.in
```kconfig
if BR2_PACKAGE_LAIRD_OPENSSL_FIPS_BINARIES

config BR2_PACKAGE_PROVIDES_OPENSSL
	default "laird_openssl_fips-binaries"

config BR2_PACKAGE_LAIRD_OPENSSL_3_0_FIPS_BINARIES
	bool "Use Laird openssl-3.0 fips binaries"
	help
		This is Laird openssl FIPS binaries (3.0.x).

config BR2_PACKAGE_LAIRD_OPENSSL_FIPS_BINARIES_VERSION_VALUE
	string
	default "0.10.0.0" if BR2_PACKAGE_LAIRD_OPENSSL_3_0_FIPS_BINARIES
	default "7.0.0.713"

config BR2_PACKAGE_LIBOPENSSL_BIN
	bool "openssl binary"
	help
	  Install the openssl binary and the associated helper scripts
	  to the target file system. This is a command line tool for
	  doing various cryptographic stuff.

comment "Below options only present to satisfy buildroot dependencies"

config BR2_PACKAGE_LIBOPENSSL_ENGINES
	bool "openssl additional engines"
	help
	  Install additional encryption engine libraries.

config BR2_PACKAGE_LIBOPENSSL_ENABLE_CHACHA
	bool "enable CHACHA"
	default y

config BR2_PACKAGE_LIBOPENSSL_ENABLE_RC2
	bool "enable RC2"
	default y

config BR2_PACKAGE_LIBOPENSSL_ENABLE_RC4
	bool "enable RC4"
	default y

config BR2_PACKAGE_LIBOPENSSL_ENABLE_MD2
	bool "enable MD2"
	default n

config BR2_PACKAGE_LIBOPENSSL_ENABLE_MD4
	bool "enable MD4"
	default y

config BR2_PACKAGE_LIBOPENSSL_ENABLE_MDC2
	bool "enable MDC2"
	default y

config BR2_PACKAGE_LIBOPENSSL_ENABLE_BLAKE2
	bool "enable BLAKE2"
	default y

config BR2_PACKAGE_LIBOPENSSL_ENABLE_IDEA
	bool "enable IDEA"
	default n

config BR2_PACKAGE_LIBOPENSSL_ENABLE_SEED
	bool "enable SEED"
	default n

config BR2_PACKAGE_LIBOPENSSL_ENABLE_DES
	bool "enable DES"
	default y

config BR2_PACKAGE_LIBOPENSSL_ENABLE_RMD160
	bool "enable RMD160"
	default n

config BR2_PACKAGE_LIBOPENSSL_ENABLE_WHIRLPOOL
	bool "enable WHIRLPOOL"
	default n

config BR2_PACKAGE_LIBOPENSSL_ENABLE_BLOWFISH
	bool "enable BLOWFISH"
	default n

config BR2_PACKAGE_LIBOPENSSL_ENABLE_SSL
	bool "enable SSL"
	default y

config BR2_PACKAGE_LIBOPENSSL_ENABLE_SSL2
	bool "enable SSL2"
	default n

config BR2_PACKAGE_LIBOPENSSL_ENABLE_SSL3
	bool "enable SSL3"
	default n

config BR2_PACKAGE_LIBOPENSSL_ENABLE_WEAK_SSL
	bool "enable WEAK_SSL"
	default n

config BR2_PACKAGE_LIBOPENSSL_ENABLE_PSK
	bool "enable mode PSK"
	default y

config BR2_PACKAGE_LIBOPENSSL_ENABLE_CAST
	bool "enable mode CAST"
	default n

config BR2_PACKAGE_LIBOPENSSL_UNSECURE
	bool "enable unit test, debug, backtrace"
	default n
	help
	  Enable unit-test crypto-mdebug-backtrace
	  crypto-mdebug autoerrinit mode.

config BR2_PACKAGE_LIBOPENSSL_DYNAMIC_ENGINE
	bool "enable dynamic engine"
	default y

config BR2_PACKAGE_LIBOPENSSL_ENABLE_COMP
	bool "enable compression"
	default n
	select BR2_PACKAGE_ZLIB

config BR2_PACKAGE_LIBOPENSSL_ENABLE_KTLS
	bool "enable ktls provider"
	default y

config BR2_PACKAGE_LIBOPENSSL_ENABLE_FIPS
	bool "enable fips provider"
	default n

endif # BR2_PACKAGE_LAIRD_OPENSSL_FIPS_BINARIES
```

## package/lrd/lrd-automount/Config.in
```kconfig
menuconfig BR2_PACKAGE_LRD_AUTOMOUNT
	bool "lrd-automount"
	help
	  Laird USB Automount

if BR2_PACKAGE_LRD_AUTOMOUNT
config BR2_PACKAGE_LRD_AUTOMOUNT_USB
	bool "USB Drive Automount"
	default y

config BR2_PACKAGE_LRD_AUTOMOUNT_USB_USER
	string "User to own mounted USB drive"
	depends on BR2_PACKAGE_LRD_AUTOMOUNT_USB

config BR2_PACKAGE_LRD_AUTOMOUNT_MMC
	bool "SD Card Automount"
	default y

config BR2_PACKAGE_LRD_AUTOMOUNT_MMC_USER
	string "User to own mounted MMC drive"
	depends on BR2_PACKAGE_LRD_AUTOMOUNT_MMC

config BR2_PACKAGE_LRD_AUTOMOUNT_EXTRA
	string "Services to start on mount"

endif
```

## package/lrd/lrd-bt-utils/Config.in
```kconfig
config BR2_PACKAGE_LRD_BT_UTILS
	bool "lrd-bt-utils"
	select BR2_PACKAGE_PYTHON3
	help
	  Utilities to support bluetooth device programming and operations
```

## package/lrd/lrd-disable-console-login/Config.in
```kconfig
config BR2_PACKAGE_LRD_DISABLE_CONSOLE_LOGIN
	bool "Disable Console Login"
	help
	  Utilities to disable serial getty
```

## package/lrd/lrd-encrypted-storage-toolkit/Config.in
```kconfig
config BR2_PACKAGE_LRD_ENCRYPTED_STORAGE_TOOLKIT
	bool "lrd encrypted storage toolkit"
	select BR2_SUMMIT_SECURE_BOOT
	select BR2_PACKAGE_KEYUTILS
	select BR2_PACKAGE_HOST_CRYPTSETUP
	select BR2_PACKAGE_FSCRYPTCTL
	select BR2_PACKAGE_HOST_FSCRYPTCTL
	help
	  Toolkit for implementing Laird's U-Boot encryption
	  with Linux per directory encryption. This is part of
	  Laird's Chain of Trust architecture.
```

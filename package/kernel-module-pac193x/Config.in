## package/kernel-module-pac193x/Config.in
```kconfig
comment "kernel-module-pac193x.mk needs a Linux kernel to be built"
	depends on !BR2_LINUX_KERNEL

config BR2_PACKAGE_KERNEL_MODULE_PAC193X
	bool "kernel-module-pac193x"
	depends on BR2_LINUX_KERNEL
	help
	  Microchip PAC193x Driver for Microchip pac1934/2/1 chip family of energy monitors (ADC)
```

## package/lontium-firmware/Config.in
```kconfig
config BR2_PACKAGE_LONTIUM_FIRMWARE
	bool "Lontium bridge firmware"
	help
	  Firmware files for Lontium LT2611UXD/UXE and LT9611C/UXD
	  display bridge devices.
```

## package/lrd/lrd-radio/Config.in
```kconfig
choice
	prompt "Radio Stack"

	config BR2_LRD_NO_RADIO
		bool "None"

	config BR2_LRD_SOM60_RADIO
		bool "SOM60 Radio"
		select BR2_PACKAGE_SOM60_FIRMWARE_BINARIES
		select BR2_PACKAGE_SDCSUPP
		select BR2_PACKAGE_SDCSUPP_WPA_CLI
		select BR2_PACKAGE_SDCSUPP_WPA_PASSPHRASE
		select BR2_PACKAGE_LRD_LINUX_BACKPORTS
		select BR2_PACKAGE_ADAPTIVE_WW_BINARIES
		select BR2_PACKAGE_LRD_NETWORK_MANAGER
		select BR2_PACKAGE_ADAPTIVE_BT if BR2_PACKAGE_BLUEZ5_UTILS || BR2_PACKAGE_BLUEZ4_UTILS

	config BR2_LRD_SOM60_RADIO_MANUAL
		bool "SOM60 Radio Manual"
		select BR2_PACKAGE_SOM60_FIRMWARE_BINARIES
		select BR2_PACKAGE_LRD_LINUX_BACKPORTS

	config BR2_LRD_WB50N_SYSD_RADIO
		bool "WB50N SYSD Radio"
		select BR2_PACKAGE_WB50N_FIRMWARE_BINARIES
		select BR2_PACKAGE_SDCSUPP
		select BR2_PACKAGE_SDCSUPP_WPA_CLI
		select BR2_PACKAGE_SDCSUPP_WPA_PASSPHRASE
		select BR2_PACKAGE_LRD_LINUX_BACKPORTS
		select BR2_PACKAGE_LRD_NETWORK_MANAGER

	config BR2_LRD_WB50N_LEGACY_RADIO
		bool "WB50N Legacy Radio"
		select BR2_PACKAGE_WB50N_FIRMWARE_BINARIES
		select BR2_PACKAGE_SDCSUPP
		select BR2_PACKAGE_LRD_LINUX_BACKPORTS
		select BR2_PACKAGE_LRD_LEGACY

	config BR2_LRD_WB45N_LEGACY_RADIO
		bool "WB45N Radio"
		select BR2_PACKAGE_WB45N_FIRMWARE_BINARIES
		select BR2_PACKAGE_SDCSUPP
		select BR2_PACKAGE_LRD_LINUX_BACKPORTS
		select BR2_PACKAGE_LRD_LEGACY
endchoice

config BR2_LRD_WB50N_RADIO
	bool
	default y if BR2_LRD_WB50N_SYSD_RADIO || BR2_LRD_WB50N_LEGACY_RADIO

choice
	prompt "Use FIPS"
	default BR2_LRD_FIPS_RADIO
	optional

config BR2_LRD_FIPS_RADIO
	bool "Use FIPS 7.1"
	depends on !BR2_LRD_NO_RADIO
	select BR2_PACKAGE_OPENSSL
	select BR2_PACKAGE_SUMMITSSL_FIPS_BINARIES if !BR2_LRD_FIPS_RADIO_DEVEL
	select BR2_PACKAGE_LIBOPENSSL_1_0_2 if BR2_LRD_FIPS_RADIO_DEVEL
	select BR2_PACKAGE_OPENSSL_FIPS if BR2_LRD_FIPS_RADIO_DEVEL
	select BR2_PACKAGE_LRD_FIPS_UTILS
	select BR2_PACKAGE_FIPSCHECK
	select BR2_PACKAGE_HOST_FIPSCHECK
	select BR2_PACKAGE_SDCSUPP_FIPS
	select BR2_PACKAGE_UBOOT_TOOLS
	select BR2_PACKAGE_UBOOT_TOOLS_DUMPIMAGE
	select BR2_PACKAGE_UBOOT_TOOLS_FIT_SUPPORT
	select BR2_REPRODUCIBLE

config BR2_LRD_FIPS_RADIO_11
	bool "Use FIPS 11.0"
	depends on !BR2_LRD_NO_RADIO
	select BR2_PACKAGE_OPENSSL
	select BR2_PACKAGE_LIBOPENSSL_3_0
	select BR2_PACKAGE_SUMMITSSL_FIPS_PROVIDER if !BR2_LRD_FIPS_RADIO_DEVEL
	select BR2_PACKAGE_LIBOPENSSL_ENABLE_FIPS if BR2_LRD_FIPS_RADIO_DEVEL
	select BR2_PACKAGE_LRD_FIPS_UTILS
	select BR2_PACKAGE_FIPSCHECK if BR2_LRD_FIPS_RADIO_DEVEL
	select BR2_PACKAGE_HOST_FIPSCHECK
	select BR2_PACKAGE_SDCSUPP_FIPS
	select BR2_PACKAGE_UBOOT_TOOLS
	select BR2_PACKAGE_UBOOT_TOOLS_DUMPIMAGE
	select BR2_PACKAGE_UBOOT_TOOLS_FIT_SUPPORT
	select BR2_REPRODUCIBLE
endchoice

config BR2_LRD_FIPS_RADIO_DEVEL
	bool "FIPS devel"

comment "Please config openssl in Target packages->Libraries/Crypto/Openssl"
	depends on !BR2_LRD_NO_RADIO

comment "Please config linux-backports in Target packages->Hardware handling->linux-backports"
	depends on !BR2_LRD_NO_RADIO

comment "Please config lrd-network-manager in Laird->Packages->lrd-networkmanager"
	depends on !BR2_LRD_NO_RADIO
	depends on !BR2_LRD_WB50N_LEGACY_RADIO
	depends on !BR2_LRD_WB45N_LEGACY_RADIO

config BR2_PACKAGE_LRD_60_RADIO_STACK_VERSION_VALUE
	string "SOM60 radio stack version"
	depends on BR2_LRD_SOM60_RADIO || BR2_LRD_SOM60_RADIO_MANUAL
	default "11.236.0.17"
	help
	  Version number for radio packages.

config BR2_PACKAGE_LRD_50_RADIO_STACK_VERSION_VALUE
	string "MSD50 radio stack version"
	depends on BR2_LRD_WB50N_RADIO
	default "11.236.0.17"
	help
	  Version number for radio packages.

config BR2_PACKAGE_LRD_45_RADIO_STACK_VERSION_VALUE
	string "MSD45 radio stack version"
	depends on BR2_LRD_WB45N_LEGACY_RADIO
	default "11.236.0.17"
	help
	  Version number for radio packages.

config BR2_PACKAGE_LRD_RADIO_STACK_VERSION_VALUE
	string
	depends on !BR2_LRD_NO_RADIO
	default BR2_PACKAGE_LRD_60_RADIO_STACK_VERSION_VALUE if BR2_LRD_SOM60_RADIO || BR2_LRD_SOM60_RADIO_MANUAL
	default BR2_PACKAGE_LRD_50_RADIO_STACK_VERSION_VALUE if BR2_LRD_WB50N_RADIO
	default BR2_PACKAGE_LRD_45_RADIO_STACK_VERSION_VALUE if BR2_LRD_WB45N_LEGACY_RADIO

config BR2_PACKAGE_LRD_RADIO_STACK_ARCH
	string
	default "-arm-eabihf" if BR2_arm && BR2_ARM_EABIHF
	default "-arm-eabi" if BR2_arm && BR2_ARM_EABI
	default "-aarch64" if BR2_aarch64
	default "-powerpc64-e5500" if BR2_powerpc64
	default "-powerpc" if BR2_powerpc
	default "-x86" if BR2_i386
	default "-x86_64" if BR2_x86_64

if BR2_LRD_SOM60_RADIO || BR2_LRD_SOM60_RADIO_MANUAL
source "$BR2_EXTERNAL_LRD_SOM_PATH/package/lrd/lrd-radio/summit-supplicant-binaries/Config.in"
source "$BR2_EXTERNAL_LRD_SOM_PATH/package/lrd/lrd-radio/som60-firmware-binaries/Config.in"
source "$BR2_EXTERNAL_LRD_SOM_PATH/package/lrd/lrd-radio/adaptive_ww-binaries/Config.in"
source "$BR2_EXTERNAL_LRD_SOM_PATH/package/lrd/lrd-radio/mfg60n-binaries/Config.in"
source "$BR2_EXTERNAL_LRD_SOM_PATH/package/lrd/lrd-radio/adaptive_bt/Config.in"
endif

if BR2_LRD_WB50N_SYSD_RADIO
source "$BR2_EXTERNAL_LRD_SOM_PATH/package/lrd/lrd-radio/summit-supplicant-binaries/Config.in"
source "$BR2_EXTERNAL_LRD_SOM_PATH/package/lrd/lrd-radio/wb50n-firmware-binaries/Config.in"
source "$BR2_EXTERNAL_LRD_SOM_PATH/package/lrd/lrd-radio/reg50n-binaries/Config.in"
endif

if BR2_LRD_WB50N_LEGACY_RADIO
source "$BR2_EXTERNAL_LRD_SOM_PATH/package/lrd/lrd-radio/summit-supplicant-binaries/Config.in"
source "$BR2_EXTERNAL_LRD_SOM_PATH/package/lrd/lrd-radio/wb50n-firmware-binaries/Config.in"
source "$BR2_EXTERNAL_LRD_SOM_PATH/package/lrd/lrd-radio/reg50n-binaries/Config.in"
endif

if BR2_LRD_WB45N_LEGACY_RADIO
source "$BR2_EXTERNAL_LRD_SOM_PATH/package/lrd/lrd-radio/summit-supplicant-binaries/Config.in"
source "$BR2_EXTERNAL_LRD_SOM_PATH/package/lrd/lrd-radio/wb45n-firmware-binaries/Config.in"
source "$BR2_EXTERNAL_LRD_SOM_PATH/package/lrd/lrd-radio/reg45n-binaries/Config.in"
endif
```

## package/lrd/lrd-radio/mfg60n-binaries/Config.in
```kconfig
config BR2_PACKAGE_MFG60N_BINARIES
	bool "60 series manufacturing tools binaries"
	select BR2_PACKAGE_LIBNL
	select BR2_PACKAGE_LIBEDIT
	help
	  This package installs 60 series manufacturing tools.

if BR2_PACKAGE_MFG60N_BINARIES
config BR2_PACKAGE_MFG60N_BINARIES_LMU
	bool "60 series manufacturing tool (lmu)"
	default y
	help
	  This package installs 60 series lmu for use in setting the regulatory domain.

config BR2_PACKAGE_MFG60N_BINARIES_REGULATORY
	bool "60 series regulatory tools (lru, btlru)"
	default y
	help
	  This package installs 60 series lru and btlru for use in regulatory testing.

endif
```

## package/php_sdk/Config.in
```kconfig
config BR2_PACKAGE_PHP_SDK
	bool "Summit PHP SDK"
	depends on BR2_PACKAGE_SDCSDK || BR2_PACKAGE_SUMMIT_SUPPLICANT
	select BR2_PACKAGE_PHP
	select BR2_PACKAGE_PHP_EXT_JSON
	help
	  Summit SDK PHP library interface

if BR2_PACKAGE_PHP_SDK

config BR2_PACKAGE_PHP_SDK_TEST
	bool "Test PHP script"
	help
	  Install test PHP script to webserver on target.

endif
```

## package/summit-automount/Config.in
```kconfig
menuconfig BR2_PACKAGE_SUMMIT_AUTOMOUNT
	bool "Summit Auto-Mount"
	help
	  USB & MMC Automount

if BR2_PACKAGE_SUMMIT_AUTOMOUNT
config BR2_PACKAGE_SUMMIT_AUTOMOUNT_USB
	bool "USB Drive Automount"
	default y

config BR2_PACKAGE_SUMMIT_AUTOMOUNT_USB_USER
	string "User to own mounted USB drive"
	depends on BR2_PACKAGE_SUMMIT_AUTOMOUNT_USB

config BR2_PACKAGE_SUMMIT_AUTOMOUNT_MMC
	bool "SD Card Automount"
	default y

config BR2_PACKAGE_SUMMIT_AUTOMOUNT_MMC_USER
	string "User to own mounted MMC drive"
	depends on BR2_PACKAGE_SUMMIT_AUTOMOUNT_MMC

config BR2_PACKAGE_SUMMIT_AUTOMOUNT_EXTRA
	string "Services to start on mount"

endif
```

## package/summit-bt-utils/Config.in
```kconfig
config BR2_PACKAGE_SUMMIT_BT_UTILS
	bool "summit-bt-utils"
	select BR2_PACKAGE_PYTHON3
	select BR2_PACKAGE_PYTHON_SERIAL
	select BR2_PACKAGE_PYTHON_GPIOD
	select BR2_PACKAGE_DBUS_PYTHON
	help
	  Utilities to support bluetooth device programming and operations
```

## package/summit-camera-setup/Config.in
```kconfig
config BR2_PACKAGE_SUMMIT_CAMERA_SETUP
	bool "summit-camera-setup"
	depends on BR2_PACKAGE_LIBV4L
	help
	  Initial camera setup for DVKs boards
```

## package/summit-disable-console-login/Config.in
```kconfig
config BR2_PACKAGE_SUMMIT_DISABLE_CONSOLE_LOGIN
	bool "Disable Console Login"
	help
	  Utilities to disable serial getty
```

## package/summit-dmcrypt-image/Config.in
```kconfig
config BR2_PACKAGE_SUMMIT_DMCRYPT_IMAGE
	bool "summit-dmcrypt-image"
	select BR2_PACKAGE_OPENSSL
	help
	  Offline dm-crypt image creation tool (C, links against libcrypto).
	  Encrypts a binary image using AES-XTS-plain64 (or AES-CBC-ESSIV)
	  without requiring losetup, dmsetup, or root access.

config BR2_PACKAGE_HOST_SUMMIT_DMCRYPT_IMAGE
	bool "host summit-dmcrypt-image"
	help
	  Offline dm-crypt image creation tool (C, host variant).
	  Encrypts a binary image using AES-XTS-plain64 (or AES-CBC-ESSIV)
	  without requiring losetup, dmsetup, or root access.
```

## package/summit-encrypted-storage-toolkit/Config.in
```kconfig
config BR2_PACKAGE_SUMMIT_ENCRYPTED_STORAGE_TOOLKIT
	bool "Summit Encrypted Storage toolkit"
	select BR2_SUMMIT_SECURE_BOOT
	select BR2_PACKAGE_KEYUTILS
	select BR2_PACKAGE_HOST_CRYPTSETUP
	select BR2_PACKAGE_FSCRYPTCTL_1
	select BR2_PACKAGE_HOST_FSCRYPTCTL_1
	select BR2_PACKAGE_BLUEZ5_UTILS_SECURE_STORAGE if BR2_PACKAGE_BLUEZ5_UTILS
	help
	  Toolkit for implementing Secure Boot architecture and encription
	  This is part of Chain of Trust architecture.

if BR2_PACKAGE_SUMMIT_ENCRYPTED_STORAGE_TOOLKIT

config BR2_PACKAGE_SUMMIT_ENCRYPTED_STORAGE_TOOLKIT_EXEC_PERM
	bool "Allow exec on perm mount"

config BR2_PACKAGE_SUMMIT_ENCRYPTED_STORAGE_TOOLKIT_CREATE_RODATA
	bool "Create encrypted read-only data partition"
	default y

endif
```

## package/summit-fips-toolchain/Config.in.host
```kconfig
config BR2_PACKAGE_SUMMIT_FIPS_TOOLCHAIN_SUPPORTS
	bool
	default y if BR2_HOSTARCH = "x86_64"

config BR2_SUMMIT_FIPS_TOOLCHAIN_PREFIX
	string
	default "som60" if BR2_ARM_EABIHF
	default "wb4x" if BR2_ARM_EABI
```

## package/summit-fips-utils/Config.in
```kconfig
config BR2_PACKAGE_SUMMIT_FIPS_UTILS
	bool "Summit FIPS utils"
	help
	  Summit FIPS utility script
```

## package/summit-key-provider/Config.in.host
```kconfig
config BR2_PACKAGE_HOST_SUMMIT_KEY_PROVIDER
	bool "host summit-key-provider"
	help
	  Secure-boot signing key provider.  On Carbon and Nitrogen it
	  checks the keys in SIG_KEY_PATH and SIG_SUPPORT_PATH and, for
	  Cloud HSM (PKCS#11) builds, generates the key wrappers that
	  SIG_KEY_PATH then points to.  Other boards get a copy of
	  SIG_KEY_PATH in the build tree (KEYS_DIR).

	  U-Boot and the TI K3 R5 loader depend on this package, so the
	  keys are in place before any signing step.  It runs once;
	  changing the signing keys or Cloud HSM ARNs requires a manual
	  reconfigure:

	    make host-summit-key-provider-reconfigure && make
```

## package/summit-legacy/Config.in
```kconfig
config BR2_PACKAGE_SUMMIT_LEGACY
	bool "summit-legacy"
	select BR2_PACKAGE_DHCPCD
	select BR2_PACKAGE_OPENRESOLV
	select BR2_PACKAGE_EVENTMON
	help
	  Summit legacy software
```

## package/summit-openssl-fips-provider/Config.in
```kconfig
config BR2_PACKAGE_SUMMIT_OPENSSL_FIPS_PROVIDER
	bool "Summit OpenSSL FIPS Provider"
	depends on BR2_PACKAGE_OPENSSL 
	depends on BR2_PACKAGE_LIBOPENSSL_3_0
	depends on !BR2_PACKAGE_FIPSCHECK 
	depends on !BR2_PACKAGE_LIBOPENSSL_ENABLE_FIPS
	help
		Summit OpenSSL FIPS provider

if BR2_PACKAGE_SUMMIT_OPENSSL_FIPS_PROVIDER

config BR2_PACKAGE_SUMMIT_OPENSSL_FIPS_PROVIDER_VERSION_VALUE
	string "OpenSSL FIPS Provider version"
	default "11.0.0.294"

config BR2_PACKAGE_SUMMIT_OPENSSL_FIPS_PROVIDER_ARCH
	string
	default "arm-eabihf" if BR2_arm && BR2_ARM_EABIHF
	default "arm-eabi" if BR2_arm && BR2_ARM_EABI
	default "aarch64" if BR2_aarch64
	default "powerpc64-e5500" if BR2_powerpc64
	default "powerpc" if BR2_powerpc
	default "x86" if BR2_i386
	default "x86_64" if BR2_x86_64

endif # BR2_PACKAGE_SUMMIT_OPENSSL_FIPS_PROVIDER
```

## package/summit-prov-imx/Config.in
```kconfig
config BR2_PACKAGE_SUMMIT_PROV_IMX
	bool "summit-prov-imx"
	depends on BR2_INIT_SYSTEMD
	depends on BR2_PACKAGE_FREESCALE_IMX_PLATFORM_IMX93
	depends on BR2_PACKAGE_SUMMIT_ENCRYPTED_STORAGE_TOOLKIT
	depends on BR2_aarch64
	depends on BR2_TOOLCHAIN_HAS_THREADS
	depends on BR2_USE_MMU
	depends on !BR2_STATIC_LIBS
	depends on BR2_TOOLCHAIN_GCC_AT_LEAST_4_9
	select BR2_PACKAGE_IMX_SECURE_ENCLAVE
	select BR2_PACKAGE_OPENSC
	select BR2_PACKAGE_OPTEE_CLIENT
	select BR2_PACKAGE_OPENSSL
	select BR2_PACKAGE_LIBOPENSSL_BIN
	help
	  Summit Provisioning Service for NXP i.MX 93.

	  On first boot, decrypts the provisioning archive built from
	  $SIG_DATA_PATH/prov_data and imports the keys and
	  certificates it contains into the OP-TEE PKCS#11 token.
	  The compressed archive must not exceed 65520 bytes.

	  With BR2_SUMMIT_IMX_AHAB, the EdgeLock Enclave derives a
	  persistent OEM import master key, imports the wrapped fleet
	  key, and decrypts an AES-GCM payload. The device must have
	  the product SRK table hash fused and be in OEM Closed or
	  OEM Locked; the helper refuses any other lifecycle. The
	  artifacts are generated from $SIG_DATA_PATH/spsdk_ahab.yaml
	  and $SIG_DATA_PATH/summit-prov-imx (nxp-prod-ka-public.bin,
	  oem-ka-private.pem, fleet-aes-256.bin).

	  nxp-prod-ka-public.bin is the NXP production key-agreement
	  public key that ELE reports for key ID 0x70000000. It is
	  bound to the fused SRK table hash, so export it from a
	  device in OEM Closed or later, for example from U-Boot:

	    nxpele --family mx93 --device uboot_serial \
	      --port /dev/ttyUSB0,115200 export-nxp-prod-ka-puk \
	      --key-id 0x70000000 --output nxp-prod-ka-public.bin

	  Without BR2_SUMMIT_IMX_AHAB, ELE is not used. The archive
	  is encrypted with AES-256-CBC using a random per-build key
	  stored in cleartext in summit-prov-imx.sh, so it works in
	  any lifecycle but does not protect prov_data. Use it only
	  for evaluation with test data.

	  Run "make summit-prov-imx-rebuild" after changing any of
	  the inputs.
```

## package/summit-prov-ti/Config.in
```kconfig
config BR2_PACKAGE_SUMMIT_PROV_TI
	bool "summit-prov-ti"
	depends on BR2_LINUX_KERNEL
	select BR2_PACKAGE_PKCS11_PROVIDER
	select BR2_PACKAGE_OPTEE_CLIENT
	select BR2_PACKAGE_OPENSSL
	select BR2_PACKAGE_LIBOPENSSL_BIN
	select BR2_PACKAGE_KEYUTILS
	help
	  Summit Provisioning Service for TI AM6x processors.

	  Imports the encrypted provisioning data bundle
	  (prov_data.tar.gz_sign_enc.bin) into the OP-TEE PKCS#11
	  token on first boot.
```

## package/summit-prov/Config.in
```kconfig
config BR2_PACKAGE_SUMMIT_PROV
	bool "summit-prov"
	depends on BR2_LINUX_KERNEL
	select BR2_PACKAGE_PKCS11_PROVIDER
	select BR2_PACKAGE_OPTEE_CLIENT
	select BR2_PACKAGE_OPENSSL
	select BR2_PACKAGE_LIBOPENSSL_BIN
	help
	  Summit Provisioning Service
```

## package/summit-rcm-awm-plugin/Config.in
```kconfig
config BR2_PACKAGE_SUMMIT_RCM_AWM_PLUGIN
	bool "AWM plugin for Summit RCM"
	depends on BR2_PACKAGE_ADAPTIVE_WW || BR2_PACKAGE_SUMMIT_ADAPTIVE_WW
	depends on BR2_PACKAGE_SUMMIT_RCM
	default y
	help
		Add AWM (Adaptive Worldwide Mode) configuration support to Summit RCM.
```

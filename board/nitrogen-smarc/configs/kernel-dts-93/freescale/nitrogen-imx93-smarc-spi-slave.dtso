// SPDX-License-Identifier: (GPL-2.0+ OR MIT)
/*
 * Copyright 2024 Ezurio LLC
 */

/dts-v1/;
/plugin/;

&lpspi3 {
	fsl,spi-num-chipselects = <1>;
	spi-slave;

	#address-cells = <0>;
	#size-cells = <1>;

	spi0@0 {
		status = "disabled";
	};

	spi0@1 {
		status = "disabled";
	};

	slave {
		compatible = "lwn,bk4";
		spi-max-frequency = <1000000>;
	};
};

// SPDX-License-Identifier: GPL-2.0
/*
 * ArduCam xISP camera module
 *
 * Copyright (C) 2025 Ezurio LLC
 */

/dts-v1/;
/plugin/;

#include "nitrogen-imx93-smarc-csi0.dtsi"

&cam_csi0 {
	reg = <0x0c>;
	compatible = "arducam,arducam-pivariety";

	VANA-supply = <&reg_vdd_3v3>;
	VDIG-supply = <&reg_vdd_3v3>;
	VDDL-supply = <&reg_vdd_3v3>;

	reset-gpios = <&gpio2 6 GPIO_ACTIVE_HIGH>;
	enable-gpios = <&gpio3 26 GPIO_ACTIVE_HIGH>;
};

// SPDX-License-Identifier: (GPL-2.0-or-later OR MIT)
/*
 * Copyright 2024 Boundary Devices
 */

/dts-v1/;
/plugin/;

#include "nitrogen-imx93-smarc-lvds1-7.dtso"

&backlight_lvds1 {
	pwms = <&tpm6 1 100000 0>;
};

&display_lvds1 {
	width-mm = <217>;
	height-mm = <136>;
};

&touchscreen_lvds1 {
	compatible = "goodix,gt9271";
};

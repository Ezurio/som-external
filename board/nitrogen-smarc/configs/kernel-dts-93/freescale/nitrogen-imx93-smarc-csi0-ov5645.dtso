// SPDX-License-Identifier: GPL-2.0
/*
 * ArduCam OV5645 5MP camera module
 *
 * Copyright (C) 2025 Ezurio LLC
 */

/dts-v1/;
/plugin/;

#include "nitrogen-imx93-smarc-csi0.dtsi"

&cam_csi0 {
	compatible = "ovti,ov5645";
	reg = <0x3c>;

	vdddo-supply = <&reg_vdd_3v3>;
	vdda-supply = <&reg_vdd_3v3>;
	vddd-supply = <&reg_vdd_3v3>;

	reset-gpios = <&gpio2 6 GPIO_ACTIVE_LOW>;
	enable-gpios = <&gpio3 26 GPIO_ACTIVE_HIGH>;

	clock-frequency = <24000000>;
};

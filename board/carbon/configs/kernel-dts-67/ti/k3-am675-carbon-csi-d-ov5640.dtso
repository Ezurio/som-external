// SPDX-License-Identifier: GPL-2.0
/*
 * Digilent Pcam 5C 5MP OV5640 camera module
 *
 * Copyright (C) 2025 Ezurio LLC
 */

/dts-v1/;
/plugin/;

#include "k3-am675-carbon-csi-d.dtsi"

&camera_d {
	compatible = "ovti,ov5640";
	reg = <0x3c>;

	DOVDD-supply = <&reg_csi_d>;
	AVDD-supply = <&reg_csi_d>;
	DVDD-supply = <&reg_csi_d>;

	reset-gpios = <&main_gpio0 72 GPIO_ACTIVE_LOW>; /* CAM_D_RST */
	powerdown-gpios = <&main_gpio0 5 GPIO_ACTIVE_LOW>; /* CAM_D_PWR */
};

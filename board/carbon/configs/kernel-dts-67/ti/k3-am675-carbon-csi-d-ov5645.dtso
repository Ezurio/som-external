// SPDX-License-Identifier: GPL-2.0
/*
 * ArduCam OV5645 5MP camera module
 *
 * Copyright (C) 2025 Ezurio LLC
 */

/dts-v1/;
/plugin/;

#include "k3-am675-carbon-csi-d.dtsi"

&camera_d {
	compatible = "ovti,ov5645";
	reg = <0x3c>;

	vdddo-supply = <&reg_csi_d>;
	vdda-supply = <&reg_csi_d>;
	vddd-supply = <&reg_csi_d>;

	reset-gpios = <&main_gpio0 72 GPIO_ACTIVE_LOW>; /* CAM_D_RST */
	enable-gpios = <&main_gpio0 5 GPIO_ACTIVE_HIGH>; /* CAM_D_PWR */

	clock-frequency = <24000000>;
};

// SPDX-License-Identifier: GPL-2.0
/*
 * ArduCam OV5645 5MP camera module
 *
 * Copyright (C) 2025 Ezurio LLC
 */

/dts-v1/;
/plugin/;

#include "k3-am675-carbon-cam-a.dtsi"

&cam_a {
	compatible = "ovti,ov5645";
	reg = <0x3c>;

	vdddo-supply = <&vdd_cam_a>;
	vdda-supply = <&vdd_cam_a>;
	vddd-supply = <&vdd_cam_a>;

	reset-gpios = <&main_gpio0 6 GPIO_ACTIVE_LOW>; /* CAM_A_RST */
	enable-gpios = <&main_gpio0 0 GPIO_ACTIVE_HIGH>; /* CAM_A_PWR */

	clock-frequency = <24000000>;
};

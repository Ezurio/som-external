// SPDX-License-Identifier: GPL-2.0
/*
 * ArduCam xISP camera module
 *
 * Copyright (C) 2025 Ezurio LLC
 */

/dts-v1/;
/plugin/;

#include "k3-am675-carbon-csi-d.dtsi"

&reg_csi_d {
	startup-delay-us = <4000000>;
	regulator-always-on;
};

&camera_d {
	reg = <0x0c>;
	compatible = "arducam,arducsi-pivariety";

	VANA-supply = <&reg_csi_d>;
	VDIG-supply = <&reg_csi_d>;
	VDDL-supply = <&reg_csi_d>;

	reset-gpios = <&main_gpio0 72 GPIO_ACTIVE_HIGH>; /* CAM_D_RST */
	enable-gpios = <&main_gpio0 5 GPIO_ACTIVE_HIGH>; /* CAM_D_PWR */
};

&camera_d_ep {
	data-lanes = <1 2 3 4>;
};

&csi2rx3_in_sensor {
	data-lanes = <1 2 3 4>;
};

// SPDX-License-Identifier: GPL-2.0
/*
 * Digilent Pcam 5C 5MP OV5640 camera module
 *
 * Copyright (C) 2025 Ezurio LLC
 */

/dts-v1/;
/plugin/;

#include "k3-am675-carbon-cam-c.dtsi"

&cam_c {
	compatible = "ovti,ov5640";
	reg = <0x3c>;

	DOVDD-supply = <&reg_cam_c>;
	AVDD-supply = <&reg_cam_c>;
	DVDD-supply = <&reg_cam_c>;

	reset-gpios = <&main_gpio0 4 GPIO_ACTIVE_LOW>; /* CAM_C_RST */
	powerdown-gpios = <&main_gpio0 3 GPIO_ACTIVE_LOW>; /* CAM_C_PWR */
};

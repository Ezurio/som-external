// SPDX-License-Identifier: GPL-2.0
/*
 * ArduCam OV5645 5MP camera module
 *
 * Copyright (C) 2025 Ezurio LLC
 */

/dts-v1/;
/plugin/;

#include "k3-am675-carbon-cam-b.dtsi"

&cam_b {
	compatible = "ovti,ov5645";
	reg = <0x3c>;

	vdddo-supply = <&reg_cam_b>;
	vdda-supply = <&reg_cam_b>;
	vddd-supply = <&reg_cam_b>;

	reset-gpios = <&main_gpio0 12 GPIO_ACTIVE_LOW>; /* CAM_B_RST */
	enable-gpios = <&main_gpio0 11 GPIO_ACTIVE_HIGH>; /* CAM_B_PWR */

	clock-frequency = <24000000>;
};

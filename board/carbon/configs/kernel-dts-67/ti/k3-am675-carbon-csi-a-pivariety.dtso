// SPDX-License-Identifier: GPL-2.0
/*
 * ArduCam xISP camera module
 *
 * Copyright (C) 2025 Ezurio LLC
 */

/dts-v1/;
/plugin/;

#include "k3-am675-carbon-csi-a.dtsi"

&reg_csi_a {
	startup-delay-us = <4000000>;
	regulator-always-on;
};

&camera_a {
	reg = <0x0c>;
	compatible = "arducam,arducam-pivariety";

	VANA-supply = <&reg_csi_a>;
	VDIG-supply = <&reg_csi_a>;
	VDDL-supply = <&reg_csi_a>;

	reset-gpios = <&main_gpio0 6 GPIO_ACTIVE_HIGH>; /* CAM_A_RST */
	enable-gpios = <&main_gpio0 0 GPIO_ACTIVE_HIGH>; /* CAM_A_PWR */
};

&camera_a_ep {
	data-lanes = <1 2 3 4>;
};

&csi2rx0_in_sensor {
	data-lanes = <1 2 3 4>;
};

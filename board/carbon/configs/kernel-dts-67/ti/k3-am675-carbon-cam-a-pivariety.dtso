// SPDX-License-Identifier: GPL-2.0
/*
 * ArduCam xISP camera module
 *
 * Copyright (C) 2025 Ezurio LLC
 */

/dts-v1/;
/plugin/;

#include "k3-am675-carbon-cam-a.dtsi"

&cam_a {
	reg = <0x0c>;
	compatible = "arducam,arducam-pivariety";

	VANA-supply = <&vdd_cam_a>;
	VDIG-supply = <&vdd_cam_a>;
	VDDL-supply = <&vdd_cam_a>;

	reset-gpios = <&exp0 12 GPIO_ACTIVE_HIGH>; /* CAM_A_RST */
	enable-gpios = <&exp0 13 GPIO_ACTIVE_HIGH>; /* CAM_A_PWR */
};

&cam_a_ep {
	data-lanes = <1 2 3 4>;
};

&csi2rx0_in_sensor {
	data-lanes = <1 2 3 4>;
};

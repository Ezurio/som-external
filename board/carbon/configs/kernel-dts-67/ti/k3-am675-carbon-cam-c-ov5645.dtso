// SPDX-License-Identifier: GPL-2.0
/*
 * ArduCam OV5645 5MP camera module
 *
 * Copyright (C) 2025 Ezurio LLC
 */

/dts-v1/;
/plugin/;

#include "k3-am675-carbon-cam-c.dtsi"

&cam_c {
	compatible = "ovti,ov5645";
	reg = <0x3c>;

	vdddo-supply = <&vdd_cam_c>;
	vdda-supply = <&vdd_cam_c>;
	vddd-supply = <&vdd_cam_c>;

	reset-gpios = <&main_gpio0 6 GPIO_ACTIVE_LOW>; /* CAM_C_RST */
	enable-gpios = <&main_gpio0 5 GPIO_ACTIVE_HIGH>; /* CAM_C_PWR */

	clock-frequency = <24000000>;
};

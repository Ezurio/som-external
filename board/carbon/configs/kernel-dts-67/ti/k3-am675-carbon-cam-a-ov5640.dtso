// SPDX-License-Identifier: GPL-2.0
/*
 * Digilent Pcam 5C 5MP OV5640 camera module
 *
 * Copyright (C) 2025 Ezurio LLC
 */

/dts-v1/;
/plugin/;

#include "k3-am675-carbon-cam-a.dtsi"

&cam_a {
	compatible = "ovti,ov5640";
	reg = <0x3c>;

	DOVDD-supply = <&vdd_cam_a>;
	AVDD-supply = <&vdd_cam_a>;
	DVDD-supply = <&vdd_cam_a>;

	reset-gpios = <&main_gpio0 6 GPIO_ACTIVE_LOW>; /* CAM_A_RST */
	powerdown-gpios = <&main_gpio0 0 GPIO_ACTIVE_LOW>; /* CAM_A_PWR */
};

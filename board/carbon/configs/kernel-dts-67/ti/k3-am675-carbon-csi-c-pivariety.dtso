// SPDX-License-Identifier: GPL-2.0
/*
 * ArduCam xISP camera module
 *
 * Copyright (C) 2025 Ezurio LLC
 */

/dts-v1/;
/plugin/;

#include "k3-am675-carbon-csi-c.dtsi"

&reg_csi_c {
	startup-delay-us = <4000000>;
	regulator-always-on;
};

&camera_c {
	reg = <0x0c>;
	compatible = "arducam,arducam-pivariety";

	VANA-supply = <&reg_csi_c>;
	VDIG-supply = <&reg_csi_c>;
	VDDL-supply = <&reg_csi_c>;

	reset-gpios = <&main_gpio0 4 GPIO_ACTIVE_HIGH>; /* CAM_C_RST */
	enable-gpios = <&main_gpio0 3 GPIO_ACTIVE_HIGH>; /* CAM_C_PWR */
};

&camera_c_ep {
	data-lanes = <1 2 3 4>;
};

&csi2rx2_in_sensor {
	data-lanes = <1 2 3 4>;
};

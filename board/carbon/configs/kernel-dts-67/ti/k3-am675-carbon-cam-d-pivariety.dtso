// SPDX-License-Identifier: GPL-2.0
/*
 * ArduCam xISP camera module
 *
 * Copyright (C) 2025 Ezurio LLC
 */

/dts-v1/;
/plugin/;

#include "k3-am675-carbon-cam-d.dtsi"

&cam_d {
	reg = <0x0c>;
	compatible = "arducam,arducam-pivariety";

	VANA-supply = <&vdd_cam_d>;
	VDIG-supply = <&vdd_cam_d>;
	VDDL-supply = <&vdd_cam_d>;

	reset-gpios = <&exp0 7 GPIO_ACTIVE_HIGH>; /* CAM_D_RST */
	enable-gpios = <&exp0 6 GPIO_ACTIVE_HIGH>; /* CAM_D_PWR */
};

&cam_d_ep {
	data-lanes = <1 2 3 4>;
};

&csi2rx3_in_sensor {
	data-lanes = <1 2 3 4>;
};

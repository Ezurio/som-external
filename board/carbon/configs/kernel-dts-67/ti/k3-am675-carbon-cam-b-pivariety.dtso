// SPDX-License-Identifier: GPL-2.0
/*
 * ArduCam xISP camera module
 *
 * Copyright (C) 2025 Ezurio LLC
 */

/dts-v1/;
/plugin/;

#include "k3-am675-carbon-cam-b.dtsi"

&reg_cam_b {
	startup-delay-us = <4000000>;
	regulator-always-on;
};

&cam_b {
	reg = <0x0c>;
	compatible = "arducam,arducam-pivariety";

	VANA-supply = <&reg_cam_b>;
	VDIG-supply = <&reg_cam_b>;
	VDDL-supply = <&reg_cam_b>;

	reset-gpios = <&main_gpio0 12 GPIO_ACTIVE_HIGH>; /* CAM_B_RST */
	enable-gpios = <&main_gpio0 11 GPIO_ACTIVE_HIGH>; /* CAM_B_PWR */
};

&cam_b_ep {
	data-lanes = <1 2 3 4>;
};

&csi2rx1_in_sensor {
	data-lanes = <1 2 3 4>;
};

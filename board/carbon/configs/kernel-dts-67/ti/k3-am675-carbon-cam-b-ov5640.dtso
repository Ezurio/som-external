// SPDX-License-Identifier: GPL-2.0
/*
 * Digilent Pcam 5C 5MP OV5640 camera module
 *
 * Copyright (C) 2025 Ezurio LLC
 */

/dts-v1/;
/plugin/;

#include "k3-am675-carbon-cam-b.dtsi"

&cam_b {
	compatible = "ovti,ov5640";
	reg = <0x3c>;

	DOVDD-supply = <&reg_cam_b>;
	AVDD-supply = <&reg_cam_b>;
	DVDD-supply = <&reg_cam_b>;

	reset-gpios = <&main_gpio0 12 GPIO_ACTIVE_LOW>; /* CAM_B_RST */
	powerdown-gpios = <&main_gpio0 11 GPIO_ACTIVE_LOW>; /* CAM_B_PWR */
};

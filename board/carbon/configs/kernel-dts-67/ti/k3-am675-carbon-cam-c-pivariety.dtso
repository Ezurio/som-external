// SPDX-License-Identifier: GPL-2.0
/*
 * ArduCam xISP camera module
 *
 * Copyright (C) 2025 Ezurio LLC
 */

/dts-v1/;
/plugin/;

#include "k3-am675-carbon-cam-c.dtsi"

&vdd_cam_c {
	startup-delay-us = <4000000>;
	regulator-always-on;
};

&cam_c {
	reg = <0x0c>;
	compatible = "arducam,arducam-pivariety";

	VANA-supply = <&vdd_cam_c>;
	VDIG-supply = <&vdd_cam_c>;
	VDDL-supply = <&vdd_cam_c>;

	reset-gpios = <&main_gpio0 6 GPIO_ACTIVE_HIGH>; /* CAM_C_RST */
	enable-gpios = <&main_gpio0 5 GPIO_ACTIVE_HIGH>; /* CAM_C_PWR */
};

&cam_c_ep {
	data-lanes = <1 2 3 4>;
};

&csi2rx2_in_sensor {
	data-lanes = <1 2 3 4>;
};

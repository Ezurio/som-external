// SPDX-License-Identifier: GPL-2.0-only OR MIT
/*
 * RGB to LVDS Expansion Board with BD101LCC3 display for carbon AM62x
 *
 * Copyright (C) 2024 Ezurio LLC
 */

#include "k3-am625-carbon-rgb-lvds-7.dtso"

&backlight_rgb {
	pwms = <&epwm1 0 100000 0>;
};

&display_rgb {
	width-mm = <217>;
	height-mm = <136>;
};

&touchscreen_rgb {
	compatible = "goodix,gt9271";
};

// SPDX-License-Identifier: (GPL-2.0+ OR MIT)
/*
 * SDIO Summit/Sterling 60 in SDIO-UART mode
 * Support stop-shutdown mode - radio de-powered on link down
 *
 * Copyright (C) 2024 Ezurio LLC
 */

#include "k3-am625-carbon-wifi-60-sdio-uart.dtso"

&wifi {
	remove-power-on-link-down;
};

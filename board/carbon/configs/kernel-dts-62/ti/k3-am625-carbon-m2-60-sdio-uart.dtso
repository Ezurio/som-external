// SPDX-License-Identifier: GPL-2.0
/*
 * M.2 ST60-2230C module
 * Copyright (C) 2024 Ezurio LLC
 */

/dts-v1/;
/plugin/;

#include "k3-am625-carbon-m2-sdio.dtsi"

&sdhci1 {
	wifi-m2 {
		compatible = "marvell,sd8997";
		fwtype = "sdio-uart";
	};
};

&wifi_wakeup_m2 {
	status = "okay";
};

&exp2 {
	wakeup-source;
};

// SPDX-License-Identifier: GPL-2.0
/*
 * ArduCam xISP camera module
 *
 * Copyright (C) 2025 Ezurio LLC
 */

/dts-v1/;
/plugin/;

#include "k3-am625-carbon-cam-a.dtsi"

&reg_cam_a {
	startup-delay-us = <4000000>;
	regulator-always-on;
};

&cam_a {
	reg = <0x0c>;
	compatible = "arducam,arducam-pivariety";

	VANA-supply = <&reg_cam_a>;
	VDIG-supply = <&reg_cam_a>;
	VDDL-supply = <&reg_cam_a>;

	reset-gpios = <&main_gpio0 29 GPIO_ACTIVE_HIGH>; /* CAM_A_RST */
	enable-gpios = <&main_gpio0 72 GPIO_ACTIVE_HIGH>; /* CAM_A_PWR */
};

&cam_a_ep {
	data-lanes = <1 2 3 4>;
};

&csi2rx0_in_sensor {
	data-lanes = <1 2 3 4>;
};

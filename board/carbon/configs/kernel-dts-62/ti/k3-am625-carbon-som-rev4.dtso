// SPDX-License-Identifier: GPL-2.0-only OR MIT
/*
 * Updates for Rev 4 of the AM62x Carbon SOM
 *
 * Copyright (C) 2024 Ezurio LLC
 */

/dts-v1/;
/plugin/;

#include <dt-bindings/gpio/gpio.h>

#include "k3-pinctrl.h"

&main_usb0_id_pins_default {
    pinctrl-single,pins = <
        AM62X_IOPAD(0x1f0, PIN_INPUT_PULLUP, 7) /* USB_A_ID (A18) EXT_REFCLK1.GPIO1_30 */
    >;
};

&main_usb1_en_pins_default {
	pinctrl-single,pins = <
		AM62X_IOPAD(0x258, PIN_OUTPUT, 0) /* USB_B_EN (F18) USB1_DRVVBUS */
	>;
};

&main_usb1_id_pins_default {
	pinctrl-single,pins = <
		AM62X_IOPAD(0x044, PIN_INPUT_PULLUP, 7) /* USB_B_ID (N24) GPMC0_AD2.GPIO0_17 */
	>;
};

&con_usb0 {
    id-gpios = <&main_gpio1 30 GPIO_ACTIVE_HIGH>;
};

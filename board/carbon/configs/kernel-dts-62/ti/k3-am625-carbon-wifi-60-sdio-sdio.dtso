// SPDX-License-Identifier: (GPL-2.0+ OR MIT)
/*
 * SDIO Summit/Sterling 60 in SDIO-SDIO mode
 *
 * Copyright (C) 2026 Ezurio LLC
 */

#include "k3-am625-carbon-wifi-60-sdio-uart.dtso"

&wifi {
	fwtype = "sdio-sdio";
};

&main_uart1 {
	status = "disabled";
};

&bt_boot_strap {
	/delete-property/ output-low;
	output-high; // BT SDIO
};

// SPDX-License-Identifier: GPL-2.0
/*
 * M.2 ST60-2230C-SS module
 * Copyright (C) 2024 Ezurio LLC
 */

#include "k3-am625-carbon-m2-60-sdio-uart.dtso"

&sdhci2 {
	wifi-m2 {
		compatible = "marvell,sd8997";
		fwtype = "sdio-sdio";
	};
};

&mcu_uart0 {
	status = "disabled";
};

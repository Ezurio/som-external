// SPDX-License-Identifier: (GPL-2.0-or-later OR MIT)
/*
 * DSI0 display expansion board with BD101LCC3 display for Nitrogen i.MX93 OSM-M
 *
 * Copyright 2026 Ezurio LLC
 */

/dts-v1/;
/plugin/;

#include "nitrogen-imx93-osm-m-dsi-a-7.dtso"

&backlight_dsi_a {
	pwms = <&tpm5 1 100000 0>;
};

&display_dsi_a {
	width-mm = <217>;
	height-mm = <136>;
};

&touchscreen_dsi_a {
	compatible = "goodix,gt9271";
};

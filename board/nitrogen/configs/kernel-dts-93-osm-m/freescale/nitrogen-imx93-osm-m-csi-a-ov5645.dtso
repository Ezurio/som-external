// SPDX-License-Identifier: (GPL-2.0+ OR MIT)
/*
 * ArduCam OV5645 5MP camera module on CSI_A for Nitrogen i.MX93 OSM-M
 *
 * Copyright 2026 Ezurio LLC
 */

/dts-v1/;
/plugin/;

#include "nitrogen-imx93-osm-m-csi-a.dtsi"

&cam_csi_a {
	compatible = "ovti,ov5645";
	reg = <0x3c>;

	vdddo-supply = <&reg_csi_a>;
	vdda-supply = <&reg_csi_a>;
	vddd-supply = <&reg_csi_a>;

	reset-gpios = <&exp0 26 GPIO_ACTIVE_LOW>; /* GPIO_C_7 -> CAM_A_RST# */
	enable-gpios = <&exp0 25 GPIO_ACTIVE_HIGH>; /* GPIO_C_6 -> CAM_A_PWR */

	clock-frequency = <24000000>;
};

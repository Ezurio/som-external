// SPDX-License-Identifier: (GPL-2.0+ OR MIT)
/*
 * Copyright 2025 Ezurio LLC
 */

/dts-v1/;
/plugin/;

// SMARC carrier has 1.8V camera GPIO/I2C, requires camera that can tolerate that

#include "nitrogen-imx93-smarc-csi0.dtsi"

&cam_csi0 {
	compatible = "ovti,ov5640";
	reg = <0x3c>;

	DOVDD-supply = <&reg_vdd_3v3>;
	AVDD-supply = <&reg_vdd_3v3>;
	DVDD-supply = <&reg_vdd_3v3>;

	reset-gpios = <&gpio2 6 GPIO_ACTIVE_LOW>;
	powerdown-gpios = <&gpio3 26 GPIO_ACTIVE_LOW>;
};

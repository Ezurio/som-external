// SPDX-License-Identifier: (GPL-2.0+ OR MIT)
/*
 * M.2 PCIE Wi-Fi module
 *
 * Copyright (C) 2026 Ezurio LLC
 */

/dts-v1/;
/plugin/;

&reg_usdhc2_vmmc {
	vin-supply = <&reg_slow_clock_carrier>;

	startup-delay-us = <1000>;
	off-on-delay-us = <100000>;
};

&pcie0 {
	vpcie-supply = <&reg_usdhc2_vmmc>;
	status = "okay";
};

&pcie_phy {
	status = "okay";
};

&uart1 {
	status = "okay";
};

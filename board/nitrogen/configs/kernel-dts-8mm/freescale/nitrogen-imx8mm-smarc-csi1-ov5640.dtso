// SPDX-License-Identifier: (GPL-2.0+ OR MIT)
/*
 * Copyright 2026 Ezurio LLC
 */

/dts-v1/;
/plugin/;

// SMARC carrier has 1.8V camera GPIO/I2C, requires camera that can tolerate that

#include "nitrogen-imx8mm-smarc-csi1.dtsi"

&cam_csi1 {
	compatible = "ovti,ov5640";
	reg = <0x3c>;

	DOVDD-supply = <&reg_vdd_3v3>;
	AVDD-supply = <&reg_vdd_3v3>;
	DVDD-supply = <&reg_vdd_3v3>;

	reset-gpios = <&gpio1 15 GPIO_ACTIVE_LOW>;
	powerdown-gpios = <&gpio4 1 GPIO_ACTIVE_LOW>;
};

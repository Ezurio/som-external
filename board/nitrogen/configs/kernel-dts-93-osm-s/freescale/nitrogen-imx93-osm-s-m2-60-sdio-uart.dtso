// SPDX-License-Identifier: (GPL-2.0+ OR MIT)
/*
 * M.2 SDIO 60-series SDIO-UART module
 *
 * Copyright 2026 Ezurio LLC
 */

/dts-v1/;
/plugin/;

#include "nitrogen-imx93-osm-s-m2-sdio.dtsi"

&usdhc2 {
	wifi-m2 {
		compatible = "marvell,sd8997";
		fwtype = "sdio-uart";
	};
};

&wifi_wakeup_m2 {
	status = "okay";
};

&exp2 {
	wakeup-source;
};

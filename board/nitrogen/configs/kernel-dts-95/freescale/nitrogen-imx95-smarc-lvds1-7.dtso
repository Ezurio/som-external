// SPDX-License-Identifier: (GPL-2.0-or-later OR MIT)
/*
 * Copyright 2024 Ezurio LLC
 */

/dts-v1/;
/plugin/;

#include "nitrogen-imx95-smarc-lvds.dtsi"

&{/} {
	backlight_lvds1: backlight-lvds {
		brightness-levels = <0 1 2 3 4 5 6 7 8 9 10>;
		compatible = "pwm-backlight";
		default-brightness-level = <8>;
		enable-gpios = <&pcal6524 20 GPIO_ACTIVE_HIGH>;
		pwms = <&tpm3 2 30000 0>;
	};

	display_lvds1: display-lvds1 {
		compatible = "panel-lvds";
		data-mapping = "vesa-24";

		backlight = <&backlight_lvds1>;

		width-mm = <150>;
		height-mm = <94>;

		panel-timing {
			BD_PANEL_TIMING
		};

		port {
			display_in_lvds1_ep: endpoint {
				remote-endpoint = <&lvds1_out_ep>;
			};
		};
	};
};

&ldb {
	channel@1 {
		status = "okay";

		#address-cells = <1>;
		#size-cells = <0>;

		port@1 {
			lvds1_out_ep: endpoint {
				remote-endpoint = <&display_in_lvds1_ep>;
			};
		};
	};
};

&ldb1_phy {
	status = "okay";
};

&tpm3 {
	status = "okay";
};

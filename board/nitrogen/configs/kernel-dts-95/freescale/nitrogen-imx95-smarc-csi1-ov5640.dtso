// SPDX-License-Identifier: (GPL-2.0+ OR MIT)
/*
 * Copyright 2025 Ezurio LLC
 */

/dts-v1/;
/plugin/;

// CSI1 is disabled on SMARC module by default,
// requires switching 0 Ohm resistors to enable

// SMARC carrier has 1.8V camera GPIO/I2C,
// requires camera that can tolerate that

#include "nitrogen-imx95-smarc-csi1.dtsi"

&cam_csi1 {
	reg = <0x3c>;
	compatible = "ovti,ov5640";

	DOVDD-supply = <&reg_vdd_3v3>;
	AVDD-supply = <&reg_vdd_3v3>;
	DVDD-supply = <&reg_vdd_3v3>;

	reset-gpios = <&gpio3 26 GPIO_ACTIVE_LOW>;
	powerdown-gpios = <&gpio5 9 GPIO_ACTIVE_LOW>;
};

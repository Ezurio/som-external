// SPDX-License-Identifier: (GPL-2.0+ OR MIT)
/*
 * Copyright 2021 Ezurio LLC
 */

#include "imx8mp-summitsom-wifi-sdio-uart.dtso"

&uart3 {
	/* BT */
 	status = "disabled";
};

&wifi {
	fwtype = "sdio-sdio";
};

&wifi_bs0 {
	/delete-property/ output-low;
	output-high;
};

// SPDX-License-Identifier: (GPL-2.0+ OR MIT)
/*
 * ArduCam Pivariety camera module
 *
 * Copyright (C) 2026 Ezurio LLC
 */

/dts-v1/;
/plugin/;

#include "nitrogen-imx8mp-smarc-csi0.dtsi"

&cam_csi0 {
	compatible = "arducam,arducam-pivariety";
	reg = <0x0c>;

	VANA-supply = <&reg_vdd_3v3>;
	VDIG-supply = <&reg_vdd_3v3>;
	VDDL-supply = <&reg_vdd_3v3>;

	reset-gpios = <&gpio5 3 GPIO_ACTIVE_HIGH>;
	enable-gpios = <&mcp23018 0 GPIO_ACTIVE_HIGH>;
};

&cam_csi0_ep {
	data-lanes = <1 2 3 4>;
};

&mipi_csi0_in_ep {
	data-lanes = <4>;
	csis-hs-settle = <30>;
	csis-clk-settle = <2>;
	csis-wclk;
};

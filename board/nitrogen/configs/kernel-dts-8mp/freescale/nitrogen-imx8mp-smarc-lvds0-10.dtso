// SPDX-License-Identifier: (GPL-2.0-or-later OR MIT)
/*
 * Copyright 2026 Ezurio LLC
 */

/dts-v1/;
/plugin/;

#include "nitrogen-imx8mp-smarc-lvds0-7.dtso"

&backlight_lvds0 {
	pwms = <&pwm2 0 100000 0>;
};

&display_lvds0 {
	width-mm = <217>;
	height-mm = <136>;
};

&touchscreen_lvds {
	compatible = "goodix,gt9271";
};

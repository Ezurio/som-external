// SPDX-License-Identifier: GPL-2.0
/*
 * M.2 PCIE LWBxx & IFxxx module
 *
 * Copyright (C) 2024 Ezurio LLC
 */

/dts-v1/;
/plugin/;

#include "k3-am675-carbon-m2-pcie.dtsi"

&mcu_uart0 {
	bluetooth {
		compatible = "brcm,bcm4329-bt";
		vbat-supply = <&vcc_wifi_m2>;
		vddio-supply = <&vdd_1v8_carrier>;
		brcm,requires-autobaud-mode;
		max-speed = <921600>;
		shutdown-gpios = <&exp1 5 GPIO_ACTIVE_HIGH>;
		device-wakeup-gpios = <&exp1 7 GPIO_ACTIVE_HIGH>;
	};
};

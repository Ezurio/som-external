// SPDX-License-Identifier: GPL-2.0
/*
 * ArduCam OV5645 5MP camera module
 *
 * Copyright (C) 2025 Ezurio LLC
 */

#include "k3-am675-carbon-cam-d-ov5640.dtso"

&camera_cam_d {
	compatible = "ovti,ov5645";

	vdddo-supply = <&vdd_3v3_carrier>;
	vdda-supply = <&vdd_3v3_carrier>;
	vddd-supply = <&vdd_3v3_carrier>;

	enable-gpios = <&exp0 6 GPIO_ACTIVE_HIGH>; /* CAM_D_PWR */
	/delete-property/ powerdown-gpios;
	clock-frequency = <24000000>;
};

// SPDX-License-Identifier: GPL-2.0
/*
 * ArduCam xISP camera module
 *
 * Copyright (C) 2025 Ezurio LLC
 */

#include "k3-am675-carbon-cam-b-ov5640.dtso"

&clk_cam_b_int {
	clock-frequency = <24000000>;
};

&camera_cam_b {
	reg = <0x0c>;
	compatible = "arducam,arducam-pivariety";
	reset-gpios = <&exp0 0 GPIO_ACTIVE_HIGH>; /* CAM_B_PWR */
	/delete-property/ powerdown-gpios;
};

&csi2_cam1 {
	data-lanes = <1 2 3 4>;
};

&csi2rx1_in_sensor {
	data-lanes = <1 2 3 4>;
};

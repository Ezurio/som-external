// SPDX-License-Identifier: GPL-2.0
/*
 * ArduCam OV5645 5MP camera module
 *
 * Copyright (C) 2025 Ezurio LLC
 */

#include "k3-am675-carbon-cam-b-ov5640.dtso"

&clk_cam_b_int {
	clock-frequency = <24000000>;
};

&camera_cam_b {
	compatible = "ovti,ov5645";
	enable-gpios = <&exp0 0 GPIO_ACTIVE_HIGH>; /* CAM_B_PWR */
	/delete-property/ powerdown-gpios;
	clock-frequency = <24000000>;
};

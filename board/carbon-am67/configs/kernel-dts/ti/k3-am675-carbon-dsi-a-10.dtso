// SPDX-License-Identifier: GPL-2.0-only OR MIT
/*
 * LVDS Expansion Board with BD101LCC3 display for carbon AM67xx
 *
 * Copyright (C) 2024 Ezurio LLC
 */

#include "k3-am675-carbon-dsi-a-7.dtso"

&backlight_dsi_a {
	pwms = <&epwm2 1 100000 0>;
};

&display_dsi_a {
	width-mm = <217>;
	height-mm = <136>;
};

&touchscreen_dsi_a {
	compatible = "goodix,gt9271";
	reg = <0x5d>;
};

// SPDX-License-Identifier: GPL-2.0-only OR MIT
/*
 * LVDS D to LVDS Expansion Board with BD101LCC3 display for Carbon AM67x
 *
 * Copyright (C) 2025 Ezurio LLC
 */

#include "k3-am675-carbon-lvds-d-7.dtso"

&backlight_lvds_d {
	pwms = <&pwm2 0 100000 0>;
};

&display_lvds_d {
	width-mm = <217>;
	height-mm = <136>;
};

&touchscreen_lvds_d {
	compatible = "goodix,gt9271";
};

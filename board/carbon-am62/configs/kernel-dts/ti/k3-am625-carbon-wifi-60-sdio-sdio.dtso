// SPDX-License-Identifier: (GPL-2.0+ OR MIT)
/*
 * SDIO Summit/Sterling 60 in SDIO-SDIO mode
 *
 * Copyright (C) 2024 Ezurio LLC
 */

#include "k3-am625-carbon-wifi-60-sdio-uart.dtso"

&reg_strap_60 {
	/* SDIO-SDIO mode */
	regulator-always-on;
};

&wifi {
	fwtype = "sdio-sdio";
};

&main_uart1 {
	status = "disabled";
};

// SPDX-License-Identifier: GPL-2.0
/*
 * M.2 ST60-2230C module
 * Copyright (C) 2024 Ezurio LLC
 */

/dts-v1/;
/plugin/;

#include "k3-am625-carbon-m2.dtsi"

&sdhci1 {
	wifi: wifi {
		compatible = "marvell,sd8997";
		fwtype = "sdio-uart";
		reset-gpios = <&exp1 4 GPIO_ACTIVE_HIGH>;
	};
};

// SPDX-License-Identifier: GPL-2.0-only OR MIT
/*
 * LVDS Expansion Board with BD101LCC3 display for carbon AM62x
 *
 * Copyright (C) 2024 Ezurio LLC
 */

#include "k3-am625-carbon-lvds-d-7.dtso"

&backlight_lvds_d {
	pwms = <&epwm1 1 100000 0>;
};

&display_lvds_d {
	width-mm = <217>;
	height-mm = <136>;
};

&touchscreen_lvds_d {
	compatible = "goodix,gt9271";
	reg = <0x5d>;
};

// SPDX-License-Identifier: GPL-2.0
/*
 * ArduCam OV5645 5MP camera module
 *
 * Copyright (C) 2025 Ezurio LLC
 */

#include "k3-am625-carbon-cam-a-ov5640.dtso"

&clk_cam_a_int {
	clock-frequency = <24000000>;
};

&camera_cam_a {
	compatible = "ovti,ov5645";
	enable-gpios = <&main_gpio0 26 GPIO_ACTIVE_HIGH>; /* GPIO_C_6 / CAM_A_PWR */
	/delete-property/ powerdown-gpios;
	clock-frequency = <24000000>;
};

## configs/summitssl_fips-arm-eabi_defconfig
```kconfig
BR2_arm=y
BR2_ARM_INSTRUCTIONS_THUMB=y
BR2_TOOLCHAIN_EXTERNAL=y
BR2_TOOLCHAIN_EXTERNAL_LAIRD_ARM=y
BR2_WGET="wget --passive-ftp -nd"
BR2_DL_DIR="$(HOME)/.br2_dl_dir"
BR2_CCACHE=y
BR2_CCACHE_DIR="$(BR2_DL_DIR)/.buildroot-ccache"
BR2_PER_PACKAGE_DIRECTORIES=y
BR2_TIME_BITS_64=y
BR2_ROOTFS_SKELETON_CUSTOM=y
BR2_ROOTFS_SKELETON_CUSTOM_PATH="$(BR2_EXTERNAL_LRD_SOM_PATH)/board/skeleton-empty"
BR2_INIT_NONE=y
BR2_ROOTFS_DEVICE_TABLE=""
BR2_ROOTFS_POST_IMAGE_SCRIPT="$(BR2_EXTERNAL_LRD_SOM_PATH)/board/summitssl-fips/post_image.sh"
# BR2_PACKAGE_BUSYBOX is not set
BR2_PACKAGE_OPENSSL=y
BR2_PACKAGE_LIBOPENSSL_BIN=y
# BR2_PACKAGE_LIBOPENSSL_ENABLE_IDEA is not set
# BR2_PACKAGE_LIBOPENSSL_ENABLE_SEED is not set
# BR2_PACKAGE_LIBOPENSSL_ENABLE_WHIRLPOOL is not set
# BR2_PACKAGE_LIBOPENSSL_ENABLE_BLOWFISH is not set
# BR2_PACKAGE_LIBOPENSSL_ENABLE_SSL3 is not set
# BR2_PACKAGE_LIBOPENSSL_ENABLE_WEAK_SSL is not set
# BR2_PACKAGE_LIBOPENSSL_ENABLE_CAST is not set
# BR2_PACKAGE_LIBOPENSSL_UNSECURE is not set
# BR2_PACKAGE_LIBOPENSSL_ENABLE_COMP is not set
BR2_PACKAGE_LIBOPENSSL_ENABLE_FIPS=y
BR2_PACKAGE_LIBOPENSSL_3_0=y
# BR2_TARGET_ROOTFS_TAR is not set
```

## configs/wb40n_rdvk_3_2_defconfig
```kconfig
BR2_arm=y
BR2_TOOLCHAIN_EXTERNAL=y
BR2_TOOLCHAIN_EXTERNAL_LAIRD_WB40_32=y
BR2_WGET="wget --passive-ftp -nd"
BR2_DL_DIR="$(HOME)/.br2_dl_dir"
BR2_CCACHE=y
BR2_CCACHE_DIR="$(BR2_DL_DIR)/.buildroot-ccache"
BR2_PACKAGE_OVERRIDE_FILE="$(BR2_EXTERNAL_LRD_SOM_PATH)/board/wb40n_rdvk/wb40n_3_2-local.mk"
BR2_PER_PACKAGE_DIRECTORIES=y
BR2_TIME_BITS_64=y
BR2_TARGET_GENERIC_HOSTNAME="summit"
BR2_TARGET_GENERIC_ISSUE="Laird Connectivity"
BR2_ROOTFS_DEVICE_CREATION_DYNAMIC_EUDEV=y
BR2_ROOTFS_MERGED_USR=y
BR2_ENABLE_LOCALE_WHITELIST="en_US"
BR2_ROOTFS_POST_BUILD_SCRIPT="$(BR2_EXTERNAL_LRD_SOM_PATH)/board/wb40n_rdvk/post_build.sh"
BR2_ROOTFS_POST_IMAGE_SCRIPT="$(BR2_EXTERNAL_LRD_SOM_PATH)/board/wb40n_rdvk/post_image.sh"
BR2_ROOTFS_POST_SCRIPT_ARGS="wb40n"
BR2_LINUX_KERNEL=y
BR2_LINUX_KERNEL_CUSTOM_VERSION=y
BR2_LINUX_KERNEL_CUSTOM_VERSION_VALUE="3.2.102"
BR2_LINUX_KERNEL_PATCH="$(BR2_EXTERNAL_LRD_SOM_PATH)/board/wb40n_rdvk/patches/linux"
BR2_LINUX_KERNEL_USE_CUSTOM_CONFIG=y
BR2_LINUX_KERNEL_CUSTOM_CONFIG_FILE="$(BR2_EXTERNAL_LRD_SOM_PATH)/board/wb40n_rdvk/patches/linux/wb40n_defconfig"
BR2_LINUX_KERNEL_UIMAGE=y
BR2_LINUX_KERNEL_LZMA=y
BR2_LINUX_KERNEL_UIMAGE_LOADADDR="0x21000000"
BR2_PACKAGE_BUSYBOX_CONFIG="$(BR2_EXTERNAL_LRD_SOM_PATH)/board/wb40n_rdvk/patches/busybox.config"
BR2_PACKAGE_BUSYBOX_SHOW_OTHERS=y
BR2_PACKAGE_LSOF=y
BR2_PACKAGE_MTD=y
# BR2_PACKAGE_MTD_MTD_DEBUG is not set
# BR2_PACKAGE_MTD_UBINIZE is not set
BR2_PACKAGE_LIBUBOOTENV=y
BR2_PACKAGE_LRD_LINUX_BACKPORTS=y
BR2_PACKAGE_LRD_LINUX_BACKPORTS_DEFCONFIG="bdimx6"
BR2_PACKAGE_USBUTILS=y
BR2_PACKAGE_LIBOPENSSL_BIN=y
# BR2_PACKAGE_LIBOPENSSL_ENABLE_IDEA is not set
# BR2_PACKAGE_LIBOPENSSL_ENABLE_SEED is not set
# BR2_PACKAGE_LIBOPENSSL_ENABLE_WHIRLPOOL is not set
# BR2_PACKAGE_LIBOPENSSL_ENABLE_BLOWFISH is not set
# BR2_PACKAGE_LIBOPENSSL_ENABLE_SSL3 is not set
# BR2_PACKAGE_LIBOPENSSL_ENABLE_WEAK_SSL is not set
# BR2_PACKAGE_LIBOPENSSL_ENABLE_CAST is not set
# BR2_PACKAGE_LIBOPENSSL_UNSECURE is not set
# BR2_PACKAGE_LIBOPENSSL_ENABLE_COMP is not set
BR2_PACKAGE_LIBOPENSSL_3_0=y
BR2_PACKAGE_LIBEDIT=y
BR2_PACKAGE_BLUEZ4_UTILS=y
BR2_PACKAGE_LRD_BRCM_PATCHRAM_PLUS=y
BR2_PACKAGE_BRIDGE_UTILS=y
BR2_PACKAGE_CHRONY=y
BR2_PACKAGE_DNSMASQ=y
BR2_PACKAGE_DNSMASQ_DNSSEC=y
BR2_PACKAGE_DROPBEAR=y
BR2_PACKAGE_IPERF=y
BR2_PACKAGE_IW=y
BR2_PACKAGE_NETSTAT_NAT=y
BR2_PACKAGE_TCPDUMP=y
BR2_PACKAGE_WGET=y
BR2_PACKAGE_WIRELESS_REGDB=y
BR2_PACKAGE_KMOD_TOOLS=y
# BR2_PACKAGE_URANDOM_SCRIPTS is not set
BR2_PACKAGE_UTIL_LINUX_HWCLOCK=y
# BR2_TARGET_ROOTFS_TAR is not set
BR2_TARGET_ROOTFS_UBI=y
BR2_TARGET_ROOTFS_UBIFS_MAXLEBCNT=955
BR2_TARGET_AT91BOOTSTRAP3=y
BR2_TARGET_AT91BOOTSTRAP3_LATEST_VERSION_3X=y
BR2_TARGET_AT91BOOTSTRAP3_DEFCONFIG="wb40n_uboot"
BR2_TARGET_UBOOT=y
BR2_TARGET_UBOOT_BUILD_SYSTEM_KCONFIG=y
BR2_TARGET_UBOOT_CUSTOM_VERSION=y
BR2_TARGET_UBOOT_CUSTOM_VERSION_VALUE="2023.04"
BR2_TARGET_UBOOT_BOARD_DEFCONFIG="wb40n"
BR2_TARGET_UBOOT_NEEDS_DTC=y
BR2_PACKAGE_LRD_WIRELESS_REGDB=y
BR2_PACKAGE_MC_MINT=y
BR2_PACKAGE_LRD_AUTOMOUNT=y
BR2_PACKAGE_SDCSUPP=y
BR2_PACKAGE_SDCSUPP_WPA_CLI=y
BR2_PACKAGE_SDCSUPP_WPA_PASSPHRASE=y
BR2_PACKAGE_LAIRD_FIRMWARE=y
BR2_PACKAGE_LAIRD_FIRMWARE_AR6003=y
BR2_PACKAGE_LAIRD_FIRMWARE_AR6004=y
BR2_PACKAGE_LAIRD_FIRMWARE_BCM4343=y
BR2_PACKAGE_LAIRD_FIRMWARE_BCM43439=y
BR2_PACKAGE_LAIRD_FIRMWARE_BCM4339=y
BR2_PACKAGE_LAIRD_FIRMWARE_BCM4373_SDIO_DIV=y
BR2_PACKAGE_LAIRD_FIRMWARE_BCM4373_SDIO_SA=y
BR2_PACKAGE_LAIRD_FIRMWARE_BCM4373_SDIO_SA_M2=y
BR2_PACKAGE_LAIRD_FIRMWARE_BCM4373_USB_DIV=y
BR2_PACKAGE_LAIRD_FIRMWARE_BCM4373_USB_SA=y
BR2_PACKAGE_LAIRD_FIRMWARE_BCM4373_USB_SA_M2=y
BR2_PACKAGE_LAIRD_FIRMWARE_LRDMWL_60_SDIO_UART=y
BR2_PACKAGE_LAIRD_FIRMWARE_LRDMWL_60_SDIO_SDIO=y
BR2_PACKAGE_LAIRD_FIRMWARE_LRDMWL_60_USB_UART=y
BR2_PACKAGE_LAIRD_FIRMWARE_LRDMWL_60_USB_USB=y
BR2_PACKAGE_LAIRD_FIRMWARE_BT=y
BR2_PACKAGE_ADAPTIVE_WW=y
```

## configs/wb40n_rdvk_defconfig
```kconfig
BR2_arm=y
BR2_WGET="wget --passive-ftp -nd"
BR2_DL_DIR="$(HOME)/.br2_dl_dir"
BR2_CCACHE=y
BR2_CCACHE_DIR="$(BR2_DL_DIR)/.buildroot-ccache"
BR2_PACKAGE_OVERRIDE_FILE="$(BR2_EXTERNAL_LRD_SOM_PATH)/board/wb40n_rdvk/wb40n-local.mk"
BR2_PER_PACKAGE_DIRECTORIES=y
BR2_TOOLCHAIN_EXTERNAL=y
BR2_TOOLCHAIN_EXTERNAL_LAIRD_ARM=y
BR2_TARGET_GENERIC_HOSTNAME="summit"
BR2_TARGET_GENERIC_ISSUE="Laird Connectivity"
BR2_ROOTFS_DEVICE_CREATION_DYNAMIC_EUDEV=y
BR2_ROOTFS_MERGED_USR=y
BR2_ENABLE_LOCALE_WHITELIST="en_US"
BR2_ROOTFS_POST_BUILD_SCRIPT="$(BR2_EXTERNAL_LRD_SOM_PATH)/board/wb40n_rdvk/post_build.sh"
BR2_ROOTFS_POST_IMAGE_SCRIPT="$(BR2_EXTERNAL_LRD_SOM_PATH)/board/wb40n_rdvk/post_image.sh"
BR2_ROOTFS_POST_SCRIPT_ARGS="wb40n"
BR2_LINUX_KERNEL=y
BR2_LINUX_KERNEL_DEFCONFIG="wb40n_rdvk"
BR2_LINUX_KERNEL_APPENDED_UIMAGE=y
BR2_LINUX_KERNEL_LZMA=y
BR2_LINUX_KERNEL_UIMAGE_LOADADDR="0x21000000"
BR2_LINUX_KERNEL_INTREE_DTS_NAME="at91-wb40n"
BR2_PACKAGE_BUSYBOX_CONFIG="$(BR2_EXTERNAL_LRD_SOM_PATH)/board/configs-common/busybox_legacy.config"
BR2_PACKAGE_BUSYBOX_SHOW_OTHERS=y
BR2_PACKAGE_LSOF=y
BR2_PACKAGE_MTD=y
# BR2_PACKAGE_MTD_MTD_DEBUG is not set
# BR2_PACKAGE_MTD_UBINIZE is not set
BR2_PACKAGE_LIBUBOOTENV=y
BR2_PACKAGE_USBUTILS=y
BR2_PACKAGE_LIBOPENSSL_BIN=y
BR2_PACKAGE_LIBEDIT=y
BR2_PACKAGE_BLUEZ5_UTILS=y
BR2_PACKAGE_BLUEZ5_UTILS_OBEX=y
BR2_PACKAGE_BLUEZ5_UTILS_CLIENT=y
BR2_PACKAGE_BLUEZ5_UTILS_TOOLS=y
BR2_PACKAGE_BLUEZ5_UTILS_DEPRECATED=y
BR2_PACKAGE_BLUEZ5_UTILS_TEST=y
BR2_PACKAGE_LRD_BRCM_PATCHRAM_PLUS=y
BR2_PACKAGE_BRIDGE_UTILS=y
BR2_PACKAGE_CHRONY=y
BR2_PACKAGE_DNSMASQ=y
BR2_PACKAGE_DNSMASQ_DNSSEC=y
BR2_PACKAGE_DROPBEAR=y
BR2_PACKAGE_ETHTOOL=y
# BR2_PACKAGE_IFUPDOWN_SCRIPTS is not set
BR2_PACKAGE_IPERF=y
BR2_PACKAGE_IPROUTE2=y
BR2_PACKAGE_IPTABLES=y
BR2_PACKAGE_IW=y
BR2_PACKAGE_NETSTAT_NAT=y
BR2_PACKAGE_TCPDUMP=y
BR2_PACKAGE_WGET=y
BR2_PACKAGE_WIRELESS_REGDB=y
BR2_PACKAGE_KMOD_TOOLS=y
BR2_PACKAGE_UTIL_LINUX_HWCLOCK=y
BR2_PACKAGE_LESS=y
# BR2_TARGET_ROOTFS_TAR is not set
BR2_TARGET_ROOTFS_UBI=y
BR2_TARGET_ROOTFS_UBIFS_MAXLEBCNT=955
BR2_TARGET_AT91BOOTSTRAP3=y
BR2_TARGET_AT91BOOTSTRAP3_LATEST_VERSION_3X=y
BR2_TARGET_AT91BOOTSTRAP3_DEFCONFIG="wb40n_uboot"
BR2_TARGET_UBOOT=y
BR2_TARGET_UBOOT_BUILD_SYSTEM_KCONFIG=y
BR2_TARGET_UBOOT_CUSTOM_VERSION=y
BR2_TARGET_UBOOT_CUSTOM_VERSION_VALUE="2022.10"
BR2_TARGET_UBOOT_BOARD_DEFCONFIG="wb40n"
BR2_TARGET_UBOOT_NEEDS_DTC=y
BR2_PACKAGE_LRD_WIRELESS_REGDB=y
BR2_PACKAGE_MC_MINT=y
BR2_PACKAGE_LRD_NETWORK_MANAGER=y
BR2_PACKAGE_LRD_AUTOMOUNT=y
BR2_PACKAGE_LRD_USBGADGET=y
BR2_PACKAGE_LRD_USBGADGET_TYPE_NCM=y
BR2_PACKAGE_SDCSUPP=y
BR2_PACKAGE_SDCSUPP_WPA_CLI=y
BR2_PACKAGE_SDCSUPP_WPA_PASSPHRASE=y
BR2_PACKAGE_LAIRD_FIRMWARE=y
BR2_PACKAGE_LAIRD_FIRMWARE_AR6004=y
BR2_PACKAGE_LAIRD_FIRMWARE_BCM4343=y
BR2_PACKAGE_LAIRD_FIRMWARE_BCM4339=y
BR2_PACKAGE_LAIRD_FIRMWARE_BCM4373_SDIO_DIV=y
BR2_PACKAGE_LAIRD_FIRMWARE_BCM4373_USB_DIV=y
BR2_PACKAGE_LAIRD_FIRMWARE_LRDMWL_60_SDIO_UART=y
BR2_PACKAGE_LAIRD_FIRMWARE_LRDMWL_60_SDIO_SDIO=y
BR2_PACKAGE_LAIRD_FIRMWARE_LRDMWL_60_USB_UART=y
BR2_PACKAGE_LAIRD_FIRMWARE_LRDMWL_60_USB_USB=y
BR2_PACKAGE_LAIRD_FIRMWARE_BT=y
BR2_PACKAGE_ADAPTIVE_WW=y
```

## configs/wb45n_legacy_defconfig
```kconfig
BR2_arm=y
BR2_TOOLCHAIN_EXTERNAL=y
BR2_TOOLCHAIN_EXTERNAL_LAIRD_ARM=y
BR2_WGET="wget --passive-ftp -nd"
BR2_DL_DIR="$(HOME)/.br2_dl_dir"
BR2_CCACHE=y
BR2_CCACHE_DIR="$(BR2_DL_DIR)/.buildroot-ccache"
BR2_PACKAGE_OVERRIDE_FILE="$(BR2_EXTERNAL_LRD_SOM_PATH)/board/wb45n/wb45n-local.mk"
BR2_PER_PACKAGE_DIRECTORIES=y
BR2_TARGET_GENERIC_HOSTNAME="summit"
BR2_TARGET_GENERIC_ISSUE="Laird Connectivity"
BR2_ROOTFS_DEVICE_CREATION_DYNAMIC_EUDEV=y
BR2_ROOTFS_DEVICE_TABLE="$(BR2_EXTERNAL_LRD_SOM_PATH)/board/device_table.txt"
BR2_ROOTFS_MERGED_USR=y
BR2_TARGET_GENERIC_ROOT_PASSWD="summit"
BR2_ENABLE_LOCALE_WHITELIST="en_US"
BR2_ROOTFS_POST_BUILD_SCRIPT="$(BR2_EXTERNAL_LRD_SOM_PATH)/board/wb45n/post_build.sh"
BR2_ROOTFS_POST_IMAGE_SCRIPT="$(BR2_EXTERNAL_LRD_SOM_PATH)/board/wb45n/post_image.sh"
BR2_ROOTFS_POST_SCRIPT_ARGS="wb45n"
BR2_LINUX_KERNEL=y
BR2_LINUX_KERNEL_DEFCONFIG="wb45n"
BR2_LINUX_KERNEL_IMAGE_TARGET_CUSTOM=y
BR2_LINUX_KERNEL_IMAGE_TARGET_NAME="Image"
BR2_LINUX_KERNEL_DTS_SUPPORT=y
BR2_LINUX_KERNEL_INTREE_DTS_NAME="at91-wb45n"
BR2_PACKAGE_BUSYBOX_CONFIG="$(BR2_EXTERNAL_LRD_SOM_PATH)/board/configs-common/busybox_legacy.config"
BR2_PACKAGE_BUSYBOX_SHOW_OTHERS=y
BR2_PACKAGE_LSOF=y
BR2_PACKAGE_MTD=y
# BR2_PACKAGE_MTD_MTD_DEBUG is not set
# BR2_PACKAGE_MTD_UBINIZE is not set
BR2_PACKAGE_LIBUBOOTENV=y
BR2_PACKAGE_USBUTILS=y
BR2_PACKAGE_LIBOPENSSL_BIN=y
BR2_PACKAGE_BLUEZ5_UTILS=y
BR2_PACKAGE_BLUEZ5_UTILS_CLIENT=y
BR2_PACKAGE_BLUEZ5_UTILS_TOOLS=y
BR2_PACKAGE_BLUEZ5_UTILS_DEPRECATED=y
BR2_PACKAGE_BRIDGE_UTILS=y
BR2_PACKAGE_CHRONY=y
BR2_PACKAGE_CONNTRACK_TOOLS=y
BR2_PACKAGE_EBTABLES=y
BR2_PACKAGE_EBTABLES_UTILS_RESTORE=y
BR2_PACKAGE_ETHTOOL=y
# BR2_PACKAGE_IFUPDOWN_SCRIPTS is not set
BR2_PACKAGE_IPERF=y
BR2_PACKAGE_IPROUTE2=y
BR2_PACKAGE_IPTABLES=y
BR2_PACKAGE_IW=y
BR2_PACKAGE_OPENSSH=y
BR2_PACKAGE_PPPD=y
# BR2_PACKAGE_PPPD_OVERWRITE_RESOLV_CONF is not set
BR2_PACKAGE_TCPDUMP=y
BR2_PACKAGE_WGET=y
# BR2_PACKAGE_URANDOM_SCRIPTS is not set
# BR2_TARGET_ROOTFS_TAR is not set
BR2_TARGET_ROOTFS_UBI=y
BR2_TARGET_ROOTFS_UBI_SUBSIZE=0
BR2_TARGET_ROOTFS_UBIFS_LEBSIZE=0x1f000
BR2_TARGET_ROOTFS_UBIFS_MAXLEBCNT=955
BR2_TARGET_AT91BOOTSTRAP3=y
BR2_TARGET_AT91BOOTSTRAP3_LATEST_VERSION_3X=y
BR2_TARGET_AT91BOOTSTRAP3_DEFCONFIG="wb45n_uboot"
BR2_TARGET_UBOOT=y
BR2_TARGET_UBOOT_BUILD_SYSTEM_KCONFIG=y
BR2_TARGET_UBOOT_CUSTOM_VERSION=y
BR2_TARGET_UBOOT_CUSTOM_VERSION_VALUE="2022.10"
BR2_TARGET_UBOOT_BOARD_DEFCONFIG="wb45n"
BR2_TARGET_UBOOT_NEEDS_DTC=y
BR2_PACKAGE_HOST_MTD=y
BR2_LRD_WB45N_LEGACY_RADIO=y
BR2_PACKAGE_DCAS=y
BR2_PACKAGE_LRD_AUTOMOUNT=y
# BR2_PACKAGE_LRD_AUTOMOUNT_MMC is not set
BR2_PACKAGE_LRD_USBGADGET=y
BR2_PACKAGE_WEBLCM_LEGACY=y
```

## configs/wb50n_rdvk_defconfig
```kconfig
BR2_arm=y
BR2_cortex_a5=y
BR2_ARM_ENABLE_VFP=y
BR2_ARM_INSTRUCTIONS_THUMB2=y
BR2_TOOLCHAIN_EXTERNAL=y
BR2_TOOLCHAIN_EXTERNAL_LAIRD_ARM=y
BR2_WGET="wget --passive-ftp -nd"
BR2_DL_DIR="$(HOME)/.br2_dl_dir"
BR2_CCACHE=y
BR2_CCACHE_DIR="$(BR2_DL_DIR)/.buildroot-ccache"
BR2_PACKAGE_OVERRIDE_FILE="$(BR2_EXTERNAL_LRD_SOM_PATH)/board/wb50n_rdvk/wb50n_rdvk-local.mk"
BR2_PER_PACKAGE_DIRECTORIES=y
BR2_TIME_BITS_64=y
BR2_TARGET_GENERIC_HOSTNAME="summit"
BR2_TARGET_GENERIC_ISSUE="Laird Connectivity"
BR2_ROOTFS_DEVICE_CREATION_DYNAMIC_EUDEV=y
BR2_ROOTFS_DEVICE_TABLE="$(BR2_EXTERNAL_LRD_SOM_PATH)/board/device_table.txt"
BR2_ROOTFS_MERGED_USR=y
BR2_ENABLE_LOCALE_WHITELIST="en_US"
BR2_ROOTFS_POST_BUILD_SCRIPT="$(BR2_EXTERNAL_LRD_SOM_PATH)/board/wb50n_rdvk/post_build.sh"
BR2_ROOTFS_POST_IMAGE_SCRIPT="$(BR2_EXTERNAL_LRD_SOM_PATH)/board/wb50n_rdvk/post_image.sh"
BR2_ROOTFS_POST_SCRIPT_ARGS="wb50n"
BR2_LINUX_KERNEL=y
BR2_LINUX_KERNEL_DEFCONFIG="wb50n_rdvk"
BR2_LINUX_KERNEL_IMAGE_TARGET_CUSTOM=y
BR2_LINUX_KERNEL_IMAGE_TARGET_NAME="Image"
BR2_LINUX_KERNEL_DTS_SUPPORT=y
BR2_LINUX_KERNEL_INTREE_DTS_NAME="at91-wb50n_rdvk"
BR2_PACKAGE_BUSYBOX_CONFIG="$(BR2_EXTERNAL_LRD_SOM_PATH)/board/configs-common/busybox_legacy.config"
BR2_PACKAGE_BUSYBOX_SHOW_OTHERS=y
BR2_PACKAGE_LSOF=y
BR2_PACKAGE_MTD=y
# BR2_PACKAGE_MTD_MTD_DEBUG is not set
# BR2_PACKAGE_MTD_UBINIZE is not set
BR2_PACKAGE_LIBUBOOTENV=y
BR2_PACKAGE_USBUTILS=y
BR2_PACKAGE_LIBOPENSSL_BIN=y
# BR2_PACKAGE_LIBOPENSSL_ENABLE_IDEA is not set
# BR2_PACKAGE_LIBOPENSSL_ENABLE_SEED is not set
# BR2_PACKAGE_LIBOPENSSL_ENABLE_WHIRLPOOL is not set
# BR2_PACKAGE_LIBOPENSSL_ENABLE_BLOWFISH is not set
# BR2_PACKAGE_LIBOPENSSL_ENABLE_SSL3 is not set
# BR2_PACKAGE_LIBOPENSSL_ENABLE_WEAK_SSL is not set
# BR2_PACKAGE_LIBOPENSSL_ENABLE_CAST is not set
# BR2_PACKAGE_LIBOPENSSL_UNSECURE is not set
# BR2_PACKAGE_LIBOPENSSL_ENABLE_COMP is not set
BR2_PACKAGE_LIBOPENSSL_3_0=y
BR2_PACKAGE_LIBEDIT=y
BR2_PACKAGE_BLUEZ5_UTILS=y
BR2_PACKAGE_BLUEZ5_UTILS_CLIENT=y
BR2_PACKAGE_BLUEZ5_UTILS_TOOLS=y
BR2_PACKAGE_BLUEZ5_UTILS_DEPRECATED=y
BR2_PACKAGE_BLUEZ5_UTILS_TEST=y
BR2_PACKAGE_LRD_BRCM_PATCHRAM_PLUS=y
BR2_PACKAGE_CHRONY=y
BR2_PACKAGE_DNSMASQ=y
BR2_PACKAGE_DROPBEAR=y
BR2_PACKAGE_ETHTOOL=y
# BR2_PACKAGE_IFUPDOWN_SCRIPTS is not set
BR2_PACKAGE_IPERF=y
BR2_PACKAGE_IPROUTE2=y
BR2_PACKAGE_IPTABLES=y
BR2_PACKAGE_IW=y
BR2_PACKAGE_PPPD=y
# BR2_PACKAGE_PPPD_OVERWRITE_RESOLV_CONF is not set
BR2_PACKAGE_TCPDUMP=y
BR2_PACKAGE_WGET=y
BR2_PACKAGE_WIRELESS_REGDB=y
BR2_PACKAGE_KMOD_TOOLS=y
# BR2_PACKAGE_URANDOM_SCRIPTS is not set
BR2_PACKAGE_UTIL_LINUX_HWCLOCK=y
BR2_PACKAGE_LESS=y
# BR2_TARGET_ROOTFS_TAR is not set
BR2_TARGET_ROOTFS_UBI=y
BR2_TARGET_ROOTFS_UBI_SUBSIZE=0
BR2_TARGET_ROOTFS_UBIFS_LEBSIZE=0x1f000
BR2_TARGET_ROOTFS_UBIFS_MAXLEBCNT=955
BR2_TARGET_AT91BOOTSTRAP3=y
BR2_TARGET_AT91BOOTSTRAP3_LATEST_VERSION_3X=y
BR2_TARGET_AT91BOOTSTRAP3_DEFCONFIG="wb50n_uboot"
BR2_TARGET_UBOOT=y
BR2_TARGET_UBOOT_BUILD_SYSTEM_KCONFIG=y
BR2_TARGET_UBOOT_CUSTOM_VERSION=y
BR2_TARGET_UBOOT_CUSTOM_VERSION_VALUE="2023.04"
BR2_TARGET_UBOOT_BOARD_DEFCONFIG="wb50n"
BR2_TARGET_UBOOT_NEEDS_DTC=y
BR2_PACKAGE_HOST_MTD=y
BR2_PACKAGE_LRD_WIRELESS_REGDB=y
BR2_PACKAGE_MC_MINT=y
BR2_PACKAGE_LRD_NETWORK_MANAGER=y
BR2_PACKAGE_LRD_AUTOMOUNT=y
BR2_PACKAGE_LRD_USBGADGET=y
BR2_PACKAGE_LRD_USBGADGET_TYPE_NCM=y
BR2_PACKAGE_SDCSUPP=y
BR2_PACKAGE_SDCSUPP_WPA_CLI=y
BR2_PACKAGE_SDCSUPP_WPA_PASSPHRASE=y
BR2_PACKAGE_LAIRD_FIRMWARE=y
BR2_PACKAGE_LAIRD_FIRMWARE_AR6003=y
BR2_PACKAGE_LAIRD_FIRMWARE_AR6004=y
BR2_PACKAGE_LAIRD_FIRMWARE_BCM4343=y
BR2_PACKAGE_LAIRD_FIRMWARE_BCM43439=y
BR2_PACKAGE_LAIRD_FIRMWARE_BCM4339=y
BR2_PACKAGE_LAIRD_FIRMWARE_BCM4373_SDIO_DIV=y
BR2_PACKAGE_LAIRD_FIRMWARE_BCM4373_SDIO_SA=y
BR2_PACKAGE_LAIRD_FIRMWARE_BCM4373_SDIO_SA_M2=y
BR2_PACKAGE_LAIRD_FIRMWARE_BCM4373_USB_DIV=y
BR2_PACKAGE_LAIRD_FIRMWARE_BCM4373_USB_SA=y
BR2_PACKAGE_LAIRD_FIRMWARE_BCM4373_USB_SA_M2=y
BR2_PACKAGE_LAIRD_FIRMWARE_LRDMWL_60_SDIO_UART=y
BR2_PACKAGE_LAIRD_FIRMWARE_LRDMWL_60_SDIO_SDIO=y
BR2_PACKAGE_LAIRD_FIRMWARE_LRDMWL_60_USB_UART=y
BR2_PACKAGE_LAIRD_FIRMWARE_LRDMWL_60_USB_USB=y
BR2_PACKAGE_LAIRD_FIRMWARE_BT=y
BR2_PACKAGE_ADAPTIVE_WW=y
BR2_PACKAGE_WAVEAGENT=y
```

## configs/wb50nsd_sysd-wbx3_defconfig
```kconfig
BR2_arm=y
BR2_cortex_a5=y
BR2_ARM_ENABLE_VFP=y
BR2_ARM_INSTRUCTIONS_THUMB2=y
BR2_TOOLCHAIN_EXTERNAL=y
BR2_TOOLCHAIN_EXTERNAL_LAIRD_ARM=y
BR2_WGET="wget --passive-ftp -nd"
BR2_DL_DIR="$(HOME)/.br2_dl_dir"
BR2_CCACHE=y
BR2_CCACHE_DIR="$(BR2_DL_DIR)/.buildroot-ccache"
BR2_PACKAGE_OVERRIDE_FILE="$(BR2_EXTERNAL_LRD_SOM_PATH)/board/wb50n_sysd/wb50n_sysd-local.mk"
BR2_PER_PACKAGE_DIRECTORIES=y
BR2_TIME_BITS_64=y
BR2_TARGET_GENERIC_HOSTNAME="summit"
BR2_TARGET_GENERIC_ISSUE="Laird Connectivity"
BR2_ROOTFS_DEVICE_CREATION_DYNAMIC_EUDEV=y
BR2_ROOTFS_DEVICE_TABLE="$(BR2_EXTERNAL_LRD_SOM_PATH)/board/device_table.txt"
BR2_ROOTFS_MERGED_USR=y
# BR2_TARGET_GENERIC_GETTY is not set
BR2_ENABLE_LOCALE_WHITELIST="en_US"
BR2_ROOTFS_POST_BUILD_SCRIPT="$(BR2_EXTERNAL_LRD_SOM_PATH)/board/wb50n_sysd/post_build.sh"
BR2_ROOTFS_POST_IMAGE_SCRIPT="$(BR2_EXTERNAL_LRD_SOM_PATH)/board/wb50n_sysd/post_image.sh"
BR2_ROOTFS_POST_SCRIPT_ARGS="wb50nsd $(BR2_EXTERNAL_LRD_SOM_PATH)/board/configs-common/keys"
BR2_LINUX_KERNEL=y
BR2_LINUX_KERNEL_DEFCONFIG="wb50n_sysd"
BR2_LINUX_KERNEL_IMAGE_TARGET_CUSTOM=y
BR2_LINUX_KERNEL_IMAGE_TARGET_NAME="Image"
BR2_LINUX_KERNEL_DTS_SUPPORT=y
BR2_LINUX_KERNEL_INTREE_DTS_NAME="at91-wb50n_sysd"
BR2_PACKAGE_BUSYBOX_CONFIG="$(BR2_EXTERNAL_LRD_SOM_PATH)/board/configs-common/busybox_legacy.config"
BR2_PACKAGE_MTD=y
# BR2_PACKAGE_MTD_MTD_DEBUG is not set
# BR2_PACKAGE_MTD_UBINIZE is not set
# BR2_PACKAGE_EUDEV_ENABLE_HWDB is not set
BR2_PACKAGE_LIBUBOOTENV=y
BR2_PACKAGE_ZLIB=y
BR2_PACKAGE_CA_CERTIFICATES=y
BR2_PACKAGE_OPENSSL=y
BR2_PACKAGE_LIBOPENSSL_BIN=y
# BR2_PACKAGE_LIBOPENSSL_ENABLE_IDEA is not set
# BR2_PACKAGE_LIBOPENSSL_ENABLE_SEED is not set
# BR2_PACKAGE_LIBOPENSSL_ENABLE_WHIRLPOOL is not set
# BR2_PACKAGE_LIBOPENSSL_ENABLE_BLOWFISH is not set
# BR2_PACKAGE_LIBOPENSSL_ENABLE_SSL3 is not set
# BR2_PACKAGE_LIBOPENSSL_ENABLE_WEAK_SSL is not set
# BR2_PACKAGE_LIBOPENSSL_ENABLE_CAST is not set
# BR2_PACKAGE_LIBOPENSSL_UNSECURE is not set
# BR2_PACKAGE_LIBOPENSSL_ENABLE_COMP is not set
BR2_PACKAGE_LIBOPENSSL_3_0=y
BR2_PACKAGE_LIBCURL=y
BR2_PACKAGE_LIBCURL_CURL=y
# BR2_PACKAGE_LIBCURL_PROXY_SUPPORT is not set
# BR2_PACKAGE_LIBCURL_COOKIES_SUPPORT is not set
# BR2_PACKAGE_LIBCURL_EXTRA_PROTOCOLS_FEATURES is not set
# BR2_PACKAGE_IFUPDOWN_SCRIPTS is not set
BR2_PACKAGE_IPROUTE2=y
# BR2_PACKAGE_URANDOM_SCRIPTS is not set
BR2_PACKAGE_SWUPDATE=y
BR2_PACKAGE_SWUPDATE_CONFIG="$(BR2_EXTERNAL_LRD_SOM_PATH)/board/configs-common/swupdate.config"
# BR2_PACKAGE_SWUPDATE_WEBSERVER is not set
BR2_TARGET_UBOOT=y
BR2_TARGET_UBOOT_BUILD_SYSTEM_KCONFIG=y
BR2_TARGET_UBOOT_CUSTOM_VERSION=y
BR2_TARGET_UBOOT_CUSTOM_VERSION_VALUE="2023.04"
BR2_TARGET_UBOOT_BOARD_DEFCONFIG="wb50nsd_sysd"
BR2_TARGET_UBOOT_NEEDS_DTC=y
# BR2_TARGET_UBOOT_FORMAT_BIN is not set
BR2_TARGET_UBOOT_FORMAT_INITIAL_ENV=y
BR2_TARGET_UBOOT_FORMAT_CUSTOM=y
BR2_TARGET_UBOOT_FORMAT_CUSTOM_NAME="u-boot.dtb u-boot-nodtb.bin"
BR2_TARGET_UBOOT_SPL=y
BR2_TARGET_UBOOT_SPL_NAME="spl/u-boot-spl-nodtb.bin spl/u-boot-spl.dtb"
BR2_PACKAGE_HOST_CRYPTSETUP=y
BR2_PACKAGE_HOST_E2FSPROGS=y
BR2_PACKAGE_HOST_MTD=y
```

## package-3rd-party/easycwmp/Config.in
```kconfig
config BR2_PACKAGE_EASYCWMP
	bool "easycwmp"
	select BR2_PACKAGE_MICROXML
	select BR2_PACKAGE_LIBUCI
	select BR2_PACKAGE_UBUS
	help
      EasyCwmp - TR069 Client
```

## package-3rd-party/gattlib/Config.in
```kconfig
config BR2_PACKAGE_GATTLIB
	bool "gattlib"
	select BR2_PACKAGE_BLUEZ5_UTILS
	help
	  GattLib is a library used to access Generic Attribute Profile (GATT)
	  protocol of BLE (Bluetooth Low Energy) devices.
	  It has been introduced to allow to build applications that could easily
	  communicate with BLE devices.

	  https://github.com/labapart/gattlib
```

## package-3rd-party/lora-gateway-bridge/Config.in
```kconfig
config BR2_PACKAGE_LORA_GATEWAY_BRIDGE
	bool "lora-gateway-bridge"
	depends on BR2_PACKAGE_HOST_GO_ARCH_SUPPORTS
    select BR2_PACKAGE_LORA_PACKET_FORWARDER
	help
      Shim MQTT to the semtech packet forwarder.
```

## package-3rd-party/python-awscrt/Config.in
```kconfig
config BR2_PACKAGE_PYTHON_AWSCRT
	bool "python-awscrt"
	help
	  A common runtime for AWS Python projects.

	  https://github.com/awslabs/aws-crt-python
```

## package-3rd-party/python-awsiotsdk/Config.in
```kconfig
config BR2_PACKAGE_PYTHON_AWSIOTSDK
	bool "python-awsiotsdk"
	select BR2_PACKAGE_PYTHON_AWSCRT # runtime
	help
	  AWS IoT SDK based on the AWS Common Runtime.

	  https://github.com/aws/aws-iot-device-sdk-python-v2
```

## package-3rd-party/python-gatt/Config.in
```kconfig
config BR2_PACKAGE_PYTHON_GATT
	bool "python-gatt"
	depends on BR2_PACKAGE_PYTHON3
	depends on BR2_PACKAGE_DBUS_PYTHON
	depends on BR2_PACKAGE_BLUEZ5_UTILS
	help
	  Bluetooth GATT SDK for Python
	  https://github.com/getsenic/gatt-python
```

## package-3rd-party/ti-rogue-km/Config.in
```kconfig
comment "ti-rogue-km needs a Linux kernel to be built"
	depends on BR2_aarch64
	depends on !BR2_LINUX_KERNEL

config BR2_PACKAGE_TI_ROGUE_KM
	bool "ti-rogue-km"
	depends on BR2_LINUX_KERNEL && BR2_aarch64
	select BR2_LINUX_NEEDS_MODULES
	help
	  Kernel modules for TI SoCs with Rogue GPU.
	  This package supports AM62, J721E, J721S2, and J784S4
	  SoCs only.

	  Note: it needs a TI specific kernel to build properly.

	  https://git.ti.com/cgit/graphics/ti-img-rogue-driver

if BR2_PACKAGE_TI_ROGUE_KM

config BR2_TARGET_TI_ROGUE_KM_TARGET_PRODUCT
	string "KM driver target product"
	default "am62_linux"
	help
	  Select target product to be used for KM driver. This needs to
	  match one of the SoC-specific folders within the build/linux
	  folder of the ti-img-rogue-driver Git repository.

endif
```

## package-3rd-party/ttn-forwarder/Config.in
```kconfig
config BR2_PACKAGE_TTN_FORWARDER
	bool "ttn-forwarder"
	depends on BR2_PACKAGE_HOST_GO_ARCH_SUPPORTS
	help
      Packet forwarder to make the link between a LoRa concentrator
      and The Things Network's backend.

if BR2_PACKAGE_TTN_FORWARDER

config BR2_TTN_FORWARDER_PLATFORM
	string "Platform the ttn forwarder will run on"
	help
	  Specify the platform thet the forwarder will run on.
	  E.g. rg1xx
endif
```

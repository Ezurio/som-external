## configs/adaptive_bt-aarch64_defconfig
```kconfig
BR2_aarch64=y
BR2_WGET="wget --passive-ftp -nd"
BR2_DL_DIR="$(HOME)/.br2_dl_dir"
BR2_CCACHE=y
BR2_CCACHE_DIR="$(BR2_DL_DIR)/.buildroot-ccache"
BR2_PER_PACKAGE_DIRECTORIES=y
BR2_TOOLCHAIN_EXTERNAL=y
BR2_TOOLCHAIN_EXTERNAL_LAIRD_COMPONENT=y
BR2_ROOTFS_SKELETON_CUSTOM=y
BR2_ROOTFS_SKELETON_CUSTOM_PATH="$(BR2_EXTERNAL_LRD_SOM_PATH)/board/skeleton-empty"
BR2_INIT_NONE=y
BR2_ROOTFS_DEVICE_TABLE=""
BR2_ROOTFS_POST_IMAGE_SCRIPT="$(BR2_EXTERNAL_LRD_SOM_PATH)/board/adaptive_bt/post_image.sh"
# BR2_PACKAGE_BUSYBOX is not set
# BR2_TARGET_ROOTFS_TAR is not set
BR2_PACKAGE_ADAPTIVE_BT=y
```

## configs/backports-test_defconfig
```kconfig
BR2_arm=y
BR2_WGET="wget --passive-ftp -nd"
BR2_DL_DIR="$(HOME)/.br2_dl_dir"
BR2_CCACHE=y
BR2_CCACHE_DIR="$(BR2_DL_DIR)/.buildroot-ccache"
BR2_PER_PACKAGE_DIRECTORIES=y
BR2_TIME_BITS_64=y
BR2_TOOLCHAIN_EXTERNAL=y
BR2_TOOLCHAIN_EXTERNAL_LAIRD_ARM=y
BR2_ROOTFS_SKELETON_CUSTOM=y
BR2_ROOTFS_SKELETON_CUSTOM_PATH="$(BR2_EXTERNAL_LRD_SOM_PATH)/board/skeleton-empty"
BR2_INIT_NONE=y
BR2_ROOTFS_POST_IMAGE_SCRIPT="$(BR2_EXTERNAL_LRD_SOM_PATH)/board/backports/post_image_test.sh"
# BR2_PACKAGE_BUSYBOX is not set
# BR2_TARGET_ROOTFS_TAR is not set
BR2_PACKAGE_HOST_BACKPORTS_TEST=y
```

## configs/bdimx6_toolchain_defconfig
```kconfig
BR2_arm=y
BR2_cortex_a9=y
BR2_ARM_ENABLE_NEON=y
BR2_ARM_ENABLE_VFP=y
BR2_ARM_FPU_VFPV3=y
BR2_ARM_INSTRUCTIONS_THUMB2=y
BR2_TOOLCHAIN_BUILDROOT_VENDOR="laird"
BR2_KERNEL_HEADERS_VERSION=y
BR2_DEFAULT_KERNEL_VERSION="4.14"
BR2_PACKAGE_HOST_LINUX_HEADERS_CUSTOM_4_14=y
BR2_BINUTILS_VERSION_2_39_X=y
BR2_GCC_VERSION_12_X=y
BR2_TOOLCHAIN_BUILDROOT_CXX=y
BR2_GCC_ENABLE_GRAPHITE=y
BR2_GCC_ENABLE_OPENMP=y
BR2_PACKAGE_HOST_GDB=y
BR2_PACKAGE_HOST_GDB_TUI=y
BR2_GDB_VERSION_12=y
BR2_DL_DIR="$(HOME)/.br2_dl_dir"
BR2_CCACHE=y
BR2_CCACHE_DIR="$(BR2_DL_DIR)/.buildroot-ccache"
BR2_PER_PACKAGE_DIRECTORIES=y
BR2_TIME_BITS_64=y
BR2_INIT_NONE=y
# BR2_TARGET_ENABLE_ROOT_LOGIN is not set
BR2_SYSTEM_BIN_SH_NONE=y
# BR2_TARGET_GENERIC_GETTY is not set
# BR2_TARGET_GENERIC_REMOUNT_ROOTFS_RW is not set
# BR2_PACKAGE_BUSYBOX is not set
BR2_PACKAGE_GDB=y
# BR2_PACKAGE_IFUPDOWN_SCRIPTS is not set
# BR2_TARGET_ROOTFS_TAR is not set
```

## configs/firmware_defconfig
```kconfig
BR2_arm=y
BR2_TOOLCHAIN_EXTERNAL=y
BR2_TOOLCHAIN_EXTERNAL_LAIRD_COMPONENT=y
BR2_WGET="wget --passive-ftp -nd"
BR2_DL_DIR="$(HOME)/.br2_dl_dir"
BR2_CCACHE=y
BR2_CCACHE_DIR="$(BR2_DL_DIR)/.buildroot-ccache"
BR2_PER_PACKAGE_DIRECTORIES=y
BR2_ROOTFS_SKELETON_CUSTOM=y
BR2_ROOTFS_SKELETON_CUSTOM_PATH="$(BR2_EXTERNAL_LRD_SOM_PATH)/board/skeleton-empty"
BR2_INIT_NONE=y
BR2_ROOTFS_DEVICE_TABLE=""
BR2_ROOTFS_POST_IMAGE_SCRIPT="$(BR2_EXTERNAL_LRD_SOM_PATH)/board/firmware/post_image.sh"
# BR2_PACKAGE_BUSYBOX is not set
# BR2_TARGET_ROOTFS_TAR is not set
BR2_PACKAGE_LAIRD_FIRMWARE=y
BR2_PACKAGE_LAIRD_FIRMWARE_AR6003=y
BR2_PACKAGE_LAIRD_FIRMWARE_AR6004=y
BR2_PACKAGE_LAIRD_FIRMWARE_BCM4343=y
BR2_PACKAGE_LAIRD_FIRMWARE_BCM43439=y
BR2_PACKAGE_LAIRD_FIRMWARE_BCM4339=y
BR2_PACKAGE_LAIRD_FIRMWARE_BCM4373_SDIO_DIV=y
BR2_PACKAGE_LAIRD_FIRMWARE_BCM4373_SDIO_SA=y
BR2_PACKAGE_LAIRD_FIRMWARE_BCM4373_SDIO_SA_M2=y
BR2_PACKAGE_LAIRD_FIRMWARE_BCM4373_USB_DIV=y
BR2_PACKAGE_LAIRD_FIRMWARE_BCM4373_USB_SA=y
BR2_PACKAGE_LAIRD_FIRMWARE_BCM4373_USB_SA_M2=y
BR2_PACKAGE_LAIRD_FIRMWARE_CYW55573_PCIE=y
BR2_PACKAGE_LAIRD_FIRMWARE_CYW55573_SDIO=y
BR2_PACKAGE_LAIRD_FIRMWARE_CYW55513_SDIO=y
BR2_PACKAGE_LAIRD_FIRMWARE_LRDMWL_60_SDIO_UART=y
BR2_PACKAGE_LAIRD_FIRMWARE_LRDMWL_60_SDIO_SDIO=y
BR2_PACKAGE_LAIRD_FIRMWARE_LRDMWL_60_PCIE_UART=y
BR2_PACKAGE_LAIRD_FIRMWARE_LRDMWL_60_PCIE_USB=y
BR2_PACKAGE_LAIRD_FIRMWARE_LRDMWL_60_USB_UART=y
BR2_PACKAGE_LAIRD_FIRMWARE_LRDMWL_60_USB_USB=y
BR2_PACKAGE_LAIRD_FIRMWARE_LRDMWL_SOM8MP=y
BR2_PACKAGE_LAIRD_FIRMWARE_BT=y
BR2_PACKAGE_SONA_FIRMWARE_NX61X=y
BR2_PACKAGE_LAIRD_FIRMWARE_QCACLD=y
BR2_PACKAGE_LRD_WIRELESS_REGDB=y
```

## configs/laird_openssl_fips-arm-eabihf_defconfig
```kconfig
BR2_arm=y
BR2_cortex_a5=y
BR2_ARM_ENABLE_VFP=y
BR2_WGET="wget --passive-ftp -nd"
BR2_DL_DIR="$(HOME)/.br2_dl_dir"
BR2_CCACHE=y
BR2_CCACHE_DIR="$(BR2_DL_DIR)/.buildroot-ccache"
BR2_PER_PACKAGE_DIRECTORIES=y
BR2_TOOLCHAIN_EXTERNAL=y
BR2_TOOLCHAIN_EXTERNAL_LAIRD_ARM=y
BR2_ROOTFS_SKELETON_CUSTOM=y
BR2_ROOTFS_SKELETON_CUSTOM_PATH="$(BR2_EXTERNAL_LRD_SOM_PATH)/board/skeleton-empty"
BR2_INIT_NONE=y
BR2_ROOTFS_DEVICE_TABLE=""
BR2_ROOTFS_POST_IMAGE_SCRIPT="$(BR2_EXTERNAL_LRD_SOM_PATH)/board/laird-openssl-fips/post_image.sh"
# BR2_PACKAGE_BUSYBOX is not set
BR2_PACKAGE_OPENSSL=y
BR2_PACKAGE_LIBOPENSSL_BIN=y
BR2_PACKAGE_LIBOPENSSL_1_0_2=y
# BR2_TARGET_ROOTFS_TAR is not set
BR2_PACKAGE_OPENSSL_FIPS=y
BR2_PACKAGE_LAIRD_OPENSSL_FIPS=y
```

## configs/regLWBplus-arm-eabi_defconfig
```kconfig
BR2_arm=y
BR2_WGET="wget --passive-ftp -nd"
BR2_DL_DIR="$(HOME)/.br2_dl_dir"
BR2_CCACHE=y
BR2_CCACHE_DIR="$(BR2_DL_DIR)/.buildroot-ccache"
BR2_PER_PACKAGE_DIRECTORIES=y
BR2_TOOLCHAIN_EXTERNAL=y
BR2_TOOLCHAIN_EXTERNAL_LAIRD_COMPONENT=y
BR2_ROOTFS_SKELETON_CUSTOM=y
BR2_ROOTFS_SKELETON_CUSTOM_PATH="$(BR2_EXTERNAL_LRD_SOM_PATH)/board/skeleton-empty"
BR2_INIT_NONE=y
BR2_ROOTFS_DEVICE_TABLE=""
BR2_ROOTFS_POST_BUILD_SCRIPT="$(BR2_EXTERNAL_LRD_SOM_PATH)/board/mfg-reg/post_build.sh"
BR2_ROOTFS_POST_IMAGE_SCRIPT="$(BR2_EXTERNAL_LRD_SOM_PATH)/board/mfg-reg/post_image.sh"
# BR2_PACKAGE_BUSYBOX is not set
BR2_PACKAGE_BLUEZ4_UTILS=y
# BR2_TARGET_ROOTFS_TAR is not set
BR2_PACKAGE_LAIRD_FIRMWARE=y
BR2_PACKAGE_LAIRD_FIRMWARE_BCM43439_MFG=y
BR2_PACKAGE_LRU_CYPRESS=y
```

## configs/som60_rdvk_defconfig
```kconfig
BR2_arm=y
BR2_cortex_a5=y
BR2_ARM_ENABLE_VFP=y
BR2_ARM_INSTRUCTIONS_THUMB2=y
BR2_TOOLCHAIN_EXTERNAL=y
BR2_TOOLCHAIN_EXTERNAL_LAIRD_ARM=y
BR2_TOOLCHAIN_EXTERNAL_GDB_SERVER_COPY=y
BR2_WGET="wget --passive-ftp -nd"
BR2_DL_DIR="$(HOME)/.br2_dl_dir"
BR2_CCACHE=y
BR2_CCACHE_DIR="$(BR2_DL_DIR)/.buildroot-ccache"
BR2_PACKAGE_OVERRIDE_FILE="$(BR2_EXTERNAL_LRD_SOM_PATH)/board/som60_rdvk/som60_rdvk-local.mk"
BR2_PER_PACKAGE_DIRECTORIES=y
BR2_TARGET_GENERIC_HOSTNAME="summit"
BR2_TARGET_GENERIC_ISSUE="Laird Connectivity"
BR2_INIT_SYSTEMD=y
BR2_ROOTFS_DEVICE_TABLE="$(BR2_EXTERNAL_LRD_SOM_PATH)/board/device_table.txt"
BR2_TARGET_GENERIC_ROOT_PASSWD="summit"
# BR2_TARGET_GENERIC_REMOUNT_ROOTFS_RW is not set
BR2_ENABLE_LOCALE_WHITELIST="en_US"
BR2_ROOTFS_POST_BUILD_SCRIPT="$(BR2_EXTERNAL_LRD_SOM_PATH)/board/som60_rdvk/post_build.sh"
BR2_ROOTFS_POST_IMAGE_SCRIPT="$(BR2_EXTERNAL_LRD_SOM_PATH)/board/som60_rdvk/post_image.sh"
BR2_ROOTFS_POST_SCRIPT_ARGS="som60 $(BR2_EXTERNAL_LRD_SOM_PATH)/board/configs-common/keys"
BR2_LINUX_KERNEL=y
BR2_LINUX_KERNEL_DEFCONFIG="som60_rdvk"
BR2_LINUX_KERNEL_IMAGE_TARGET_CUSTOM=y
BR2_LINUX_KERNEL_IMAGE_TARGET_NAME="Image"
BR2_LINUX_KERNEL_DTS_SUPPORT=y
BR2_LINUX_KERNEL_INTREE_DTS_NAME="at91-dvk_som60_rdvk"
BR2_PACKAGE_BUSYBOX_CONFIG="$(BR2_EXTERNAL_LRD_SOM_PATH)/board/configs-common/busybox.config"
BR2_PACKAGE_LSOF=y
BR2_PACKAGE_NETPERF=y
BR2_PACKAGE_STRACE=y
BR2_PACKAGE_TRACE_CMD=y
BR2_PACKAGE_MTD=y
# BR2_PACKAGE_MTD_MTD_DEBUG is not set
# BR2_PACKAGE_MTD_UBINIZE is not set
BR2_PACKAGE_LIBUBOOTENV=y
BR2_PACKAGE_SETSERIAL=y
BR2_PACKAGE_SREDIRD=y
BR2_PACKAGE_STATSERIAL=y
BR2_PACKAGE_USBUTILS=y
BR2_PACKAGE_PYTHON3=y
BR2_PACKAGE_PYTHON_DBUS_FAST=y
BR2_PACKAGE_CA_CERTIFICATES=y
BR2_PACKAGE_LIBOPENSSL_BIN=y
# BR2_PACKAGE_LIBOPENSSL_ENABLE_IDEA is not set
# BR2_PACKAGE_LIBOPENSSL_ENABLE_SEED is not set
# BR2_PACKAGE_LIBOPENSSL_ENABLE_WHIRLPOOL is not set
# BR2_PACKAGE_LIBOPENSSL_ENABLE_BLOWFISH is not set
# BR2_PACKAGE_LIBOPENSSL_ENABLE_SSL3 is not set
# BR2_PACKAGE_LIBOPENSSL_ENABLE_WEAK_SSL is not set
# BR2_PACKAGE_LIBOPENSSL_ENABLE_CAST is not set
# BR2_PACKAGE_LIBOPENSSL_UNSECURE is not set
# BR2_PACKAGE_LIBOPENSSL_ENABLE_COMP is not set
BR2_PACKAGE_LIBOPENSSL_3_0=y
BR2_PACKAGE_LIBCURL=y
BR2_PACKAGE_LIBCURL_CURL=y
# BR2_PACKAGE_LIBCURL_EXTRA_PROTOCOLS_FEATURES is not set
BR2_PACKAGE_LIBEDIT=y
BR2_PACKAGE_BLUEZ5_UTILS=y
BR2_PACKAGE_BLUEZ5_UTILS_OBEX=y
BR2_PACKAGE_BLUEZ5_UTILS_CLIENT=y
BR2_PACKAGE_BLUEZ5_UTILS_TOOLS=y
BR2_PACKAGE_BLUEZ5_UTILS_DEPRECATED=y
BR2_PACKAGE_BLUEZ5_UTILS_TEST=y
BR2_PACKAGE_BRIDGE_UTILS=y
BR2_PACKAGE_CAN_UTILS=y
BR2_PACKAGE_CHRONY=y
BR2_PACKAGE_CONNTRACK_TOOLS=y
BR2_PACKAGE_DNSMASQ=y
# BR2_PACKAGE_DNSMASQ_TFTP is not set
BR2_PACKAGE_DROPBEAR=y
# BR2_PACKAGE_DROPBEAR_CLIENT is not set
BR2_PACKAGE_EBTABLES=y
BR2_PACKAGE_ETHTOOL=y
# BR2_PACKAGE_IFUPDOWN_SCRIPTS is not set
BR2_PACKAGE_IPERF=y
BR2_PACKAGE_IPERF3=y
BR2_PACKAGE_IPROUTE2=y
BR2_PACKAGE_IPTABLES=y
BR2_PACKAGE_IW=y
BR2_PACKAGE_PPPD=y
# BR2_PACKAGE_PPPD_OVERWRITE_RESOLV_CONF is not set
BR2_PACKAGE_TCPDUMP=y
BR2_PACKAGE_WIRELESS_REGDB=y
BR2_PACKAGE_SWUPDATE=y
BR2_PACKAGE_SWUPDATE_CONFIG="$(BR2_EXTERNAL_LRD_SOM_PATH)/board/configs-common/swupdate.config"
# BR2_PACKAGE_SWUPDATE_WEBSERVER is not set
# BR2_PACKAGE_SYSTEMD_PSTORE is not set
BR2_PACKAGE_SYSTEMD_HIBERNATE=y
# BR2_PACKAGE_SYSTEMD_HWDB is not set
BR2_PACKAGE_SYSTEMD_LOGIND=y
# BR2_PACKAGE_SYSTEMD_MYHOSTNAME is not set
# BR2_PACKAGE_SYSTEMD_NETWORKD is not set
# BR2_PACKAGE_SYSTEMD_RESOLVED is not set
# BR2_PACKAGE_SYSTEMD_TIMESYNCD is not set
# BR2_PACKAGE_SYSTEMD_VCONSOLE is not set
BR2_PACKAGE_UTIL_LINUX_HWCLOCK=y
BR2_PACKAGE_LESS=y
BR2_TARGET_ROOTFS_SQUASHFS=y
BR2_TARGET_ROOTFS_SQUASHFS4_LZO=y
# BR2_TARGET_ROOTFS_TAR is not set
BR2_TARGET_UBOOT=y
BR2_TARGET_UBOOT_BUILD_SYSTEM_KCONFIG=y
BR2_TARGET_UBOOT_CUSTOM_VERSION=y
BR2_TARGET_UBOOT_CUSTOM_VERSION_VALUE="2023.04"
BR2_TARGET_UBOOT_BOARD_DEFCONFIG="som60"
BR2_TARGET_UBOOT_NEEDS_DTC=y
BR2_TARGET_UBOOT_NEEDS_OPENSSL=y
# BR2_TARGET_UBOOT_FORMAT_BIN is not set
BR2_TARGET_UBOOT_FORMAT_INITIAL_ENV=y
BR2_TARGET_UBOOT_FORMAT_CUSTOM=y
BR2_TARGET_UBOOT_FORMAT_CUSTOM_NAME="u-boot.dtb u-boot-nodtb.bin"
BR2_TARGET_UBOOT_SPL=y
BR2_TARGET_UBOOT_SPL_NAME="spl/u-boot-spl-nodtb.bin spl/u-boot-spl.dtb"
BR2_PACKAGE_HOST_MTD=y
BR2_PACKAGE_LAIRD_FIRMWARE=y
BR2_PACKAGE_LAIRD_FIRMWARE_AR6003=y
BR2_PACKAGE_LAIRD_FIRMWARE_AR6004=y
BR2_PACKAGE_LAIRD_FIRMWARE_BCM4343=y
BR2_PACKAGE_LAIRD_FIRMWARE_BCM43439=y
BR2_PACKAGE_LAIRD_FIRMWARE_BCM4339=y
BR2_PACKAGE_LAIRD_FIRMWARE_BCM4373_SDIO_DIV=y
BR2_PACKAGE_LAIRD_FIRMWARE_BCM4373_SDIO_SA=y
BR2_PACKAGE_LAIRD_FIRMWARE_BCM4373_SDIO_SA_M2=y
BR2_PACKAGE_LAIRD_FIRMWARE_BCM4373_USB_DIV=y
BR2_PACKAGE_LAIRD_FIRMWARE_BCM4373_USB_SA=y
BR2_PACKAGE_LAIRD_FIRMWARE_BCM4373_USB_SA_M2=y
BR2_PACKAGE_LAIRD_FIRMWARE_LRDMWL_60_SDIO_UART=y
BR2_PACKAGE_LAIRD_FIRMWARE_LRDMWL_60_SDIO_SDIO=y
BR2_PACKAGE_LAIRD_FIRMWARE_LRDMWL_60_USB_UART=y
BR2_PACKAGE_LAIRD_FIRMWARE_LRDMWL_60_USB_USB=y
BR2_PACKAGE_LAIRD_FIRMWARE_BT=y
BR2_PACKAGE_SONA_FIRMWARE_NX61X=y
BR2_PACKAGE_WL_FMAC=y
BR2_PACKAGE_ADAPTIVE_WW=y
BR2_PACKAGE_WAVEAGENT=y
BR2_PACKAGE_ADAPTIVE_BT=y
BR2_PACKAGE_LRD_WIRELESS_REGDB=y
BR2_PACKAGE_MC_MINT=y
BR2_PACKAGE_LRD_NETWORK_MANAGER=y
BR2_PACKAGE_LRD_AUTOMOUNT=y
BR2_PACKAGE_LRD_USBGADGET=y
BR2_PACKAGE_LRD_USBGADGET_TYPE_NCM=y
BR2_PACKAGE_SDCSUPP=y
BR2_PACKAGE_SDCSUPP_WPA_CLI=y
BR2_PACKAGE_SDCSUPP_WPA_PASSPHRASE=y
BR2_PACKAGE_LRD_BRCM_PATCHRAM_PLUS=y
```

## configs/som60_toolchain_defconfig
```kconfig
BR2_arm=y
BR2_cortex_a5=y
BR2_ARM_ENABLE_VFP=y
BR2_TOOLCHAIN_BUILDROOT_VENDOR="laird"
BR2_KERNEL_HEADERS_VERSION=y
BR2_DEFAULT_KERNEL_VERSION="6.1"
BR2_BINUTILS_VERSION_2_39_X=y
BR2_GCC_VERSION_12_X=y
BR2_TOOLCHAIN_BUILDROOT_CXX=y
BR2_PACKAGE_HOST_GDB=y
BR2_PACKAGE_HOST_GDB_TUI=y
BR2_GDB_VERSION_12=y
BR2_DL_DIR="$(HOME)/.br2_dl_dir"
BR2_CCACHE=y
BR2_CCACHE_DIR="$(BR2_DL_DIR)/.buildroot-ccache"
BR2_PER_PACKAGE_DIRECTORIES=y
BR2_INIT_NONE=y
# BR2_TARGET_ENABLE_ROOT_LOGIN is not set
BR2_SYSTEM_BIN_SH_NONE=y
# BR2_TARGET_GENERIC_GETTY is not set
# BR2_TARGET_GENERIC_REMOUNT_ROOTFS_RW is not set
# BR2_PACKAGE_BUSYBOX is not set
BR2_PACKAGE_GDB=y
# BR2_PACKAGE_IFUPDOWN_SCRIPTS is not set
# BR2_TARGET_ROOTFS_TAR is not set
```

## configs/som60sd_mfg_defconfig
```kconfig
BR2_arm=y
BR2_cortex_a5=y
BR2_ARM_ENABLE_VFP=y
BR2_ARM_INSTRUCTIONS_THUMB2=y
BR2_TOOLCHAIN_EXTERNAL=y
BR2_TOOLCHAIN_EXTERNAL_LAIRD_ARM=y
BR2_WGET="wget --passive-ftp -nd"
BR2_DL_DIR="$(HOME)/.br2_dl_dir"
BR2_CCACHE=y
BR2_CCACHE_DIR="$(BR2_DL_DIR)/.buildroot-ccache"
BR2_PACKAGE_OVERRIDE_FILE="$(BR2_EXTERNAL_LRD_SOM_PATH)/board/som60/som60-local.mk"
BR2_PER_PACKAGE_DIRECTORIES=y
BR2_TARGET_GENERIC_HOSTNAME="summit"
BR2_TARGET_GENERIC_ISSUE="Laird Connectivity"
BR2_INIT_SYSTEMD=y
BR2_ROOTFS_DEVICE_TABLE="$(BR2_EXTERNAL_LRD_SOM_PATH)/board/device_table.txt"
BR2_TARGET_GENERIC_ROOT_PASSWD="summit"
BR2_ENABLE_LOCALE_WHITELIST="en_US"
BR2_ROOTFS_POST_BUILD_SCRIPT="$(BR2_EXTERNAL_LRD_SOM_PATH)/board/som60/post_build.sh"
BR2_ROOTFS_POST_IMAGE_SCRIPT="$(BR2_EXTERNAL_LRD_SOM_PATH)/board/som60/post_image.sh"
BR2_ROOTFS_POST_SCRIPT_ARGS="som60sd $(BR2_EXTERNAL_LRD_SOM_PATH)/board/configs-common/keys"
BR2_LINUX_KERNEL=y
BR2_LINUX_KERNEL_DEFCONFIG="som60"
BR2_LINUX_KERNEL_IMAGE_TARGET_CUSTOM=y
BR2_LINUX_KERNEL_IMAGE_TARGET_NAME="Image"
BR2_LINUX_KERNEL_DTS_SUPPORT=y
BR2_LINUX_KERNEL_INTREE_DTS_NAME="at91-dvk_som60sd_mfg"
BR2_PACKAGE_BUSYBOX_CONFIG="$(BR2_EXTERNAL_LRD_SOM_PATH)/board/configs-common/busybox.config"
BR2_PACKAGE_MTD=y
BR2_PACKAGE_I2C_TOOLS=y
BR2_PACKAGE_LIBUBOOTENV=y
BR2_PACKAGE_LINUXCONSOLETOOLS=y
BR2_PACKAGE_MEMTESTER=y
BR2_PACKAGE_SETSERIAL=y
BR2_PACKAGE_USBUTILS=y
BR2_PACKAGE_CA_CERTIFICATES=y
BR2_PACKAGE_LIBSSH=y
BR2_PACKAGE_LIBOPENSSL_BIN=y
BR2_PACKAGE_LIBCURL=y
# BR2_PACKAGE_LIBCURL_EXTRA_PROTOCOLS_FEATURES is not set
BR2_PACKAGE_LIBEDIT=y
BR2_PACKAGE_BLUEZ5_UTILS=y
BR2_PACKAGE_BLUEZ5_UTILS_OBEX=y
BR2_PACKAGE_BLUEZ5_UTILS_CLIENT=y
BR2_PACKAGE_BLUEZ5_UTILS_TOOLS=y
BR2_PACKAGE_DNSMASQ=y
# BR2_PACKAGE_DNSMASQ_TFTP is not set
BR2_PACKAGE_DROPBEAR=y
BR2_PACKAGE_EBTABLES=y
BR2_PACKAGE_ETHTOOL=y
# BR2_PACKAGE_IFUPDOWN_SCRIPTS is not set
BR2_PACKAGE_IPERF=y
BR2_PACKAGE_IPERF3=y
BR2_PACKAGE_IPROUTE2=y
BR2_PACKAGE_IW=y
BR2_PACKAGE_MII_DIAG=y
BR2_PACKAGE_TCPDUMP=y
BR2_PACKAGE_LOCKFILE_PROGS=y
BR2_PACKAGE_SWUPDATE=y
BR2_PACKAGE_SWUPDATE_CONFIG="$(BR2_EXTERNAL_LRD_SOM_PATH)/board/configs-common/swupdate.config"
# BR2_PACKAGE_SWUPDATE_WEBSERVER is not set
# BR2_PACKAGE_SYSTEMD_PSTORE is not set
BR2_PACKAGE_SYSTEMD_HIBERNATE=y
# BR2_PACKAGE_SYSTEMD_HWDB is not set
BR2_PACKAGE_SYSTEMD_LOGIND=y
# BR2_PACKAGE_SYSTEMD_MYHOSTNAME is not set
# BR2_PACKAGE_SYSTEMD_NETWORKD is not set
# BR2_PACKAGE_SYSTEMD_RESOLVED is not set
# BR2_PACKAGE_SYSTEMD_TIMESYNCD is not set
# BR2_PACKAGE_SYSTEMD_VCONSOLE is not set
BR2_PACKAGE_UTIL_LINUX_HWCLOCK=y
BR2_PACKAGE_UTIL_LINUX_SWAPON=y
BR2_PACKAGE_LESS=y
BR2_TARGET_UBOOT=y
BR2_TARGET_UBOOT_BUILD_SYSTEM_KCONFIG=y
BR2_TARGET_UBOOT_CUSTOM_VERSION=y
BR2_TARGET_UBOOT_CUSTOM_VERSION_VALUE="2022.10"
BR2_TARGET_UBOOT_BOARD_DEFCONFIG="som60sd_mfg"
BR2_TARGET_UBOOT_NEEDS_DTC=y
# BR2_TARGET_UBOOT_FORMAT_BIN is not set
BR2_TARGET_UBOOT_FORMAT_INITIAL_ENV=y
BR2_TARGET_UBOOT_FORMAT_CUSTOM=y
BR2_TARGET_UBOOT_FORMAT_CUSTOM_NAME="u-boot.dtb u-boot-nodtb.bin"
BR2_TARGET_UBOOT_SPL=y
BR2_TARGET_UBOOT_SPL_NAME="spl/u-boot-spl-nodtb.bin spl/u-boot-spl.dtb"
BR2_PACKAGE_HOST_CRYPTSETUP=y
BR2_PACKAGE_HOST_E2FSPROGS=y
BR2_PACKAGE_HOST_MTD=y
BR2_LRD_SOM60_RADIO=y
BR2_PACKAGE_LRD_AUTOMOUNT=y
# BR2_PACKAGE_LRD_AUTOMOUNT_MMC is not set
BR2_PACKAGE_LRD_USBGADGET=y
BR2_PACKAGE_MFG60N=y
BR2_PACKAGE_MFG60N_LRT=y
```

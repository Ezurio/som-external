## package-3rd-party/python-pkcs11/Config.in
```kconfig
config BR2_PACKAGE_PYTHON_PKCS11
	bool "python-pkcs11"
	select BR2_PACKAGE_PYTHON_ASN1CRYPTO
	help
	  Python PKCS#11 wrapper for applications using hardware security modules.
```

## package-3rd-party/python-pkcs11/Config.in.host
```kconfig
config BR2_PACKAGE_HOST_PYTHON_PKCS11
	bool "host python-pkcs11"
	select BR2_PACKAGE_HOST_PYTHON3
	select BR2_PACKAGE_HOST_PYTHON_ASN1CRYPTO
	help
	  Python PKCS#11 wrapper used by the SPSDK PKCS#11 signature provider.
```

## package-3rd-party/python-platformdirs/Config.in.host
```kconfig
config BR2_PACKAGE_HOST_PYTHON_PLATFORMDIRS
	bool "host python-platformdirs"
	help
	  Platform-specific directory helpers for Python applications.
```

## package-3rd-party/python-prettytable/Config.in
```kconfig
config BR2_PACKAGE_PYTHON_PRETTYTABLE
	bool "python-prettytable"
	select BR2_PACKAGE_PYTHON_WCWIDTH
	help
	  Formatted table output for Python applications.
```

## package-3rd-party/python-prettytable/Config.in.host
```kconfig
config BR2_PACKAGE_HOST_PYTHON_PRETTYTABLE
	bool "host python-prettytable"
	help
	  Formatted table output for Python applications.
```

## package-3rd-party/python-pyasn1/Config.in.host
```kconfig
config BR2_PACKAGE_HOST_PYTHON_PYASN1
	bool "host python-pyasn1"
	help
	  ASN.1 support for Python.
```

## package-3rd-party/python-pycryptodome/Config.in
```kconfig
config BR2_PACKAGE_PYTHON_PYCRYPTODOME
	bool "python-pycryptodome"
	help
	  Cryptographic library for Python.

	  https://www.pycryptodome.org

config BR2_PACKAGE_HOST_PYTHON_PYCRYPTODOME
	bool "host python-pycryptodome"
	help
	  Cryptographic library for Python for the host.

	  https://www.pycryptodome.org
```

## package-3rd-party/python-pyserial/Config.in.host
```kconfig
config BR2_PACKAGE_HOST_PYTHON_PYSERIAL
	bool "host python-pyserial"
	help
	  Serial-port support for Python.
```

## package-3rd-party/python-sly/Config.in
```kconfig
config BR2_PACKAGE_PYTHON_SLY
	bool "python-sly"
	help
	  Lexer and parser tools for Python.
```

## package-3rd-party/python-sly/Config.in.host
```kconfig
config BR2_PACKAGE_HOST_PYTHON_SLY
	bool "host python-sly"
	help
	  Lexer and parser tools for Python.
```

## package-3rd-party/python-spsdk-pkcs11/Config.in
```kconfig
config BR2_PACKAGE_PYTHON_SPSDK_PKCS11
	bool "python-spsdk-pkcs11"
	select BR2_PACKAGE_PYTHON_PKCS11
	select BR2_PACKAGE_PYTHON_CACHED_PROPERTY
	select BR2_PACKAGE_PYTHON_SPSDK
	help
	  SPSDK PKCS#11 signature provider for HSM-backed signing.
```

## package-3rd-party/python-spsdk-pkcs11/Config.in.host
```kconfig
config BR2_PACKAGE_HOST_PYTHON_SPSDK_PKCS11
	bool "host python-spsdk-pkcs11"
	select BR2_PACKAGE_HOST_PYTHON_PKCS11
	select BR2_PACKAGE_HOST_PYTHON_CACHED_PROPERTY
	help
	  SPSDK PKCS#11 signature provider for HSM-backed signing.
```

## package-3rd-party/python-spsdk/Config.in
```kconfig
config BR2_PACKAGE_PYTHON_SPSDK
	bool "python-spsdk"
	select BR2_PACKAGE_PYTHON3_BZIP2
	select BR2_PACKAGE_PYTHON3_SSL
	select BR2_PACKAGE_PYTHON3_XZ
	select BR2_PACKAGE_PYTHON_BINCOPY
	select BR2_PACKAGE_PYTHON_BITSTRING
	select BR2_PACKAGE_PYTHON_CHARDET
	select BR2_PACKAGE_PYTHON_COLORAMA
	select BR2_PACKAGE_PYTHON_CLICK_COMMAND_TREE
	select BR2_PACKAGE_PYTHON_CLICK_OPTION_GROUP
	select BR2_PACKAGE_PYTHON_HEXDUMP
	select BR2_PACKAGE_PYTHON_PLATFORMDIRS
	select BR2_PACKAGE_PYTHON_PYASN1
	select BR2_PACKAGE_PYTHON_CLICK
	select BR2_PACKAGE_PYTHON_HUMANFRIENDLY
	select BR2_PACKAGE_PYTHON_IMPORTLIB_METADATA
	select BR2_PACKAGE_PYTHON_JINJA2
	select BR2_PACKAGE_PYTHON_OSCRYPTO
	select BR2_PACKAGE_PYTHON_PRETTYTABLE
	select BR2_PACKAGE_PYTHON_SERIAL
	select BR2_PACKAGE_PYTHON_SLY
	select BR2_PACKAGE_PYTHON_T61CODEC
	select BR2_PACKAGE_PYTHON_X690
	select BR2_PACKAGE_PYTHON_CRCMOD
	select BR2_PACKAGE_PYTHON_CRYPTOGRAPHY
	select BR2_PACKAGE_PYTHON_DEEPMERGE
	select BR2_PACKAGE_PYTHON_FASTJSONSCHEMA
	select BR2_PACKAGE_PYTHON_FILELOCK
	select BR2_PACKAGE_PYTHON_PYYAML
	select BR2_PACKAGE_PYTHON_REQUESTS
	select BR2_PACKAGE_PYTHON_RUAMEL_YAML
	select BR2_PACKAGE_PYTHON_TYPING_EXTENSIONS
	select BR2_PACKAGE_PYTHON_ASN1CRYPTO
	select BR2_PACKAGE_PYTHON_PACKAGING
	help
	  NXP Secure Provisioning SDK for signing HAB and AHAB containers.
```

## package-3rd-party/python-spsdk/Config.in.host
```kconfig
config BR2_PACKAGE_HOST_PYTHON_SPSDK
	bool "host python-spsdk"
	select BR2_PACKAGE_HOST_PYTHON3_BZIP2
	select BR2_PACKAGE_HOST_PYTHON3_SSL
	select BR2_PACKAGE_HOST_PYTHON3_XZ
	help
	  NXP Secure Provisioning SDK (SPSDK) provides the nxpimage
	  tool used for signing HAB4 images on i.MX8M and AHAB
	  containers on i.MX9x platforms.

	  https://github.com/nxp-mcuxpresso/spsdk
```

## package-3rd-party/python-t61codec/Config.in
```kconfig
config BR2_PACKAGE_PYTHON_T61CODEC
	bool "python-t61codec"
	help
	  T.61 codec support for Python.
```

## package-3rd-party/python-t61codec/Config.in.host
```kconfig
config BR2_PACKAGE_HOST_PYTHON_T61CODEC
	bool "host python-t61codec"
	help
	  T.61 codec support for Python, used by the x690 ASN.1 decoder.
```

## package-3rd-party/python-x690/Config.in
```kconfig
config BR2_PACKAGE_PYTHON_X690
	bool "python-x690"
	select BR2_PACKAGE_PYTHON_T61CODEC
	help
	  X.690 encoding support for Python.
```

## package-3rd-party/python-x690/Config.in.host
```kconfig
config BR2_PACKAGE_HOST_PYTHON_X690
	bool "host python-x690"
	help
	  X.690 encoding support for Python.
```

## package-3rd-party/secure-sam-ba-cipher/Config.in.host
```kconfig
config BR2_ENABLE_HOST_SECURE_SAM_BA_CIPHER
    bool
    option env="ENABLE_HOST_SECURE_SAM_BA_CIPHER"

config BR2_PACKAGE_HOST_SECURE_SAM_BA_CIPHER
    bool "host secure sam-ba cipher tool"
    default y if BR2_ENABLE_HOST_SECURE_SAM_BA_CIPHER
    help
        Secure SAM-BA Cipher Tool
        Optionally enabled via env variable at build time
```

## package-3rd-party/tac5x1x/Config.in
```kconfig
config BR2_PACKAGE_TAC5X1X
	bool "tac5x1x"
	depends on BR2_LINUX_KERNEL
	help
	  Texas Instruments TAC5x1x Sound Codec Driver
```

## package-3rd-party/ti-rogue-um/Config.in
```kconfig
comment "ti-rogue-um needs udev and a glibc toolchain w/ threads"
	depends on BR2_aarch64
	depends on !BR2_PACKAGE_HAS_UDEV || !BR2_TOOLCHAIN_USES_GLIBC \
		|| !BR2_TOOLCHAIN_HAS_THREADS

config BR2_PACKAGE_TI_ROGUE_UM
	bool "ti-rogue-um"
	depends on BR2_TOOLCHAIN_HAS_THREADS # libdrm
	depends on BR2_PACKAGE_HAS_UDEV
	# pre-built binaries
	depends on BR2_TOOLCHAIN_USES_GLIBC
	depends on BR2_aarch64
	select BR2_PACKAGE_LIBDRM
	select BR2_PACKAGE_HAS_POWERVR
	select BR2_PACKAGE_TI_ROGUE_KM if BR2_LINUX_KERNEL
	help
	  Graphics libraries for TI SoCs with Rogue GPU.
	  This package supports AM62, J721E, J721S2, and J784S4
	  SoCs only.

	  https://git.ti.com/cgit/graphics/ti-img-rogue-umlibs

if BR2_PACKAGE_TI_ROGUE_UM

config BR2_PACKAGE_PROVIDES_POWERVR
	default "ti-rogue-um"

config BR2_TARGET_TI_ROGUE_UM_TARGET_PRODUCT
	string "UM driver target product"
	default "am62_linux"
	help
	  Select target product to be used for UM libraries. This needs to
	  match one of the SoC-specific folders within the root/targetfs
	  folder of the ti-img-rogue-umlibs Git repository.

config BR2_PACKAGE_TI_ROGUE_UM_TOOLS
	bool "UM tools"
	help
	  Tools for the TI Rogue UM driver.
	  This package provides utilities related to the TI Rogue UM architecture,
	  ensuring comprehensive support for various functionalities.

endif
```

## package/dcas/Config.in
```kconfig
config BR2_PACKAGE_DCAS
	bool "dcas"
	select BR2_PACKAGE_FLATCC
	select BR2_PACKAGE_LIBSSH
	select BR2_PACKAGE_LIBSSH_SERVER
	depends on BR2_PACKAGE_SDCSDK || BR2_PACKAGE_SUMMIT_SUPPLICANT
	help
	  dcas is Device Client API Server. It is a daemon that
	  implements the server-side of the Device Client API and is used by
	  a host's implementation of DCAL.
```

## package/demo-gui/Config.in
```kconfig
config BR2_PACKAGE_DEMO_GUI
	bool "Summit GUI Demo"
	depends on BR2_PACKAGE_QT5BASE
	depends on BR2_PACKAGE_LIBDRM
	depends on BR2_PACKAGE_LIBPLANES
	depends on BR2_PACKAGE_SUMMIT_NETWORK_MANAGER
	help
		Summit GUI demo applications
```

## package/eventmon/Config.in
```kconfig
config BR2_PACKAGE_EVENTMON
	bool "eventmon"
	depends on BR2_PACKAGE_SDCSDK || BR2_PACKAGE_SUMMIT_SUPPLICANT
	help
	  Summit Event Monitor
```

## package/igconfd/Config.in
```kconfig
config BR2_PACKAGE_IGCONFD
	bool "igconfd"
	select BR2_PACKAGE_PYTHON3
	select BR2_PACKAGE_BLUEZ5_UTILS
	select BR2_PACKAGE_GOBJECT_INTROSPECTION
	select BR2_PACKAGE_PYTHON_GOBJECT
	select BR2_PACKAGE_PYTHON_SYSTEMD
	select BR2_PACKAGE_DBUS_PYTHON
	select BR2_PACKAGE_PYTHON_BTSOCKET
	help
	  Industrial Gateway Configuration Service
```

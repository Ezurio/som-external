## package-3rd-party/lora-packet-forwarder/Config.in
```kconfig
config BR2_PACKAGE_LORA_PACKET_FORWARDER
	bool "lora-packet-forwarder"
	select BR2_PACKAGE_LIBLORAGW
	help
		Semtech packet forwarder
```

## package-3rd-party/mesa-pvr-headers/Config.in
```kconfig
config BR2_PACKAGE_MESA_PVR_HEADERS
	bool
	help
	  Mesa 3D, an open-source implementation of the OpenGL
	  specification.

	  This package only installs headers needed by other packages.

	  http://mesa3d.org
```

## package-3rd-party/mesa-pvr/Config.in
```kconfig
menuconfig BR2_PACKAGE_MESA_PVR
	bool "mesa-pvr"
	depends on BR2_INSTALL_LIBSTDCPP
	depends on !BR2_STATIC_LIBS
	depends on BR2_TOOLCHAIN_HAS_SYNC_1
	depends on BR2_TOOLCHAIN_HAS_THREADS_NPTL
	depends on BR2_TOOLCHAIN_GCC_AT_LEAST_8
	select BR2_PACKAGE_EXPAT
	select BR2_PACKAGE_LIBDRM
	select BR2_PACKAGE_WAYLAND_PROTOCOLS if BR2_PACKAGE_WAYLAND
	select BR2_PACKAGE_ZLIB
	help
	  Mesa 3D, an open-source implementation of the OpenGL
	  specification.

	  http://mesa3d.org

if BR2_PACKAGE_MESA_PVR

# Some Gallium driver needs libelf when built with LLVM support
config BR2_PACKAGE_MESA_PVR_NEEDS_ELFUTILS
	bool

config BR2_PACKAGE_MESA_PVR_LLVM
	bool "llvm support"
	depends on BR2_PACKAGE_LLVM_ARCH_SUPPORTS
	depends on BR2_TOOLCHAIN_GCC_AT_LEAST_7
	depends on BR2_TOOLCHAIN_HAS_THREADS
	depends on BR2_INSTALL_LIBSTDCPP
	depends on !BR2_TOOLCHAIN_HAS_GCC_BUG_64735 # std::shared_future
	depends on !BR2_STATIC_LIBS
	depends on BR2_USE_WCHAR # std::wstring
	depends on BR2_HOST_GCC_AT_LEAST_7 # host-llvm
	select BR2_PACKAGE_LLVM

comment "llvm support needs a toolchain w/ wchar, threads, C++, gcc >= 7, dynamic library, host gcc >= 7"
	depends on BR2_PACKAGE_LLVM_ARCH_SUPPORTS
	depends on !BR2_TOOLCHAIN_HAS_THREADS || !BR2_INSTALL_LIBSTDCPP || \
		!BR2_TOOLCHAIN_GCC_AT_LEAST_7 \
		|| BR2_STATIC_LIBS || !BR2_USE_WCHAR \
		|| !BR2_HOST_GCC_AT_LEAST_7

comment "llvm support needs a toolchain not affected by GCC bug 64735"
	depends on BR2_PACKAGE_LLVM_ARCH_SUPPORTS
	depends on BR2_TOOLCHAIN_HAS_GCC_BUG_64735

# clang and libclc dependencies are satisfied by
# BR2_PACKAGE_MESA_PVR_LLVM
config BR2_PACKAGE_MESA_PVR_OPENCL
	bool "OpenCL support"
	depends on BR2_PACKAGE_MESA3D_LLVM
	select BR2_PACKAGE_LLVM_RTTI
	select BR2_PACKAGE_CLANG
	select BR2_PACKAGE_LIBCLC
	select BR2_PACKAGE_HAS_LIBOPENCL

# inform the .mk file of gallium or vulkan driver selection
config BR2_PACKAGE_MESA_PVR_GALLIUM_DRIVER
	bool
	select BR2_PACKAGE_MESA_PVR_DRIVER

config BR2_PACKAGE_MESA_PVR_VULKAN_DRIVER
	bool
	select BR2_PACKAGE_MESA_PVR_DRIVER

config BR2_PACKAGE_MESA_PVR_DRIVER
	bool
	select BR2_PACKAGE_XLIB_LIBXSHMFENCE if BR2_PACKAGE_XORG7

# Gallium xa state tracker.
# Quote from MESA_PVR meson.build: "XA state tracker requires at least
# one of the following gallium drivers: nouveau, freedreno, i915, svga.
config BR2_PACKAGE_MESA_PVR_NEEDS_XA
	bool

# OpenGL GLX and Gallium VDPAU both needs X11
config BR2_PACKAGE_MESA_PVR_NEEDS_X11
	bool
	depends on BR2_PACKAGE_XORG7
	select BR2_PACKAGE_LIBXCB
	select BR2_PACKAGE_XLIB_LIBX11
	select BR2_PACKAGE_XLIB_LIBXDAMAGE
	select BR2_PACKAGE_XLIB_LIBXEXT
	select BR2_PACKAGE_XLIB_LIBXFIXES
	select BR2_PACKAGE_XLIB_LIBXRANDR
	select BR2_PACKAGE_XLIB_LIBXXF86VM
	select BR2_PACKAGE_XORGPROTO

comment "Gallium drivers"

config BR2_PACKAGE_MESA_PVR_GALLIUM_DRIVER_SWRAST
	bool "Gallium swrast driver"
	select BR2_PACKAGE_MESA_PVR_GALLIUM_DRIVER
	help
	  This is a software opengl implementation using the Gallium3D
	  infrastructure.

config BR2_PACKAGE_MESA_PVR_GALLIUM_DRIVER_ZINK
	bool "Gallium Zink driver"
	depends on BR2_PACKAGE_MESA_PVR_VULKAN_DRIVER
	select BR2_PACKAGE_MESA_PVR_GALLIUM_DRIVER
	select BR2_PACKAGE_MESA_PVR_OPENGL_EGL
	help
	  zink driver provides gallium API emulation from Vulkan driver.

config BR2_PACKAGE_MESA_PVR_GALLIUM_DRIVER_ROGUE
	bool "Gallium PowerVR Rogue driver"
	select BR2_PACKAGE_MESA_PVR_GALLIUM_DRIVER
	select BR2_PACKAGE_MESA_PVR_OPENGL_EGL
	select BR2_PACKAGE_MESA_PVR_OPENGL_ES
	help
	  Gallium driver for PowerVR Rogue.

config BR2_PACKAGE_MESA_PVR_GALLIUM_DRIVER_SGX
	bool "Gallium PowerVR SGX driver"
	select BR2_PACKAGE_MESA_PVR_GALLIUM_DRIVER
	select BR2_PACKAGE_MESA_PVR_OPENGL_EGL
	select BR2_PACKAGE_MESA_PVR_OPENGL_ES
	help
	  Gallium driver for PowerVR SGX.

comment "Vulkan drivers"

config BR2_PACKAGE_MESA_PVR_VULKAN_DRIVER_SWRAST
	bool "Vulkan swrast driver"
	depends on BR2_PACKAGE_MESA_PVR_LLVM
	select BR2_PACKAGE_MESA_PVR_GALLIUM_DRIVER_SWRAST
	select BR2_PACKAGE_MESA_PVR_VULKAN_DRIVER
	help
	  Vulkan swrast driver.

config BR2_PACKAGE_MESA_PVR_VULKAN_DRIVER_ROGUE
	bool "Vulkan PowerVR Rogue driver"
	depends on BR2_arm || BR2_aarch64
	depends on BR2_TOOLCHAIN_HAS_SYNC_4 # dri3/libxshmfence
	select BR2_PACKAGE_MESA_PVR_VULKAN_DRIVER
	help
	  Vulkan PowerVR driver.

comment "Off-screen Rendering"

config BR2_PACKAGE_MESA_PVR_OSMESA_GALLIUM
	bool "OSMesa (Gallium) library"
	select BR2_PACKAGE_MESA_PVR_GALLIUM_DRIVER_SWRAST
	help
	  The OSMesa API provides functions for off-screen rendering.

if BR2_PACKAGE_MESA_PVR_DRIVER

comment "OpenGL API Support"

config BR2_PACKAGE_MESA_PVR_GBM
	bool "gbm"
	depends on BR2_PACKAGE_MESA_PVR_GALLIUM_DRIVER && \
		BR2_PACKAGE_MESA_PVR_OPENGL_EGL
	select BR2_PACKAGE_HAS_LIBGBM
	select BR2_PACKAGE_LIBGBM_HAS_FEATURE_FORMAT_MODIFIER_PLANE_COUNT
	select BR2_PACKAGE_LIBGBM_HAS_FEATURE_DMA_BUF
	help
	  Enable Generic Buffer Management (gbm)

comment "gbm support needs a gallium driver w/ EGL support."
	depends on !(BR2_PACKAGE_MESA_PVR_GALLIUM_DRIVER && BR2_PACKAGE_MESA_PVR_OPENGL_EGL)

config BR2_PACKAGE_MESA_PVR_OPENGL_GLX
	bool "OpenGL GLX"
	depends on BR2_PACKAGE_XORG7
	select BR2_PACKAGE_HAS_LIBGL if !BR2_PACKAGE_LIBGLVND
	select BR2_PACKAGE_LIBGLVND_DISPATCH_GL if BR2_PACKAGE_LIBGLVND
	select BR2_PACKAGE_MESA_PVR_NEEDS_X11
	help
	  Enable GLX graphic acceleration (OpenGL + X11).

comment "OpenGL GLX support needs X11"
	depends on !BR2_PACKAGE_XORG7

config BR2_PACKAGE_MESA_PVR_OPENGL_EGL
	bool "OpenGL EGL"
	depends on BR2_PACKAGE_MESA_PVR_GALLIUM_DRIVER
	select BR2_PACKAGE_HAS_LIBEGL if !BR2_PACKAGE_LIBGLVND
	select BR2_PACKAGE_LIBGLVND_DISPATCH_EGL if BR2_PACKAGE_LIBGLVND
	select BR2_PACKAGE_MESA_PVR_GBM
	help
	  Use the Khronos EGL APIs. EGL is a window manager for OpenGL
	  applications similar to GLX, for X, and WGL, for Windows.

config BR2_PACKAGE_MESA_PVR_OPENGL_ES
	bool "OpenGL ES"
	select BR2_PACKAGE_HAS_LIBGLES if !BR2_PACKAGE_LIBGLVND
	select BR2_PACKAGE_LIBGLVND_DISPATCH_GLES if BR2_PACKAGE_LIBGLVND
	help
	  Use the Khronos OpenGL ES APIs. This is commonly used on
	  embedded systems and represents a subset of the OpenGL API.

endif # BR2_PACKAGE_MESA_PVR_DRIVER

config BR2_PACKAGE_PROVIDES_LIBGBM
	default "mesa-pvr" if BR2_PACKAGE_MESA_PVR_GBM

config BR2_PACKAGE_PROVIDES_LIBGL
	default "mesa-pvr" if BR2_PACKAGE_MESA_PVR_OPENGL_GLX && !BR2_PACKAGE_LIBGLVND

config BR2_PACKAGE_PROVIDES_LIBEGL
	default "mesa-pvr" if BR2_PACKAGE_MESA_PVR_OPENGL_EGL && !BR2_PACKAGE_LIBGLVND

config BR2_PACKAGE_PROVIDES_LIBGLES
	default "mesa-pvr" if BR2_PACKAGE_MESA_PVR_OPENGL_ES && !BR2_PACKAGE_LIBGLVND

config BR2_PACKAGE_PROVIDES_LIBOPENCL
	default "mesa-pvr" if BR2_PACKAGE_MESA3D_OPENCL

endif # BR2_PACKAGE_MESA_PVR

comment "mesa-pvr needs a toolchain w/ gcc >=8, C++, NPTL, dynamic library"
	depends on !BR2_INSTALL_LIBSTDCPP || !BR2_TOOLCHAIN_HAS_THREADS_NPTL || \
		BR2_STATIC_LIBS || !BR2_TOOLCHAIN_GCC_AT_LEAST_8
	depends on BR2_TOOLCHAIN_HAS_SYNC_1
```

## package-3rd-party/pac193x/Config.in
```kconfig
config BR2_PACKAGE_PAC193X
	bool "pac193x"
	depends on BR2_LINUX_KERNEL
	help
	  Microchip PAC193x ADC/Power Monitor Driver
```

## package-3rd-party/pkcs11-provider/Config.in
```kconfig
config BR2_PACKAGE_PKCS11_PROVIDER
    bool "PKCS#11 Provider for OpenSSL 3.0+"
    depends on BR2_PACKAGE_OPENSSL
    select BR2_PACKAGE_P11_KIT
    select BR2_PACKAGE_OPENSC
    help
      A PKCS#11 provider for OpenSSL 3.0+

      https://github.com/latchset/pkcs11-provider

if BR2_PACKAGE_PKCS11_PROVIDER

config BR2_PACKAGE_PKCS11_PROVIDER_PEM_URI
    bool "PKCS#11 URI PEM tool"
    select BR2_PACKAGE_PYTHON_ASN1CRYPTO
    default y
    help
      Tool for converting PKCS#11 URIs to PEM certificate

endif
```

## package-3rd-party/python-argparse-addons/Config.in
```kconfig
config BR2_PACKAGE_PYTHON_ARGPARSE_ADDONS
	bool "python-argparse-addons"
	help
	  Additional argparse types and actions for Python.
```

## package-3rd-party/python-argparse-addons/Config.in.host
```kconfig
config BR2_PACKAGE_HOST_PYTHON_ARGPARSE_ADDONS
	bool "host python-argparse-addons"
	help
	  Additional argparse types and actions for Python.
```

## package-3rd-party/python-bincopy/Config.in
```kconfig
config BR2_PACKAGE_PYTHON_BINCOPY
	bool "python-bincopy"
	select BR2_PACKAGE_PYTHON_ARGPARSE_ADDONS
	select BR2_PACKAGE_PYTHON_HUMANFRIENDLY
	select BR2_PACKAGE_PYTHON_PYELFTOOLS
	help
	  Binary image manipulation library for Python.
```

## package-3rd-party/python-bincopy/Config.in.host
```kconfig
config BR2_PACKAGE_HOST_PYTHON_BINCOPY
	bool "host python-bincopy"
	help
	  Binary image manipulation library for Python.
```

## package-3rd-party/python-bitstring/Config.in.host
```kconfig
config BR2_PACKAGE_HOST_PYTHON_BITSTRING
	bool "host python-bitstring"
	help
	  Binary data manipulation library for Python.
```

## package-3rd-party/python-btsocket/Config.in
```kconfig
config BR2_PACKAGE_PYTHON_BTSOCKET
	bool "python-btsocket"
	depends on BR2_PACKAGE_PYTHON3
	depends on BR2_PACKAGE_BLUEZ5_UTILS
	help
	  Bluetooth Socket API for Python
	  https://github.com/ukBaz/python-btsocket
```

## package-3rd-party/python-chardet/Config.in.host
```kconfig
config BR2_PACKAGE_HOST_PYTHON_CHARDET
	bool "host python-chardet"
	help
	  Character encoding detection library for Python.
```

## package-3rd-party/python-click-command-tree/Config.in
```kconfig
config BR2_PACKAGE_PYTHON_CLICK_COMMAND_TREE
	bool "python-click-command-tree"
	select BR2_PACKAGE_PYTHON_CLICK
	help
	  Command-tree support for Click-based command-line applications.
```

## package-3rd-party/python-click-command-tree/Config.in.host
```kconfig
config BR2_PACKAGE_HOST_PYTHON_CLICK_COMMAND_TREE
	bool "host python-click-command-tree"
	help
	  Command-tree support for Click-based command-line applications.
```

## package-3rd-party/python-click-option-group/Config.in
```kconfig
config BR2_PACKAGE_PYTHON_CLICK_OPTION_GROUP
	bool "python-click-option-group"
	select BR2_PACKAGE_PYTHON_CLICK
	help
	  Option-group support for Click-based command-line applications.
```

## package-3rd-party/python-click-option-group/Config.in.host
```kconfig
config BR2_PACKAGE_HOST_PYTHON_CLICK_OPTION_GROUP
	bool "host python-click-option-group"
	help
	  Option-group support for Click-based command-line applications.
```

## package-3rd-party/python-colorama/Config.in.host
```kconfig
config BR2_PACKAGE_HOST_PYTHON_COLORAMA
	bool "host python-colorama"
	help
	  Cross-platform terminal color support for Python applications.
```

## package-3rd-party/python-deepmerge/Config.in
```kconfig
config BR2_PACKAGE_PYTHON_DEEPMERGE
	bool "python-deepmerge"
	help
	  A toolset for deeply merging Python dictionaries.

	  https://github.com/toumorokoshi/deepmerge
```

## package-3rd-party/python-fastjsonschema/Config.in
```kconfig
config BR2_PACKAGE_PYTHON_FASTJSONSCHEMA
	bool "python-fastjsonschema"
	help
	  Fast JSON schema validator for Python.

	  https://github.com/horejsek/python-fastjsonschema
```

## package-3rd-party/python-hexdump/Config.in
```kconfig
config BR2_PACKAGE_PYTHON_HEXDUMP
	bool "python-hexdump"
	help
	  Hex dump helper for Python.
```

## package-3rd-party/python-hexdump/Config.in.host
```kconfig
config BR2_PACKAGE_HOST_PYTHON_HEXDUMP
	bool "host python-hexdump"
	help
	  Hex dump helper for Python.
```

## package-3rd-party/python-importlib-metadata/Config.in
```kconfig
config BR2_PACKAGE_PYTHON_IMPORTLIB_METADATA
	bool "python-importlib-metadata"
	help
	  Import metadata support for Python packages.
```

## package-3rd-party/python-importlib-metadata/Config.in.host
```kconfig
config BR2_PACKAGE_HOST_PYTHON_IMPORTLIB_METADATA
	bool "host python-importlib-metadata"
	help
	  Import metadata support for Python packages.
```

## package-3rd-party/python-oscrypto/Config.in
```kconfig
config BR2_PACKAGE_PYTHON_OSCRYPTO
	bool "python-oscrypto"
	select BR2_PACKAGE_OPENSSL
	help
	  OpenSSL-backed cryptography primitives for Python.
```

## package-3rd-party/python-oscrypto/Config.in.host
```kconfig
config BR2_PACKAGE_HOST_PYTHON_OSCRYPTO
	bool "host python-oscrypto"
	help
	  OpenSSL-backed cryptography primitives for Python.
```

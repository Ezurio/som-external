## configs/nitrogen_imx8mp_smarc_2g_r2_defconfig
```kconfig
BR2_aarch64=y
BR2_TOOLCHAIN_EXTERNAL=y
BR2_TOOLCHAIN_EXTERNAL_SUMMIT_ARM=y
BR2_TOOLCHAIN_EXTERNAL_GDB_SERVER_COPY=y
BR2_WGET="wget --passive-ftp -nd"
BR2_DL_DIR="$(HOME)/.br2_dl_dir"
BR2_CCACHE=y
BR2_CCACHE_DIR="$(BR2_DL_DIR)/.buildroot-ccache"
BR2_OPTIMIZE_S=y
BR2_PACKAGE_OVERRIDE_FILE="$(BR2_EXTERNAL_SUMMIT_SOM_PATH)/board/som-local.mk"
BR2_GLOBAL_PATCH_DIR="$(BR2_EXTERNAL_SUMMIT_SOM_PATH)/board/patches-common"
BR2_PER_PACKAGE_DIRECTORIES=y
BR2_TARGET_GENERIC_HOSTNAME="summit"
BR2_TARGET_GENERIC_ISSUE="Summit"
BR2_INIT_SYSTEMD=y
BR2_PACKAGE_SYSTEMD_DEFAULT_TARGET="graphical.target"
BR2_ROOTFS_DEVICE_TABLE="$(BR2_EXTERNAL_SUMMIT_SOM_PATH)/board/device_table.txt"
BR2_TARGET_GENERIC_ROOT_PASSWD="summit"
BR2_TARGET_GENERIC_GETTY_PORT="tty0"
# BR2_TARGET_GENERIC_REMOUNT_ROOTFS_RW is not set
BR2_ENABLE_LOCALE_WHITELIST="en_US"
BR2_ROOTFS_OVERLAY="$(BR2_EXTERNAL_SUMMIT_SOM_PATH)/board/rootfs-additions-60 $(BR2_EXTERNAL_SUMMIT_SOM_PATH)/board/nitrogen/rootfs-additions-wm8962audio"
BR2_ROOTFS_POST_BUILD_SCRIPT="$(BR2_EXTERNAL_SUMMIT_SOM_PATH)/board/post_build_common.sh"
BR2_ROOTFS_POST_IMAGE_SCRIPT="$(BR2_EXTERNAL_SUMMIT_SOM_PATH)/board/post_image_common.sh"
BR2_ROOTFS_POST_SCRIPT_ARGS="imx8"
BR2_LINUX_KERNEL=y
BR2_LINUX_KERNEL_CUSTOM_TARBALL=y
BR2_LINUX_KERNEL_CUSTOM_TARBALL_LOCATION="$(call github,nxp-imx,linux-imx,lf-6.12.49-2.2.0)/linux-imx-lf-6.12.49-2.2.0.tar.gz"
BR2_LINUX_KERNEL_PATCH="$(BR2_EXTERNAL_SUMMIT_SOM_PATH)/board/patches-common/linux-imx"
BR2_LINUX_KERNEL_USE_CUSTOM_CONFIG=y
BR2_LINUX_KERNEL_CUSTOM_CONFIG_FILE="$(BR2_EXTERNAL_SUMMIT_SOM_PATH)/board/nitrogen/configs/nitrogen_imx8mp_defconfig"
BR2_LINUX_KERNEL_DTS_SUPPORT=y
BR2_LINUX_KERNEL_CUSTOM_DTS_DIR="$(BR2_EXTERNAL_SUMMIT_SOM_PATH)/board/nitrogen/configs/kernel-dts-8mp-smarc"
BR2_LINUX_KERNEL_DTB_OVERLAY_SUPPORT=y
BR2_LINUX_KERNEL_NEEDS_HOST_OPENSSL=y
BR2_PACKAGE_BUSYBOX_CONFIG="$(BR2_EXTERNAL_SUMMIT_SOM_PATH)/board/configs-common/busybox.config"
BR2_PACKAGE_ALSA_UTILS=y
BR2_PACKAGE_ALSA_UTILS_APLAY=y
BR2_PACKAGE_ALSA_UTILS_SPEAKER_TEST=y
BR2_PACKAGE_GSTREAMER1=y
BR2_PACKAGE_GST1_PLUGINS_BASE_LIB_OPENGL=y
BR2_PACKAGE_GST1_PLUGINS_BASE_PLUGIN_ALSA=y
BR2_PACKAGE_GST1_PLUGINS_GOOD=y
BR2_PACKAGE_GST1_PLUGINS_GOOD_JPEG=y
BR2_PACKAGE_GST1_PLUGINS_GOOD_PLUGIN_AUTODETECT=y
BR2_PACKAGE_GST1_PLUGINS_GOOD_PLUGIN_VIDEOBOX=y
BR2_PACKAGE_GST1_PLUGINS_GOOD_PLUGIN_VIDEOCROP=y
BR2_PACKAGE_GST1_PLUGINS_GOOD_PLUGIN_VIDEOFILTER=y
BR2_PACKAGE_GST1_PLUGINS_GOOD_PLUGIN_V4L2=y
BR2_PACKAGE_GST1_PLUGINS_GOOD_PLUGIN_V4L2_PROBE=y
BR2_PACKAGE_GST1_PLUGINS_BAD=y
BR2_PACKAGE_GST1_PLUGINS_BAD_PLUGIN_FBDEV=y
BR2_PACKAGE_GST1_PLUGINS_BAD_PLUGIN_KMS=y
BR2_PACKAGE_LSOF=y
BR2_PACKAGE_NETPERF=y
BR2_PACKAGE_STRACE=y
BR2_PACKAGE_STRESS_NG=y
BR2_PACKAGE_TRACE_CMD=y
BR2_PACKAGE_WHETSTONE=y
BR2_PACKAGE_E2FSPROGS=y
BR2_PACKAGE_MMC_UTILS=y
BR2_PACKAGE_GLMARK2=y
BR2_PACKAGE_PSPLASH=y
BR2_PACKAGE_PSPLASH_IMAGE="$(BR2_EXTERNAL_SUMMIT_SOM_PATH)/board/configs-common/ezurio-splash-logo.png"
# BR2_PACKAGE_PSPLASH_STARTUP_MSG is not set
BR2_PACKAGE_PSPLASH_FULL_SCREEN=y
BR2_PACKAGE_VULKAN_TOOLS=y
BR2_PACKAGE_WESTON=y
BR2_PACKAGE_EVTEST=y
BR2_PACKAGE_FREESCALE_IMX=y
BR2_PACKAGE_FREESCALE_IMX_PLATFORM_IMX8MP=y
BR2_PACKAGE_FIRMWARE_IMX=y
BR2_PACKAGE_IMX_GPU_G2D=y
BR2_PACKAGE_GPTFDISK=y
BR2_PACKAGE_GPTFDISK_SGDISK=y
BR2_PACKAGE_I2C_TOOLS=y
BR2_PACKAGE_MDIO_TOOLS=y
BR2_PACKAGE_PCIUTILS=y
BR2_PACKAGE_SPI_TOOLS=y
BR2_PACKAGE_USBUTILS=y
BR2_PACKAGE_PYTHON3=y
BR2_PACKAGE_PYTHON_DBUS_FAST=y
BR2_PACKAGE_CA_CERTIFICATES=y
BR2_PACKAGE_LIBSSH=y
BR2_PACKAGE_LIBOPENSSL_BIN=y
BR2_PACKAGE_LIBOPENSSL_3_0=y
BR2_PACKAGE_PKCS11_HELPER=y
BR2_PACKAGE_WAYLAND_UTILS=y
BR2_PACKAGE_LIBGPIOD2=y
BR2_PACKAGE_LIBGPIOD2_TOOLS=y
BR2_PACKAGE_LIBV4L=y
BR2_PACKAGE_LIBV4L_UTILS=y
BR2_PACKAGE_LIBCURL=y
BR2_PACKAGE_LIBCURL_CURL=y
# BR2_PACKAGE_LIBCURL_PROXY_SUPPORT is not set
# BR2_PACKAGE_LIBCURL_COOKIES_SUPPORT is not set
# BR2_PACKAGE_LIBCURL_EXTRA_PROTOCOLS_FEATURES is not set
BR2_PACKAGE_BLUEZ5_UTILS=y
BR2_PACKAGE_BLUEZ5_UTILS_CLIENT=y
BR2_PACKAGE_BLUEZ5_UTILS_TOOLS=y
BR2_PACKAGE_BLUEZ5_UTILS_PLUGINS_HID=y
BR2_PACKAGE_BRIDGE_UTILS=y
BR2_PACKAGE_CAN_UTILS=y
BR2_PACKAGE_CHRONY=y
BR2_PACKAGE_CONNTRACK_TOOLS=y
BR2_PACKAGE_DNSMASQ=y
# BR2_PACKAGE_DNSMASQ_TFTP is not set
BR2_PACKAGE_DROPBEAR=y
BR2_PACKAGE_EBTABLES=y
BR2_PACKAGE_ETHTOOL=y
# BR2_PACKAGE_IFUPDOWN_SCRIPTS is not set
BR2_PACKAGE_IPERF=y
BR2_PACKAGE_IPERF3=y
BR2_PACKAGE_IPROUTE2=y
BR2_PACKAGE_IPTABLES=y
BR2_PACKAGE_IW=y
BR2_PACKAGE_TCPDUMP=y
BR2_PACKAGE_OPTEE_CLIENT=y
BR2_PACKAGE_OPTEE_CLIENT_CUSTOM_TARBALL=y
BR2_PACKAGE_OPTEE_CLIENT_CUSTOM_TARBALL_LOCATION="$(call github,nxp-imx,imx-optee-client,lf-6.12.49_2.2.0)/imx-optee-client-lf-6.12.49_2.2.0.tar.gz"
BR2_PACKAGE_OPTEE_CLIENT_TEE_FS_PATH="/perm/tee"
BR2_PACKAGE_SWUPDATE_CONFIG="$(BR2_EXTERNAL_SUMMIT_SOM_PATH)/board/configs-common/swupdate_emmc.config"
# BR2_PACKAGE_SWUPDATE_WEBSERVER is not set
# BR2_PACKAGE_SYSTEMD_PSTORE is not set
# BR2_PACKAGE_SYSTEMD_HWDB is not set
BR2_PACKAGE_SYSTEMD_LOGIND=y
# BR2_PACKAGE_SYSTEMD_MYHOSTNAME is not set
# BR2_PACKAGE_SYSTEMD_NETWORKD is not set
# BR2_PACKAGE_SYSTEMD_RESOLVED is not set
# BR2_PACKAGE_SYSTEMD_TIMESYNCD is not set
BR2_PACKAGE_SYSTEMD_UTMP=y
BR2_PACKAGE_UTIL_LINUX_BINARIES=y
BR2_PACKAGE_UTIL_LINUX_HWCLOCK=y
BR2_PACKAGE_UTIL_LINUX_LOGIN=y
BR2_PACKAGE_LESS=y
BR2_TARGET_ROOTFS_SQUASHFS=y
BR2_TARGET_ROOTFS_SQUASHFS4_ZSTD=y
# BR2_TARGET_ROOTFS_TAR is not set
BR2_TARGET_ARM_TRUSTED_FIRMWARE=y
BR2_TARGET_ARM_TRUSTED_FIRMWARE_CUSTOM_TARBALL=y
BR2_TARGET_ARM_TRUSTED_FIRMWARE_CUSTOM_TARBALL_LOCATION="$(call github,nxp-imx,imx-atf,lf-6.12.49-2.2.0)/imx-atf-lf-6.12.49-2.2.0.tar.gz"
BR2_TARGET_ARM_TRUSTED_FIRMWARE_PLATFORM="imx8mp"
BR2_TARGET_ARM_TRUSTED_FIRMWARE_BL32_OPTEE=y
BR2_TARGET_OPTEE_OS=y
BR2_TARGET_OPTEE_OS_CUSTOM_TARBALL=y
BR2_TARGET_OPTEE_OS_CUSTOM_TARBALL_LOCATION="$(call github,nxp-imx,imx-optee-os,lf-6.12.49_2.2.0)/imx-optee-os-lf-6.12.49_2.2.0.tar.gz"
BR2_TARGET_OPTEE_OS_NEEDS_PYTHON_CRYPTOGRAPHY=y
BR2_TARGET_OPTEE_OS_PLATFORM="imx"
BR2_TARGET_OPTEE_OS_PLATFORM_FLAVOR="mx8mpevk"
BR2_TARGET_OPTEE_OS_ADDITIONAL_VARIABLES="CFG_TEE_CORE_LOG_LEVEL=1 CFG_IN_TREE_EARLY_TAS=trusted_keys/f04a0fe7-1f5d-4b9b-abf7-619b85b4ce8c"
BR2_TARGET_UBOOT=y
BR2_TARGET_UBOOT_BUILD_SYSTEM_KCONFIG=y
BR2_TARGET_UBOOT_CUSTOM_VERSION=y
BR2_TARGET_UBOOT_CUSTOM_VERSION_VALUE="custom"
BR2_TARGET_UBOOT_BOARD_DEFCONFIG="nitrogen_imx8mp_2g_r2"
BR2_TARGET_UBOOT_NEEDS_DTC=y
BR2_TARGET_UBOOT_NEEDS_OPENSSL=y
BR2_TARGET_UBOOT_NEEDS_ATF_BL31=y
BR2_TARGET_UBOOT_NEEDS_OPTEE_TEE=y
BR2_TARGET_UBOOT_NEEDS_IMX_FIRMWARE=y
BR2_TARGET_UBOOT_USE_BINMAN=y
# BR2_TARGET_UBOOT_FORMAT_BIN is not set
BR2_TARGET_UBOOT_FORMAT_DTB=y
BR2_TARGET_UBOOT_FORMAT_CUSTOM=y
BR2_TARGET_UBOOT_FORMAT_CUSTOM_NAME="flash.bin"
BR2_TARGET_UBOOT_INITIAL_ENV=y
BR2_TARGET_UBOOT_CUSTOM_MAKEOPTS="BINMAN_VERBOSE=3"
BR2_PACKAGE_HOST_DOSFSTOOLS=y
BR2_PACKAGE_HOST_E2FSPROGS=y
BR2_PACKAGE_HOST_MTOOLS=y
# BR2_SUMMIT_CONSOLE_LOGGING is not set
BR2_SUMMIT_SW_DESCRIPTION="$(BR2_EXTERNAL_SUMMIT_SOM_PATH)/board/nitrogen/configs/sw-description"
BR2_PACKAGE_MC_MINT=y
BR2_PACKAGE_SUMMIT_AUTOMOUNT=y
BR2_PACKAGE_SUMMIT_CAMERA_SETUP=y
BR2_PACKAGE_SUMMIT_SET_MODE=y
BR2_PACKAGE_SUMMIT_UPDATE=y
BR2_PACKAGE_SUMMIT_USBGADGET=y
BR2_PACKAGE_SUMMIT_USBGADGET_OTG=y
BR2_PACKAGE_WESTON_INIT=y
BR2_PACKAGE_WESTON_INIT_AUTOLOGIN=y
BR2_PACKAGE_ARDUCAM_PIVARIETY=y
BR2_PACKAGE_FBIDA=y
BR2_SUMMIT_COMBO_IMAGE_RADIO=y
BR2_PACKAGE_SUMMIT_FIRMWARE_60_PCIE_UART=y
BR2_PACKAGE_SUMMIT_FIRMWARE_LWB_IF_IF573_PCIE=y
BR2_PACKAGE_SUMMIT_FIRMWARE_LWB_IF_IF513_SA=y
BR2_PACKAGE_SUMMIT_FIRMWARE_LWB_IF_LWB5PLUS_SDIO_DIV=y
BR2_PACKAGE_SUMMIT_FIRMWARE_LWB_IF_LWB5PLUS_SDIO_SA=y
BR2_PACKAGE_SUMMIT_FIRMWARE_LWB_IF_LWB5PLUS_USB_SA=y
BR2_PACKAGE_SUMMIT_FIRMWARE_LWB_IF_LWBPLUS=y
BR2_PACKAGE_SUMMIT_FIRMWARE_NX61X_1218=y
```

## configs/wb50nsd_legacy-wbx3_defconfig
```kconfig
BR2_arm=y
BR2_cortex_a5=y
BR2_ARM_ENABLE_VFP=y
BR2_ARM_INSTRUCTIONS_THUMB2=y
BR2_TOOLCHAIN_EXTERNAL=y
BR2_TOOLCHAIN_EXTERNAL_SUMMIT_ARM=y
BR2_WGET="wget --passive-ftp -nd --auth-no-challenge"
BR2_DL_DIR="$(HOME)/.br2_dl_dir"
BR2_CCACHE=y
BR2_CCACHE_DIR="$(BR2_DL_DIR)/.buildroot-ccache"
BR2_PACKAGE_OVERRIDE_FILE="$(BR2_EXTERNAL_SUMMIT_SOM_PATH)/board/som-local.mk"
BR2_PER_PACKAGE_DIRECTORIES=y
BR2_TIME_BITS_64=y
BR2_TARGET_GENERIC_HOSTNAME="summit"
BR2_TARGET_GENERIC_ISSUE="Summit"
BR2_INIT_NONE=y
BR2_ROOTFS_DEVICE_TABLE=""
# BR2_TARGET_ENABLE_ROOT_LOGIN is not set
BR2_SYSTEM_BIN_SH_NONE=y
# BR2_TARGET_GENERIC_GETTY is not set
# BR2_TARGET_GENERIC_REMOUNT_ROOTFS_RW is not set
# BR2_ENABLE_LOCALE_PURGE is not set
BR2_ROOTFS_POST_IMAGE_SCRIPT="$(BR2_EXTERNAL_SUMMIT_SOM_PATH)/board/wb50nsd_legacy-wbx3/post_image.sh"
# BR2_PACKAGE_BUSYBOX is not set
# BR2_PACKAGE_IFUPDOWN_SCRIPTS is not set
# BR2_TARGET_ROOTFS_TAR is not set
BR2_TARGET_UBOOT=y
BR2_TARGET_UBOOT_BUILD_SYSTEM_KCONFIG=y
BR2_TARGET_UBOOT_CUSTOM_VERSION=y
BR2_TARGET_UBOOT_CUSTOM_VERSION_VALUE="2024.04"
BR2_TARGET_UBOOT_BOARD_DEFCONFIG="wb50nsd_legacy-wbx3"
BR2_TARGET_UBOOT_NEEDS_DTC=y
# BR2_TARGET_UBOOT_FORMAT_BIN is not set
BR2_TARGET_UBOOT_FORMAT_ITB=y
BR2_TARGET_UBOOT_FORMAT_INITIAL_ENV=y
BR2_TARGET_UBOOT_SPL=y
BR2_TARGET_UBOOT_SPL_NAME="spl/boot.bin"
```

## package-3rd-party/arducam-pivariety/Config.in
```kconfig
config BR2_PACKAGE_ARDUCAM_PIVARIETY
	bool "Arducam Pivariety"
	depends on BR2_LINUX_KERNEL
	help
	  Arducam Pivariety Camera Driver
```

## package-3rd-party/aws-kms-pkcs11/Config.in
```kconfig
config BR2_PACKAGE_AWS_KMS_PKCS11
	bool "aws-kms-pkcs11"
	depends on BR2_PACKAGE_OPENSSL
	select BR2_PACKAGE_AWS_SDK_CPP
	select BR2_PACKAGE_JSON_C
	select BR2_PACKAGE_LIBCURL
	select BR2_PACKAGE_P11_KIT
	select BR2_PACKAGE_PKCS11_PROVIDER
	select BR2_PACKAGE_ZLIB
	help
	  PKCS#11 provider using AWS KMS as the signing backend.

	  https://github.com/JackOfMostTrades/aws-kms-pkcs11
```

## package-3rd-party/aws-kms-pkcs11/Config.in.host
```kconfig
config BR2_PACKAGE_HOST_AWS_KMS_PKCS11
	bool "host aws-kms-pkcs11"
	select BR2_PACKAGE_HOST_AWS_SDK_CPP
	select BR2_PACKAGE_HOST_PKCS11_PROVIDER
	help
	  PKCS#11 Provider Using AWS KMS.

	  https://github.com/JackOfMostTrades/aws-kms-pkcs11
```

## package-3rd-party/aws-sdk-cpp/Config.in
```kconfig
config BR2_PACKAGE_AWS_SDK_CPP
	bool "aws-sdk-cpp"
	depends on BR2_PACKAGE_OPENSSL
	help
	  AWS SDK for C++, a cross-platform C++ library for AWS.

	  https://aws.amazon.com/sdk-for-cpp/
```

## package-3rd-party/aws-sdk-cpp/Config.in.host
```kconfig
config BR2_PACKAGE_HOST_AWS_SDK_CPP
	bool "host aws-sdk-cpp"
	help
	  AWS SDK for C++, a cross-platform C++ library for AWS.

	  https://aws.amazon.com/sdk-for-cpp/
```

## package-3rd-party/cst/Config.in.host
```kconfig
config BR2_PACKAGE_HOST_CST
	bool "host cst (NXP Code Signing Tool)"
	help
	  NXP i.MX Code Signing Tool (CST), supporting HABv4 image
	  signing. Used by U-Boot's binman to sign SPL and FIT images
	  when CONFIG_IMX_HAB is enabled.

	  The CST_URI environment variable may be set to the base URL
	  of the directory containing the IMX_CST_TOOL_NEW.tgz tarball.
	  Buildroot will fetch $(CST_URI)/IMX_CST_TOOL_NEW.tgz.
	  Alternatively, place the tarball in BR2_DL_DIR manually.

	  https://www.nxp.com/webapp/Download?colCode=IMX_CST_TOOL_NEW
```

## package-3rd-party/fbida/Config.in
```kconfig
menuconfig BR2_PACKAGE_FBIDA
	bool "fbida"
	depends on BR2_PACKAGE_HAS_UDEV
	select BR2_PACKAGE_JPEG
	select BR2_PACKAGE_LIBDRM
	select BR2_PACKAGE_LIBINPUT
	select BR2_PACKAGE_LIBEXIF
	select BR2_PACKAGE_CAIRO
	select BR2_PACKAGE_LIBXKBCOMMON
	help
	  fbida console image viewer
	  https://github.com/kraxel/fbida.

if BR2_PACKAGE_FBIDA

# Some Gallium driver needs libelf when built with LLVM support
config BR2_PACKAGE_FBIDA_GIF
	bool "GIF support"
	select BR2_PACKAGE_GIFLIB
	help
	  Enable support for GIF images.	

config BR2_PACKAGE_FBIDA_PNG
	bool "PNG support"
	select BR2_PACKAGE_LIBPNG
	help
	  Enable support for PNG images.

config BR2_PACKAGE_FBIDA_TIFF
	bool "TIFF support"
	select BR2_PACKAGE_LIBTIFF
	help
	  Enable support for TIFF images.

config BR2_PACKAGE_FBIDA_WEBP
	bool "WebP support"
	select BR2_PACKAGE_WEBP
	help
	  Enable support for WebP images.

config BR2_PACKAGE_FBIDA_PDF
	bool "PDF support"
	select BR2_PACKAGE_POPPLER
	help
	  Enable support for PDF files.

endif # BR2_PACKAGE_FBIDA
```

## package-3rd-party/imx-secure-enclave/Config.in
```kconfig
config BR2_PACKAGE_IMX_SECURE_ENCLAVE
	bool "imx-secure-enclave"
	depends on BR2_aarch64
	depends on BR2_PACKAGE_FREESCALE_IMX_PLATFORM_IMX93
	depends on BR2_TOOLCHAIN_HAS_THREADS
	help
	  NXP EdgeLock Enclave (ELE) HSM and NVM libraries, se_tools,
	  and the nvm_daemon key store service.

	  On systemd images the nvm_daemon key store is kept in
	  /perm/ele so persistent ELE keys survive reboots.

	  https://github.com/nxp-imx/imx-secure-enclave

comment "imx-secure-enclave needs a toolchain w/ threads"
	depends on BR2_aarch64
	depends on BR2_PACKAGE_FREESCALE_IMX_PLATFORM_IMX93
	depends on !BR2_TOOLCHAIN_HAS_THREADS
```

## package-3rd-party/libplanes/Config.in
```kconfig
config BR2_PACKAGE_LIBPLANES
	bool "libplanes"
	select BR2_PACKAGE_CAIRO
	select BR2_PACKAGE_CJSON
	select BR2_PACKAGE_LIBDRM
	select BR2_PACKAGE_LUA
	help
	  libplanes is a library that provides support for working with LCD
	  controller hardware planes found on SAMA5 hardware.
```

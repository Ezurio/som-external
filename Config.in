## Config.in
```kconfig
config BR2_SUMMIT_SECURE_BOOT
	bool "Summit Secure Boot"
	select BR2_TARGET_UBOOT_NEEDS_OPENSSL
	select BR2_PACKAGE_HOST_CRYPTSETUP
	help
		This enables "traditional" (down to kernel) secure boot
		rootfs security provided by Summit Encrypted Storage Toolkit

config BR2_SUMMIT_IMX_HAB
	bool "i.MX HAB Signed Boot (CST)"
	select BR2_PACKAGE_HOST_CST
	select BR2_TARGET_UBOOT_NEEDS_OPENSSL
	help
		Enable NXP HABv4 (High Assurance Boot) signing for i.MX8M
		platforms. When enabled, U-Boot's binman uses the NXP Code
		Signing Tool (CST) to sign SPL and FIT images.

		Requires SIG_DATA_PATH environment variable to point to a
		directory containing HAB PKI certificates and keys:
		  crts/SRK_1_2_3_4_table.bin
		  crts/CSF1_1_sha256_2048_65537_v3_usr_crt.pem
		  crts/IMG1_1_sha256_2048_65537_v3_usr_crt.pem
		  keys/ (private keys and key_pass.txt)

config BR2_SUMMIT_LINUX_CUSTOM_DTB_FILTER
	string "Custom device tree blobs filter"
	help
		Set this option to select custom device tree blobs
		to use in the kernel build. The value should be a
		space-separated list of device tree blob filenames 
		or wildcard patterns.
		It's similar to running 'ls' on 'images' directory 
		and selecting desired dtb(o) files from all built.
		For example, "am625*carbon*dvk*.dtb" would select
		all dtb files with "am625", "carbon", and "dvk" in
		their names.

config BR2_SUMMIT_LINUX_DEFAULT_DTB
	string "Default device tree blob"
	help
		Set this option to select the default device tree blob
		to use in the kernel build.

config BR2_SUMMIT_LINUX_APPLY_DTBO_AT_BUILD
	bool "Apply DTBO at build time"
	help
		Set this option to apply the device tree overlay (DTBO)
		at build time.

config BR2_SUMMIT_CONSOLE_LOGGING
	bool "Enable Console Logging"
	default y if !BR2_PACKAGE_SUMMIT_ENCRYPTED_STORAGE_TOOLKIT
	help
		This enables Console Logging during boot.

config BR2_SUMMIT_EXTRA_KERNEL_CMDS
	string "Extra kernel command line parameters"
	help
		This allows you to specify extra kernel command line parameters
		to be added to the default ones.

config BR2_SUMMIT_SW_DESCRIPTION
	string "Software Description file for swupdate"
	help
		This specifies software description file to use

config BR2_SUMMIT_EMMC_DEVICE
	int "eMMC device number"
	default 0
	help
		This specifies the eMMC device number to use.
		Valid values are 0, 1, 2, 3, 4, 5, 6, 7.

config BR2_SUMMIT_OPENJDK_GGV2
	bool "summit-openjdk-ggv2"
	depends on BR2_PACKAGE_OPENJDK
	help
		Split out the OpenJDK 'modules' file dependency
		during the build to support moving Java dependecies
		to the SD card to support AWS IoT Greengrass V2. This
		flag triggers logic in the post_build and post_image
		scripts.

choice
	prompt "Use FIPS"
	optional

config BR2_SUMMIT_FIPS_11
	bool "Use FIPS 11.0"
	select BR2_PACKAGE_OPENSSL
	select BR2_PACKAGE_LIBOPENSSL_3_0
	select BR2_PACKAGE_SUMMIT_OPENSSL_FIPS_PROVIDER
	select BR2_PACKAGE_SUMMIT_FIPS_UTILS
	select BR2_SUMMIT_FIPS_RADIO
	select BR2_PACKAGE_UBOOT_TOOLS
	select BR2_PACKAGE_UBOOT_TOOLS_DUMPIMAGE
	select BR2_PACKAGE_UBOOT_TOOLS_FIT_SUPPORT
	select BR2_REPRODUCIBLE

endchoice

menu "Packages"
source "$BR2_EXTERNAL_SUMMIT_SOM_PATH/package/dcal/Config.in"
source "$BR2_EXTERNAL_SUMMIT_SOM_PATH/package/dcas/Config.in"
source "$BR2_EXTERNAL_SUMMIT_SOM_PATH/package/demo-gui/Config.in"
source "$BR2_EXTERNAL_SUMMIT_SOM_PATH/package/echotest/Config.in"
source "$BR2_EXTERNAL_SUMMIT_SOM_PATH/package/eventmon/Config.in"
source "$BR2_EXTERNAL_SUMMIT_SOM_PATH/package/ggv2support/Config.in"
source "$BR2_EXTERNAL_SUMMIT_SOM_PATH/package/ig-tty-utils/Config.in"
source "$BR2_EXTERNAL_SUMMIT_SOM_PATH/package/igconfd/Config.in"
source "$BR2_EXTERNAL_SUMMIT_SOM_PATH/package/igprovd/Config.in"
source "$BR2_EXTERNAL_SUMMIT_SOM_PATH/package/mc-mint/Config.in"
source "$BR2_EXTERNAL_SUMMIT_SOM_PATH/package/php_sdk/Config.in"
source "$BR2_EXTERNAL_SUMMIT_SOM_PATH/package/sdcsdk_nm/Config.in"
source "$BR2_EXTERNAL_SUMMIT_SOM_PATH/package/summit-automount/Config.in"
source "$BR2_EXTERNAL_SUMMIT_SOM_PATH/package/summit-bt-utils/Config.in"
source "$BR2_EXTERNAL_SUMMIT_SOM_PATH/package/summit-camera-setup/Config.in"
source "$BR2_EXTERNAL_SUMMIT_SOM_PATH/package/summit-disable-console-login/Config.in"
source "$BR2_EXTERNAL_SUMMIT_SOM_PATH/package/summit-dmcrypt-image/Config.in"
source "$BR2_EXTERNAL_SUMMIT_SOM_PATH/package/summit-edgeiq/Config.in"
source "$BR2_EXTERNAL_SUMMIT_SOM_PATH/package/summit-encrypted-storage-toolkit/Config.in"
source "$BR2_EXTERNAL_SUMMIT_SOM_PATH/package/summit-fips-utils/Config.in"
source "$BR2_EXTERNAL_SUMMIT_SOM_PATH/package/summit-firewall/Config.in"
source "$BR2_EXTERNAL_SUMMIT_SOM_PATH/package/summit-legacy/Config.in"
source "$BR2_EXTERNAL_SUMMIT_SOM_PATH/package/summit-openssl-fips-provider/Config.in"
source "$BR2_EXTERNAL_SUMMIT_SOM_PATH/package/summit-prov/Config.in"
source "$BR2_EXTERNAL_SUMMIT_SOM_PATH/package/summit-rcm/Config.in"
source "$BR2_EXTERNAL_SUMMIT_SOM_PATH/package/summit-rcm-awm-plugin/Config.in"
source "$BR2_EXTERNAL_SUMMIT_SOM_PATH/package/summit-rcm-bluetooth-plugin/Config.in"
source "$BR2_EXTERNAL_SUMMIT_SOM_PATH/package/summit-rcm-certificate-provisioning-plugin/Config.in"
source "$BR2_EXTERNAL_SUMMIT_SOM_PATH/package/summit-rcm-chrony-plugin/Config.in"
source "$BR2_EXTERNAL_SUMMIT_SOM_PATH/package/summit-rcm-firewall-plugin/Config.in"
source "$BR2_EXTERNAL_SUMMIT_SOM_PATH/package/summit-rcm-log-forwarding-plugin/Config.in"
source "$BR2_EXTERNAL_SUMMIT_SOM_PATH/package/summit-rcm-radio-siso-mode-plugin/Config.in"
source "$BR2_EXTERNAL_SUMMIT_SOM_PATH/package/summit-rcm-stunnel-plugin/Config.in"
source "$BR2_EXTERNAL_SUMMIT_SOM_PATH/package/summit-rcm-unauthenticated-plugin/Config.in"
source "$BR2_EXTERNAL_SUMMIT_SOM_PATH/package/summit-rcm-rust/Config.in"
source "$BR2_EXTERNAL_SUMMIT_SOM_PATH/package/summit-set-mode/Config.in"
source "$BR2_EXTERNAL_SUMMIT_SOM_PATH/package/summit-swupdate-client/Config.in"
source "$BR2_EXTERNAL_SUMMIT_SOM_PATH/package/summit-update/Config.in"
source "$BR2_EXTERNAL_SUMMIT_SOM_PATH/package/summit-usbgadget/Config.in"
source "$BR2_EXTERNAL_SUMMIT_SOM_PATH/package/summit-usbgadget-legacy/Config.in"
source "$BR2_EXTERNAL_SUMMIT_SOM_PATH/package/summit-userspace-examples/Config.in"
source "$BR2_EXTERNAL_SUMMIT_SOM_PATH/package/summit-wifi-bridge/Config.in"
source "$BR2_EXTERNAL_SUMMIT_SOM_PATH/package/weston-init/Config.in"
endmenu

menu "Packages (3rd party)"
source "$BR2_EXTERNAL_SUMMIT_SOM_PATH/package-3rd-party/arducam-pivariety/Config.in"
source "$BR2_EXTERNAL_SUMMIT_SOM_PATH/package-3rd-party/aws-kms-pkcs11/Config.in.host"
source "$BR2_EXTERNAL_SUMMIT_SOM_PATH/package-3rd-party/aws-sdk-cpp/Config.in.host"
source "$BR2_EXTERNAL_SUMMIT_SOM_PATH/package-3rd-party/fbida/Config.in"
source "$BR2_EXTERNAL_SUMMIT_SOM_PATH/package-3rd-party/fscryptctl_1/Config.in"
source "$BR2_EXTERNAL_SUMMIT_SOM_PATH/package-3rd-party/cst/Config.in.host"
source "$BR2_EXTERNAL_SUMMIT_SOM_PATH/package-3rd-party/libplanes/Config.in"
source "$BR2_EXTERNAL_SUMMIT_SOM_PATH/package-3rd-party/mesa-pvr/Config.in"
source "$BR2_EXTERNAL_SUMMIT_SOM_PATH/package-3rd-party/minehunt/Config.in"
source "$BR2_EXTERNAL_SUMMIT_SOM_PATH/package-3rd-party/pkcs11-provider/Config.in"
source "$BR2_EXTERNAL_SUMMIT_SOM_PATH/package-3rd-party/python-awscrt/Config.in"
source "$BR2_EXTERNAL_SUMMIT_SOM_PATH/package-3rd-party/python-awsiotsdk/Config.in"
source "$BR2_EXTERNAL_SUMMIT_SOM_PATH/package-3rd-party/python-btsocket/Config.in"
source "$BR2_EXTERNAL_SUMMIT_SOM_PATH/package-3rd-party/python-gatt/Config.in"
source "$BR2_EXTERNAL_SUMMIT_SOM_PATH/package-3rd-party/python-httptools/Config.in"
source "$BR2_EXTERNAL_SUMMIT_SOM_PATH/package-3rd-party/python-spectree/Config.in"
source "$BR2_EXTERNAL_SUMMIT_SOM_PATH/package-3rd-party/python-transitions/Config.in"
source "$BR2_EXTERNAL_SUMMIT_SOM_PATH/package-3rd-party/qt5quick1d/Config.in"
source "$BR2_EXTERNAL_SUMMIT_SOM_PATH/package-3rd-party/secure-sam-ba-cipher/Config.in.host"
source "$BR2_EXTERNAL_SUMMIT_SOM_PATH/package-3rd-party/tac5x1x/Config.in"
source "$BR2_EXTERNAL_SUMMIT_SOM_PATH/package-3rd-party/ti-rogue-km/Config.in"
source "$BR2_EXTERNAL_SUMMIT_SOM_PATH/package-3rd-party/ti-rogue-um/Config.in"
endmenu

source "$BR2_EXTERNAL_SUMMIT_SOM_PATH/toolchain/toolchain-external-summit-arm/Config.in.options"
source "$BR2_EXTERNAL_SUMMIT_SOM_PATH/package/summit-fips-toolchain/Config.in.host"
```

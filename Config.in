## configs/carbon_am67x_defconfig
```kconfig
BR2_aarch64=y
BR2_TOOLCHAIN_EXTERNAL=y
BR2_TOOLCHAIN_EXTERNAL_SUMMIT_ARM=y
BR2_TOOLCHAIN_EXTERNAL_GDB_SERVER_COPY=y
BR2_WGET="wget --passive-ftp -nd"
BR2_DL_DIR="$(HOME)/.br2_dl_dir"
BR2_CCACHE=y
BR2_CCACHE_DIR="$(BR2_DL_DIR)/.buildroot-ccache"
BR2_OPTIMIZE_S=y
BR2_PACKAGE_OVERRIDE_FILE="$(BR2_EXTERNAL_SUMMIT_SOM_PATH)/board/som-local.mk"
BR2_GLOBAL_PATCH_DIR="$(BR2_EXTERNAL_SUMMIT_SOM_PATH)/board/patches-common"
BR2_PER_PACKAGE_DIRECTORIES=y
BR2_TARGET_GENERIC_HOSTNAME="summit"
BR2_TARGET_GENERIC_ISSUE="Summit"
BR2_INIT_SYSTEMD=y
BR2_ROOTFS_DEVICE_TABLE="$(BR2_EXTERNAL_SUMMIT_SOM_PATH)/board/device_table.txt"
BR2_TARGET_GENERIC_ROOT_PASSWD="summit"
BR2_TARGET_GENERIC_GETTY_PORT="tty0"
# BR2_TARGET_GENERIC_REMOUNT_ROOTFS_RW is not set
BR2_ENABLE_LOCALE_WHITELIST="en_US"
BR2_ROOTFS_OVERLAY="$(BR2_EXTERNAL_SUMMIT_SOM_PATH)/board/rootfs-additions-60"
BR2_ROOTFS_POST_BUILD_SCRIPT="$(BR2_EXTERNAL_SUMMIT_SOM_PATH)/board/post_build_common.sh"
BR2_ROOTFS_POST_IMAGE_SCRIPT="$(BR2_EXTERNAL_SUMMIT_SOM_PATH)/board/post_image_common.sh"
BR2_ROOTFS_POST_SCRIPT_ARGS="am67sd"
BR2_LINUX_KERNEL=y
BR2_LINUX_KERNEL_CUSTOM_TARBALL=y
BR2_LINUX_KERNEL_CUSTOM_TARBALL_LOCATION="https://git.ti.com/cgit/ti-linux-kernel/ti-linux-kernel/snapshot/ti-linux-kernel-11.00.10.tar.xz"
BR2_LINUX_KERNEL_PATCH="$(BR2_EXTERNAL_SUMMIT_SOM_PATH)/board/patches-common/linux-ti"
BR2_LINUX_KERNEL_USE_CUSTOM_CONFIG=y
BR2_LINUX_KERNEL_CUSTOM_CONFIG_FILE="$(BR2_EXTERNAL_SUMMIT_SOM_PATH)/board/carbon-am67/configs/k3-am675-carbon_defconfig"
BR2_LINUX_KERNEL_DTS_SUPPORT=y
BR2_LINUX_KERNEL_CUSTOM_DTS_DIR="$(BR2_EXTERNAL_SUMMIT_SOM_PATH)/board/carbon-am67/configs/kernel-dts"
BR2_LINUX_KERNEL_DTB_OVERLAY_SUPPORT=y
BR2_LINUX_KERNEL_NEEDS_HOST_OPENSSL=y
BR2_PACKAGE_BUSYBOX_CONFIG="$(BR2_EXTERNAL_SUMMIT_SOM_PATH)/board/configs-common/busybox.config"
BR2_PACKAGE_ALSA_UTILS=y
BR2_PACKAGE_ALSA_UTILS_APLAY=y
BR2_PACKAGE_ALSA_UTILS_SPEAKER_TEST=y
BR2_PACKAGE_LSOF=y
BR2_PACKAGE_NETPERF=y
BR2_PACKAGE_STRACE=y
BR2_PACKAGE_TRACE_CMD=y
BR2_PACKAGE_WHETSTONE=y
BR2_PACKAGE_E2FSPROGS=y
BR2_PACKAGE_MMC_UTILS=y
BR2_PACKAGE_GLMARK2=y
BR2_PACKAGE_EVTEST=y
BR2_PACKAGE_GPTFDISK=y
BR2_PACKAGE_GPTFDISK_SGDISK=y
BR2_PACKAGE_I2C_TOOLS=y
BR2_PACKAGE_MDIO_TOOLS=y
BR2_PACKAGE_PCIUTILS=y
BR2_PACKAGE_USBUTILS=y
BR2_PACKAGE_CA_CERTIFICATES=y
BR2_PACKAGE_LIBSSH=y
BR2_PACKAGE_LIBOPENSSL_3_0=y
BR2_PACKAGE_LIBGPIOD2=y
BR2_PACKAGE_LIBGPIOD2_TOOLS=y
BR2_PACKAGE_LIBV4L=y
BR2_PACKAGE_LIBV4L_UTILS=y
BR2_PACKAGE_LIBCURL=y
BR2_PACKAGE_LIBCURL_CURL=y
# BR2_PACKAGE_LIBCURL_PROXY_SUPPORT is not set
# BR2_PACKAGE_LIBCURL_COOKIES_SUPPORT is not set
# BR2_PACKAGE_LIBCURL_EXTRA_PROTOCOLS_FEATURES is not set
BR2_PACKAGE_BLUEZ5_UTILS=y
BR2_PACKAGE_BLUEZ5_UTILS_CLIENT=y
BR2_PACKAGE_BLUEZ5_UTILS_TOOLS=y
BR2_PACKAGE_BRIDGE_UTILS=y
BR2_PACKAGE_CAN_UTILS=y
BR2_PACKAGE_CHRONY=y
BR2_PACKAGE_CONNTRACK_TOOLS=y
BR2_PACKAGE_DNSMASQ=y
# BR2_PACKAGE_DNSMASQ_TFTP is not set
BR2_PACKAGE_DROPBEAR=y
BR2_PACKAGE_EBTABLES=y
BR2_PACKAGE_ETHTOOL=y
# BR2_PACKAGE_IFUPDOWN_SCRIPTS is not set
BR2_PACKAGE_IPERF=y
BR2_PACKAGE_IPERF3=y
BR2_PACKAGE_IPROUTE2=y
BR2_PACKAGE_IPTABLES=y
BR2_PACKAGE_IW=y
BR2_PACKAGE_TCPDUMP=y
BR2_PACKAGE_WIRELESS_REGDB=y
BR2_PACKAGE_OPTEE_CLIENT=y
BR2_PACKAGE_OPTEE_CLIENT_CUSTOM_TARBALL=y
BR2_PACKAGE_OPTEE_CLIENT_CUSTOM_TARBALL_LOCATION="$(call github,OP-TEE,optee_client,4.5.0)/optee_client-4.5.0.tar.gz"
BR2_PACKAGE_OPTEE_CLIENT_TEE_FS_PATH="/perm/caam"
BR2_PACKAGE_SWUPDATE_CONFIG="$(BR2_EXTERNAL_SUMMIT_SOM_PATH)/board/configs-common/swupdate_emmc.config"
# BR2_PACKAGE_SWUPDATE_WEBSERVER is not set
# BR2_PACKAGE_SYSTEMD_PSTORE is not set
BR2_PACKAGE_SYSTEMD_HIBERNATE=y
# BR2_PACKAGE_SYSTEMD_HWDB is not set
BR2_PACKAGE_SYSTEMD_LOGIND=y
# BR2_PACKAGE_SYSTEMD_MYHOSTNAME is not set
# BR2_PACKAGE_SYSTEMD_NETWORKD is not set
# BR2_PACKAGE_SYSTEMD_RESOLVED is not set
# BR2_PACKAGE_SYSTEMD_TIMESYNCD is not set
# BR2_PACKAGE_SYSTEMD_VCONSOLE is not set
BR2_PACKAGE_UTIL_LINUX_BINARIES=y
BR2_PACKAGE_UTIL_LINUX_HWCLOCK=y
BR2_PACKAGE_LESS=y
BR2_TARGET_ROOTFS_SQUASHFS=y
BR2_TARGET_ROOTFS_SQUASHFS4_ZSTD=y
# BR2_TARGET_ROOTFS_TAR is not set
BR2_TARGET_ARM_TRUSTED_FIRMWARE=y
BR2_TARGET_ARM_TRUSTED_FIRMWARE_PLATFORM="k3"
BR2_TARGET_ARM_TRUSTED_FIRMWARE_TARGET_BOARD="lite"
BR2_TARGET_ARM_TRUSTED_FIRMWARE_BL32_OPTEE=y
BR2_TARGET_OPTEE_OS=y
BR2_TARGET_OPTEE_OS_CUSTOM_TARBALL=y
BR2_TARGET_OPTEE_OS_CUSTOM_TARBALL_LOCATION="$(call github,OP-TEE,optee_os,4.5.0)/optee_os-4.5.0.tar.gz"
BR2_TARGET_OPTEE_OS_NEEDS_PYTHON_CRYPTOGRAPHY=y
BR2_TARGET_OPTEE_OS_PLATFORM="k3-am62x"
BR2_TARGET_TI_K3_BOOT_FIRMWARE_CPU="j722s"
BR2_TARGET_TI_K3_BOOT_FIRMWARE_VPU=y
BR2_TARGET_TI_K3_R5_LOADER=y
BR2_TARGET_TI_K3_R5_LOADER_CUSTOM_VERSION=y
BR2_TARGET_TI_K3_R5_LOADER_CUSTOM_VERSION_VALUE="custom"
BR2_TARGET_TI_K3_R5_LOADER_BOARD_DEFCONFIG="carbon_am67_r5"
BR2_TARGET_UBOOT=y
BR2_TARGET_UBOOT_BUILD_SYSTEM_KCONFIG=y
BR2_TARGET_UBOOT_CUSTOM_VERSION=y
BR2_TARGET_UBOOT_CUSTOM_VERSION_VALUE="custom"
BR2_TARGET_UBOOT_BOARD_DEFCONFIG="carbon_am67_a53"
BR2_TARGET_UBOOT_NEEDS_DTC=y
BR2_TARGET_UBOOT_NEEDS_OPENSSL=y
BR2_TARGET_UBOOT_NEEDS_ATF_BL31=y
BR2_TARGET_UBOOT_USE_BINMAN=y
# BR2_TARGET_UBOOT_FORMAT_BIN is not set
BR2_TARGET_UBOOT_FORMAT_DTB=y
BR2_TARGET_UBOOT_FORMAT_IMG=y
BR2_TARGET_UBOOT_SPL=y
BR2_TARGET_UBOOT_SPL_NAME="tispl.bin"
BR2_TARGET_UBOOT_INITIAL_ENV=y
BR2_TARGET_UBOOT_CUSTOM_MAKEOPTS="TEE=$(BINARIES_DIR)/tee-pager_v2.bin"
BR2_PACKAGE_HOST_CRYPTSETUP=y
BR2_PACKAGE_HOST_DOSFSTOOLS=y
BR2_PACKAGE_HOST_E2FSPROGS=y
BR2_PACKAGE_HOST_MTOOLS=y
BR2_SUMMIT_SW_DESCRIPTION="$(BR2_EXTERNAL_SUMMIT_SOM_PATH)/board/carbon-am62/configs/sw-description"
BR2_PACKAGE_MC_MINT=y
BR2_PACKAGE_SUMMIT_AUTOMOUNT=y
BR2_PACKAGE_SUMMIT_RCM=y
BR2_PACKAGE_SUMMIT_SET_MODE=y
BR2_PACKAGE_SUMMIT_UPDATE=y
BR2_PACKAGE_SUMMIT_USBGADGET=y
BR2_PACKAGE_SUMMIT_USBGADGET_OTG=y
BR2_PACKAGE_FBIDA=y
BR2_PACKAGE_MESA_PVR=y
BR2_PACKAGE_MESA_PVR_GALLIUM_DRIVER_ROGUE=y
BR2_PACKAGE_MESA_PVR_VULKAN_DRIVER_ROGUE=y
BR2_PACKAGE_TAC5X1X=y
BR2_TARGET_TI_ROGUE_KM_TARGET_PRODUCT="j722s_linux"
BR2_PACKAGE_TI_ROGUE_UM=y
BR2_TARGET_TI_ROGUE_UM_TARGET_PRODUCT="j722s_linux"
BR2_SUMMIT_COMBO_IMAGE_RADIO=y
BR2_PACKAGE_SUMMIT_ADAPTIVE_BT=y
BR2_PACKAGE_SUMMIT_ADAPTIVE_WW=y
BR2_PACKAGE_SUMMIT_BT_UART_SCRIPTS_60=y
BR2_PACKAGE_SUMMIT_BT_UART_SCRIPTS_60_PORT="/dev/ttyS5"
BR2_PACKAGE_SUMMIT_FIRMWARE_60_PCIE_UART=y
BR2_PACKAGE_SUMMIT_FIRMWARE_60_USB_USB=y
BR2_PACKAGE_SUMMIT_FIRMWARE_LWB_IF_LWB5PLUS_SDIO_DIV=y
BR2_PACKAGE_SUMMIT_FIRMWARE_LWB_IF_LWB5PLUS_SDIO_SA=y
BR2_PACKAGE_SUMMIT_FIRMWARE_LWB_IF_LWB5PLUS_USB_SA=y
BR2_PACKAGE_SUMMIT_FIRMWARE_LWB_IF_LWBPLUS=y
BR2_PACKAGE_SUMMIT_FIRMWARE_LWB_IF_IF573_PCIE=y
BR2_PACKAGE_SUMMIT_FIRMWARE_LWB_IF_IF513_SA=y
BR2_PACKAGE_SUMMIT_FIRMWARE_NX61X_1218=y
BR2_PACKAGE_SUMMIT_FIRMWARE_NX61X_SERDEV=y
```

## configs/nitrogen_imx8mm_smarc_uuu_defconfig
```kconfig
BR2_aarch64=y
BR2_TOOLCHAIN_EXTERNAL=y
BR2_TOOLCHAIN_EXTERNAL_SUMMIT_ARM=y
BR2_WGET="wget --passive-ftp -nd"
BR2_DL_DIR="$(HOME)/.br2_dl_dir"
BR2_CCACHE=y
BR2_CCACHE_DIR="$(BR2_DL_DIR)/.buildroot-ccache"
BR2_OPTIMIZE_S=y
BR2_PACKAGE_OVERRIDE_FILE="$(BR2_EXTERNAL_SUMMIT_SOM_PATH)/board/som-local.mk"
BR2_GLOBAL_PATCH_DIR="$(BR2_EXTERNAL_SUMMIT_SOM_PATH)/board/patches-common"
BR2_PER_PACKAGE_DIRECTORIES=y
BR2_TARGET_GENERIC_HOSTNAME="summit"
BR2_TARGET_GENERIC_ISSUE="Summit"
BR2_ROOTFS_DEVICE_CREATION_DYNAMIC_EUDEV=y
BR2_ROOTFS_DEVICE_TABLE="$(BR2_EXTERNAL_SUMMIT_SOM_PATH)/board/device_table.txt"
BR2_ROOTFS_MERGED_USR=y
# BR2_TARGET_ENABLE_ROOT_LOGIN is not set
# BR2_TARGET_GENERIC_REMOUNT_ROOTFS_RW is not set
BR2_ROOTFS_OVERLAY="$(BR2_EXTERNAL_SUMMIT_SOM_PATH)/board/rootfs-additions-60 $(BR2_EXTERNAL_SUMMIT_SOM_PATH)/board/nitrogen/rootfs-additions-wm8962audio"
BR2_ROOTFS_POST_BUILD_SCRIPT="$(BR2_EXTERNAL_SUMMIT_SOM_PATH)/board/post_build_common.sh"
BR2_ROOTFS_POST_IMAGE_SCRIPT="$(BR2_EXTERNAL_SUMMIT_SOM_PATH)/board/post_image_common.sh"
BR2_ROOTFS_POST_SCRIPT_ARGS="imx8"
BR2_LINUX_KERNEL=y
BR2_LINUX_KERNEL_CUSTOM_TARBALL=y
BR2_LINUX_KERNEL_CUSTOM_TARBALL_LOCATION="$(call github,nxp-imx,linux-imx,lf-6.18.20-2.0.0)/linux-imx-lf-6.18.20-2.0.0.tar.gz"
BR2_LINUX_KERNEL_PATCH="$(BR2_EXTERNAL_SUMMIT_SOM_PATH)/board/patches-common/linux-imx"
BR2_LINUX_KERNEL_USE_CUSTOM_CONFIG=y
BR2_LINUX_KERNEL_CUSTOM_CONFIG_FILE="$(BR2_EXTERNAL_SUMMIT_SOM_PATH)/board/nitrogen/configs/nitrogen_imx8mm_defconfig"
BR2_LINUX_KERNEL_DTS_SUPPORT=y
BR2_LINUX_KERNEL_CUSTOM_DTS_DIR="$(BR2_EXTERNAL_SUMMIT_SOM_PATH)/board/nitrogen/configs/kernel-dts-8mm-smarc"
BR2_LINUX_KERNEL_NEEDS_HOST_OPENSSL=y
BR2_PACKAGE_BUSYBOX_CONFIG="$(BR2_EXTERNAL_SUMMIT_SOM_PATH)/board/configs-common/busybox-wbx.config"
BR2_PACKAGE_BUSYBOX_SHOW_OTHERS=y
BR2_PACKAGE_E2FSPROGS=y
BR2_PACKAGE_MMC_UTILS=y
BR2_PACKAGE_FREESCALE_IMX=y
BR2_PACKAGE_FREESCALE_IMX_PLATFORM_IMX8MM=y
BR2_PACKAGE_FIRMWARE_IMX=y
BR2_PACKAGE_GPTFDISK=y
BR2_PACKAGE_GPTFDISK_SGDISK=y
BR2_PACKAGE_CA_CERTIFICATES=y
BR2_PACKAGE_LIBOPENSSL_BIN=y
BR2_PACKAGE_LIBOPENSSL_3_0=y
BR2_PACKAGE_LIBCURL=y
BR2_PACKAGE_LIBCURL_CURL=y
# BR2_PACKAGE_LIBCURL_PROXY_SUPPORT is not set
# BR2_PACKAGE_LIBCURL_COOKIES_SUPPORT is not set
# BR2_PACKAGE_LIBCURL_EXTRA_PROTOCOLS_FEATURES is not set
BR2_PACKAGE_DHCPCD=y
# BR2_PACKAGE_DHCPCD_ENABLE_PRIVSEP is not set
BR2_PACKAGE_DROPBEAR=y
# BR2_PACKAGE_IFUPDOWN_SCRIPTS is not set
BR2_PACKAGE_IPROUTE2=y
BR2_PACKAGE_OPTEE_CLIENT=y
BR2_PACKAGE_OPTEE_CLIENT_CUSTOM_TARBALL=y
BR2_PACKAGE_OPTEE_CLIENT_CUSTOM_TARBALL_LOCATION="$(call github,nxp-imx,imx-optee-client,lf-6.18.20_2.0.0)/imx-optee-client-lf-6.18.20_2.0.0.tar.gz"
BR2_PACKAGE_OPTEE_CLIENT_TEE_FS_PATH="/perm/tee"
BR2_PACKAGE_SWUPDATE_CONFIG="$(BR2_EXTERNAL_SUMMIT_SOM_PATH)/board/configs-common/swupdate_emmc.config"
# BR2_PACKAGE_SWUPDATE_WEBSERVER is not set
BR2_TARGET_ROOTFS_CPIO_ZSTD=y
BR2_TARGET_ROOTFS_CPIO_UIMAGE=y
# BR2_TARGET_ROOTFS_TAR is not set
BR2_TARGET_ARM_TRUSTED_FIRMWARE=y
BR2_TARGET_ARM_TRUSTED_FIRMWARE_CUSTOM_TARBALL=y
BR2_TARGET_ARM_TRUSTED_FIRMWARE_CUSTOM_TARBALL_LOCATION="$(call github,nxp-imx,imx-atf,lf-6.18.20-2.0.0)/imx-atf-lf-6.18.20-2.0.0.tar.gz"
BR2_TARGET_ARM_TRUSTED_FIRMWARE_PLATFORM="imx8mm"
BR2_TARGET_ARM_TRUSTED_FIRMWARE_BL32_OPTEE=y
BR2_TARGET_OPTEE_OS=y
BR2_TARGET_OPTEE_OS_CUSTOM_TARBALL=y
BR2_TARGET_OPTEE_OS_CUSTOM_TARBALL_LOCATION="$(call github,nxp-imx,imx-optee-os,lf-6.18.20_2.0.0)/imx-optee-os-lf-6.18.20_2.0.0.tar.gz"
BR2_TARGET_OPTEE_OS_NEEDS_PYTHON_CRYPTOGRAPHY=y
BR2_TARGET_OPTEE_OS_PLATFORM="imx"
BR2_TARGET_OPTEE_OS_PLATFORM_FLAVOR="mx8mmevk"
BR2_TARGET_OPTEE_OS_ADDITIONAL_VARIABLES="CFG_TEE_CORE_LOG_LEVEL=1 CFG_CORE_LARGE_PHYS_ADDR=y CFG_CORE_ARM64_PA_BITS=36 CFG_IN_TREE_EARLY_TAS=trusted_keys/f04a0fe7-1f5d-4b9b-abf7-619b85b4ce8c"
BR2_TARGET_UBOOT=y
BR2_TARGET_UBOOT_BUILD_SYSTEM_KCONFIG=y
BR2_TARGET_UBOOT_CUSTOM_VERSION=y
BR2_TARGET_UBOOT_CUSTOM_VERSION_VALUE="custom"
BR2_TARGET_UBOOT_BOARD_DEFCONFIG="nitrogen_imx8mm"
BR2_TARGET_UBOOT_NEEDS_DTC=y
BR2_TARGET_UBOOT_NEEDS_OPENSSL=y
BR2_TARGET_UBOOT_NEEDS_ATF_BL31=y
BR2_TARGET_UBOOT_NEEDS_OPTEE_TEE=y
BR2_TARGET_UBOOT_NEEDS_IMX_FIRMWARE=y
BR2_TARGET_UBOOT_USE_BINMAN=y
# BR2_TARGET_UBOOT_FORMAT_BIN is not set
BR2_TARGET_UBOOT_FORMAT_DTB=y
BR2_TARGET_UBOOT_FORMAT_CUSTOM=y
BR2_TARGET_UBOOT_FORMAT_CUSTOM_NAME="flash.bin"
BR2_TARGET_UBOOT_INITIAL_ENV=y
BR2_TARGET_UBOOT_CUSTOM_MAKEOPTS="BINMAN_VERBOSE=3"
BR2_PACKAGE_HOST_DOSFSTOOLS=y
BR2_PACKAGE_HOST_E2FSPROGS=y
BR2_PACKAGE_HOST_MKPASSWD=y
BR2_PACKAGE_HOST_MTOOLS=y
# BR2_SUMMIT_CONSOLE_LOGGING is not set
BR2_SUMMIT_SW_DESCRIPTION="$(BR2_EXTERNAL_SUMMIT_SOM_PATH)/board/nitrogen/configs/sw-description"
BR2_PACKAGE_SUMMIT_AUTOMOUNT=y
BR2_PACKAGE_SUMMIT_UPDATE=y
BR2_PACKAGE_SUMMIT_USBGADGET=y
```

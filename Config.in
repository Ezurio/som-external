## board/configs-common/image/kernel.its
```
// SPDX-License-Identifier: GPL-2.0
/*
 * Copyright (C) 2018-2024 Ezurio
 *
 * Minimal dts for a SPL FIT image payload.
 */

/dts-v1/;

/ {
	description = "Summit Linux FIT Image";

	images {
		kernel {
			description = "Summit Linux Kernel";
			data = /incbin/("Image.gz");
			type = "kernel";
			arch = "arm";
			os = "linux";
			compression = "gzip";
			load = <0x20008000>;
			entry = <0x20008000>;
			kernel-version = <1>;

			hash {
				algo = "sha256";
			};
		};

		fdt {
			description = "Flattened Device Tree blob";
			data = /incbin/("at91-dvk_som60.dtb");
			type = "flat_dt";
			arch = "arm";
			compression = "none";
			fdt-version = <1>;

			hash {
				algo = "sha256";
			};
		};

		script {
			description = "Boot script";
			data = /incbin/("boot.scr");
			type = "script";
			arch = "arm";
			compression = "none";

			hash {
				algo = "sha256";
			};
		};
	};

	configurations {
		default = "config";

		config {
			description = "Summit Linux Kernel with FDT blob";
			kernel = "kernel";
			fdt = "fdt";
			loadables = "script";
		};
	};
};
```

## board/configs-common/image/kernel_legacy.its
```
/*
 * Copyright (C) 2018-2024 Ezurio
 *
 * Minimal dts for a SPL FIT image payload.
 *
 * SPDX-License-Identifier: GPL-2.0+  X11
 */

/dts-v1/;

/ {
	description = "Summit Linux FIT Image";
	#address-cells = <1>;

	images {
		kernel {
			description = "Summit Linux Kernel";
			summit-version = "";
			data = /incbin/("Image.gz");
			type = "kernel";
			arch = "arm";
			os = "linux";
			compression = "gzip";
			load = <0x20008000>;
			entry = <0x20008000>;
			kernel-version = <1>;
		};

		fdt {
			description = "Flattened Device Tree blob";
			data = /incbin/("at91-wb50n.dtb");
			type = "flat_dt";
			arch = "arm";
			compression = "none";
			fdt-version = <1>;
		};
	};

	configurations {
		default = "config";

		config {
			description = "Summit Linux Kernel with FDT blob";
			kernel = "kernel";
			fdt = "fdt";
		};
	};
};
```

## board/configs-common/image/u-boot-enc.its
```
// SPDX-License-Identifier: GPL-2.0
/*
 * Copyright (C) 2018-2024 Ezurio
 *
 * Minimal dts for a SPL FIT image payload.
 */

/dts-v1/;

/ {
	description = "Summit U-Boot FIT Image";

	images {
		uboot {
			description = "Summit U-Boot";
			data = /incbin/("u-boot-nodtb.bin");
			type = "standalone";
			os = "u-boot";
			arch = "arm";
			compression = "none";
			load = <0x21000000>;

			hash {
				algo = "sha256";
			};

			cipher {
				algo = "aes128";
				key-name-hint = "key";
				iv-name-hint = "key-iv";
			};
		};

		fdt {
			description = "Flattened Device Tree blob";
			data = /incbin/("u-boot.dtb");
			type = "flat_dt";
			arch = "arm";
			compression = "none";

			hash {
				algo = "sha256";
			};

			cipher {
				algo = "aes128";
				key-name-hint = "key";
				iv-name-hint = "key-iv";
			};
		};

		script {
			description = "Boot script";
			data = /incbin/("u-boot.scr.itb");
			type = "script";
			load = <0x20100000>;
			compression = "none";

			hash {
				algo = "sha256";
			};

			cipher {
				algo = "aes128";
				key-name-hint = "key";
				iv-name-hint = "key-iv";
			};
		};
	};

	configurations {
		default = "config";

		config {
			description = "Summit U-Boot with FDT blob";
			loadables = "uboot", "script";
			fdt = "fdt";

			signature {
				algo = "sha256,rsa2048";
				padding = "pkcs-1.5";
				key-name-hint = "dev";
				sign-images = "loadables", "fdt";
			};
		};
	};
};
```

## board/configs-common/image/u-boot.its
```
// SPDX-License-Identifier: LicenseRef-Ezurio-Clause
/*
 * Copyright (C) 2018-2024 Ezurio
 *
 * Minimal dts for a SPL FIT image payload.
 */

/dts-v1/;

/ {
	description = "Summit U-Boot FIT Image";

	images {
		uboot {
			description = "Summit U-Boot";
			data = /incbin/("u-boot-nodtb.bin");
			type = "standalone";
			os = "u-boot";
			arch = "arm";
			compression = "none";
			load = <0x21000000>;

			hash {
				algo = "sha256";
			};
		};

		fdt {
			description = "Flattened Device Tree blob";
			data = /incbin/("u-boot.dtb");
			type = "flat_dt";
			arch = "arm";
			compression = "none";

			hash {
				algo = "sha256";
			};
		};
	};

	configurations {
		default = "config";

		config {
			description = "Summit U-Boot with FDT blob";
			loadables = "uboot";
			fdt = "fdt";
		};
	};
};
```

## board/configs-common/image/u-boot.scr.its
```
/*
 * Copyright (C) 2018-2024 Ezurio
 *
 * Minimal dts for a SPL FIT image payload.
 *
 * SPDX-License-Identifier: GPL-2.0+  X11
 */

/dts-v1/;

/ {
	description = "U-Boot Script";
	#address-cells = <1>;

	images {
		script {
			data = /incbin/("u-boot.scr");
			type = "script";
			compression = "none";

			hash {
				algo = "sha256";
			};
		};
	};
};
```
